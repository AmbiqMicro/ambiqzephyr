## tests/boards/ambiq/aes_hal_example/testcase.yaml
```yaml
# Copyright (c) 2026 Ambiq Micro, Inc.
# SPDX-License-Identifier: Apache-2.0

tests:
  boards.ambiq.aes_hal_example:
    tags:
      - ambiq
      - crypto
      - aes
    harness: console
    harness_config:
      type: one_line
      regex:
        - "All driver checks passed"
    platform_allow:
      - apollo330mP_evb
      - apollo330mP_evb/apollo330P
      - apollo510_evb
      - apollo510_evb/apollo510
      - apollo510b_evb
      - apollo510b_evb/apollo510b
      - apollo510dL_evb
      - apollo510dL_evb/apollo510L
```

## tests/boards/ambiq/chacha_hal_example/testcase.yaml
```yaml
# Copyright (c) 2026 Ambiq Micro, Inc.
# SPDX-License-Identifier: Apache-2.0

tests:
  boards.ambiq.chacha_hal_example:
    tags:
      - ambiq
      - crypto
      - chacha
    harness: console
    harness_config:
      type: one_line
      regex:
        - "All driver checks passed"
    platform_allow:
      - apollo510_evb
      - apollo510b_evb
      - apollo510dL_evb
      - apollo330mP_evb
```

## tests/boards/ambiq/hmac_hal_example/testcase.yaml
```yaml
# Copyright (c) 2026 Ambiq Micro, Inc.
# SPDX-License-Identifier: Apache-2.0

tests:
  boards.ambiq.hmac_hal_example:
    tags:
      - ambiq
      - crypto
      - hmac
    harness: console
    harness_config:
      type: one_line
      regex:
        - "All driver checks passed"
    platform_allow:
      - apollo510_evb
      - apollo510b_evb
      - apollo510dL_evb
      - apollo330mP_evb
```

## tests/boards/ambiq/poly1305_hal_example/testcase.yaml
```yaml
# Copyright (c) 2026 Ambiq Micro, Inc.
# SPDX-License-Identifier: Apache-2.0

tests:
  boards.ambiq.poly1305_hal_example:
    tags:
      - ambiq
      - crypto
      - poly1305
    harness: console
    harness_config:
      type: one_line
      regex:
        - "All driver checks passed"
    platform_allow:
      - apollo510_evb
      - apollo510b_evb
      - apollo510dL_evb
      - apollo330mP_evb
```

## tests/crypto/crypto_aes/testcase.yaml
```yaml
tests:
  crypto.aes.mbedtls_shim:
    platform_allow:
      - native_sim
    integration_platforms:
      - native_sim
    extra_args: EXTRA_CONF_FILE=prj_mtls_shim.conf
    tags: crypto
  crypto.aes:
    platform_allow:
      - esp32_devkitc/esp32/procpu
      - esp32s2_devkitc
      - esp32s3_devkitc/esp32s3/procpu
      - esp32c3_devkitc
      - esp32c6_devkitc/esp32c6/hpcore
      - esp32h2_devkitm
    tags: crypto
  crypto.aes.ambiq:
    platform_allow:
      - apollo510_evb
      - apollo510b_evb
      - apollo510dL_evb
      - apollo330mP_evb
    integration_platforms:
      - apollo510_evb
    extra_configs:
      - CONFIG_NOCACHE_MEMORY=y
    tags: crypto
```

## tests/crypto/crypto_hash/testcase.yaml
```yaml
tests:
  crypto.hash.mbedtls_shim:
    platform_allow:
      - native_sim
      - nucleo_u575zi_q
    integration_platforms:
      - native_sim
      - nucleo_u575zi_q
    extra_args: EXTRA_CONF_FILE=prj_mtls_shim.conf
    tags: crypto
  crypto.hash:
    platform_allow:
      - esp32_devkitc/esp32/procpu
      - esp32s2_devkitc
      - esp32s3_devkitc/esp32s3/procpu
      - esp32c3_devkitc
      - esp32c6_devkitc/esp32c6/hpcore
      - esp32h2_devkitm
    tags: crypto
  crypto.hash.ambiq:
    platform_allow:
      - apollo510_evb
      - apollo510b_evb
      - apollo510dL_evb
      - apollo330mP_evb
    integration_platforms:
      - apollo510_evb
    extra_configs:
      - CONFIG_NOCACHE_MEMORY=n
    tags: crypto
```

## tests/drivers/i2s/i2s_speed/boards/apollo510_evb.conf
```kconfig
# Copyright (c) 2026 Ambiq Micro Inc.
# SPDX-License-Identifier: Apache-2.0

CONFIG_I2S_TEST_SEPARATE_DEVICES=y
CONFIG_I2S_TEST_USE_GPIO_LOOPBACK=y
CONFIG_I2S_TEST_USE_I2S_DIR_BOTH=n
CONFIG_I2S_TEST_ALLOWED_DATA_OFFSET=2
```
