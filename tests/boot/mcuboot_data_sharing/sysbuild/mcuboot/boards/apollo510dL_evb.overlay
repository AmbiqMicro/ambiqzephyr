/*
 * Copyright (c) 2026 Ambiq Micro Inc. <www.ambiq.com>
 *
 * SPDX-License-Identifier: Apache-2.0
 */
#include "../../../boards/apollo510dL_evb.overlay"

/ {
	chosen {
		zephyr,code-partition = &boot_partition;
	};
};
