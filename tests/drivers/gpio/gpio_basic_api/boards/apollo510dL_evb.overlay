/*
 * Copyright (c) 2026 Ambiq Micro Inc.
 *
 * SPDX-License-Identifier: Apache-2.0
 */

/ {
	resources {
		compatible = "test-gpio-basic-api";
		out-gpios = <&gpio0_31 14 (GPIO_ACTIVE_HIGH | GPIO_PULL_DOWN)>;
		in-gpios = <&gpio0_31 31 (GPIO_ACTIVE_HIGH | GPIO_PULL_DOWN)>;
	};
};
