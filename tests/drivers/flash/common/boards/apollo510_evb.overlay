/*
 * SPDX-FileCopyrightText: Copyright The Zephyr Project Contributors
 * SPDX-License-Identifier: Apache-2.0
 */

&flash0 {
	partitions {
		ranges;
		#address-cells = <1>;
		#size-cells = <1>;

		/* Reserve first 1 MB for code */
		code_partition: partition@0 {
			compatible = "zephyr,mapped-partition";
			reg = <0x0 DT_SIZE_K(1024)>;
			read-only;
		};

		/* 128 KB storage area (64 x 2 KB erase pages) */
		storage_partition: partition@100000 {
			compatible = "zephyr,mapped-partition";
			label = "storage";
			reg = <0x100000 DT_SIZE_K(128)>;
		};
	};
};
