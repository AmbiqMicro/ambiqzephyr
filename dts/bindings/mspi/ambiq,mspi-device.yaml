## dts/bindings/mspi/ambiq,mspi-device.yaml
```yaml
# Copyright (c) 2024 Ambiq Inc.
# SPDX-License-Identifier: Apache-2.0

description: Ambiq MSPI device

include: [mspi-device.yaml, "jedec,jesd216.yaml"]

properties:
  mspi-io-mode:
    required: true

  mspi-data-rate:
    required: true

  hardware-ce-num:
    type: int
    required: true
    default: 0
    description: |
      It can be only CE0 or CE1,
      but there could be multiple of CE0 or CE1 for a controller

  rx-dummy:
    required: true

  tx-dummy:
    required: true

  read-instruction:
    required: true

  write-instruction:
    required: true

  instruction-length:
    required: true

  address-length:
    required: true

  timing-config:
    type: array
    default: [0, 0, 0, 0, 0, 0]
    description: |
      Array of tuples to configure the timing parameters
      default =
      <
        .bSendInstr        = false;
        .bSendAddr         = false;
        .bWriteLatency     = false;
        .bTurnaround       = false;
        .ui8WriteLatency   = 0;
        .ui8TurnAround     = 0;
      >
```

## dts/bindings/mspi/mspi-device.yaml
```yaml
# Copyright (c) 2024, Ambiq Micro Inc.
# SPDX-License-Identifier: Apache-2.0

# Common fields for MSPI devices

include: [base.yaml, power.yaml]

on-bus: mspi

properties:
  reg:
    required: true

  mspi-max-frequency:
    type: int
    required: true
    description: Maximum clock frequency of device to configure in Hz

  duplex:
    type: string
    enum:
      - "MSPI_HALF_DUPLEX"
      - "MSPI_FULL_DUPLEX"
    description: |
      Duplex mode, full or half.

  mspi-io-mode:
    type: string
    enum:
      - "MSPI_IO_MODE_SINGLE"
      - "MSPI_IO_MODE_DUAL"
      - "MSPI_IO_MODE_DUAL_1_1_2"
      - "MSPI_IO_MODE_DUAL_1_2_2"
      - "MSPI_IO_MODE_QUAD"
      - "MSPI_IO_MODE_QUAD_1_1_4"
      - "MSPI_IO_MODE_QUAD_1_4_4"
      - "MSPI_IO_MODE_OCTAL"
      - "MSPI_IO_MODE_OCTAL_1_1_8"
      - "MSPI_IO_MODE_OCTAL_1_8_8"
      - "MSPI_IO_MODE_HEX"
    description: |
      MSPI I/O mode capabilities

  mspi-data-rate:
    type: string
    enum:
      - "MSPI_SINGLE_DATA_RATE"
      - "MSPI_DUAL_DATA_RATE"
    description:
      MSPI data rate capabilities

  mspi-cpp-mode:
    type: string
    enum:
      - "MSPI_CPP_MODE_0"
      - "MSPI_CPP_MODE_1"
      - "MSPI_CPP_MODE_2"
      - "MSPI_CPP_MODE_3"
    description: |
      MSPI_CPP_MODE_0: CPOL=0, CPHA=0
      MSPI_CPP_MODE_1: CPOL=0, CPHA=1
      MSPI_CPP_MODE_2: CPOL=1, CPHA=0
      MSPI_CPP_MODE_3: CPOL=1, CPHA=1

  mspi-endian:
    type: string
    enum:
      - "MSPI_LITTLE_ENDIAN"
      - "MSPI_BIG_ENDIAN"
    description: |
      MSPI transfer MSB or LSB first

  mspi-ce-polarity:
    type: string
    enum:
      - "MSPI_CE_ACTIVE_LOW"
      - "MSPI_CE_ACTIVE_HIGH"
    description: |
      MSPI CE polarity, in most cases, it is active low.

  mspi-hold-ce:
    type: boolean
    description: |
      In some cases, it is necessary for the master to manage MSPI chip enable
      (under software control), so that multiple mspi transactions can be performed
      without releasing it. A typical use case is variable length MSPI packets
      where the first mspi transaction reads the length and the second mspi transaction
      reads length bytes.

  mspi-enable-rx-dummy:
    type: boolean
    description: |
      Enable RX dummy cycles

  mspi-enable-tx-dummy:
    type: boolean
    description: |
      Enable TX dummy cycles

  mspi-enable-instr:
    type: boolean
    description: |
      Enable command phase

  mspi-enable-address:
    type: boolean
    description: |
      Enable address phase

  rx-dummy:
    type: int
    description: |
      The number of data or clock cycles between addr and data in RX direction

  tx-dummy:
    type: int
    description: |
      The number of data or clock cycles between addr and data in TX direction

  read-instruction:
    type: int
    description: |
      Read command to be sent in RX direction

  write-instruction:
    type: int
    description: |
      Write command to be sent in RX direction

  instruction-length:
    type: string
    enum:
      - "INSTR_1_BYTE"
      - "INSTR_2_BYTE"
    description: |
      Configure instruction length

  address-length:
    type: string
    enum:
      - "ADDR_1_BYTE"
      - "ADDR_2_BYTE"
      - "ADDR_3_BYTE"
      - "ADDR_4_BYTE"
    description: |
      Configure address length

  xip-config:
    type: array
    default: [0, 0, 0]
    description: |
      Array of tuples to configure the xip feature
      default =
      <
        .bEnable        = false;
        .ui32AddOffset  = 0;
        .ui32Size       = 0;
        .ePermission    = 0;
      >

  scramble-config:
    type: array
    default: [0, 0, 0]
    description: |
      Array of tuples to configure the scrambling feature
      default =
      <
        .bEnable        = false;
        .ui32AddOffset  = 0;
        .ui32Size       = 0;
      >

  ce-break-config:
    type: array
    default: [0, 0]
    description: |
      Array of tuples to configure the scrambling feature
      default =
      <
        .ui32MemBoundary          = 0;
                                    NONE = 0x0 - Disable DMA address boundary breaks
                                    BREAK32 = 0x1 - Break at 32 byte boundary (0x20 increments)
                                    BREAK64 = 0x2 - Break at 64 byte boundary (0x40 increments)
                                    BREAK128 = 0x3 - Break at 128 byte boundary (0x80 increments)
                                    BREAK256 = 0x4 - Break at 256 byte boundary (0x100 increments)
                                    BREAK512 = 0x5 - Break at 512 byte boundary (0x200 increments)
                                    BREAK1K = 0x6 - Break at 1KB boundary (0x400 increments)
                                    BREAK2K = 0x7 - Break at 2KB boundary (0x800 increments)
                                    BREAK4K = 0x8 - Break at 4KB boundary (0x1000 increments)
                                    BREAK8K = 0x9 - Break at 8KB boundary (0x2000 increments)
                                    BREAK16K = 0xA - Break at 16KB boundary (0x4000 increments)
        .ui32BreakTimeLimit       = 0; can be in us/ms
      >
```

## dts/bindings/mtd/ambiq,mspi-aps6404l.yaml
```yaml
# Copyright 2024 Ambiq Micro Inc.
# SPDX-License-Identifier: Apache-2.0

description: AP Memory APS6404L pSRAM on Ambiq MSPI bus

compatible: "ambiq,mspi-aps6404l"

include: ambiq,mspi-device.yaml
```

## dts/bindings/mtd/ambiq,mspi-atxp032.yaml
```yaml
# Copyright 2024 Ambiq Micro Inc.
# SPDX-License-Identifier: Apache-2.0

description: NOR Flash devices on Ambiq MSPI bus

compatible: "ambiq,mspi-atxp032"

include: ambiq,mspi-device.yaml
```

## dts/bindings/mtd/mspi-is25wx064.yaml
```yaml
# Copyright (c) 2024, Ambiq Micro Inc. <www.ambiq.com>
# SPDX-License-Identifier: Apache-2.0

description: NOR Flash devices IS25WX064 on MSPI bus

compatible: "mspi-is25wx064"

include: ambiq,mspi-device.yaml

properties:
  reset-gpios:
    type: phandle-array
    description: |
      The RESET pin is active low.
      If connected directly the MCU pin should be configured
      as active low.
```

## dts/bindings/power-domain/ambiq,crypto-power-domain.yaml
```yaml
# Copyright (c) 2026 Ambiq Micro Inc.
# SPDX-License-Identifier: Apache-2.0

description: |
  Ambiq CRYPTO (CC312) power domain. Manages the CRYPTO peripheral rail.
  On RESUME, enables CRYPTO via am_hal_pwrctrl_periph_enable. On SUSPEND,
  uses the dedicated am_hal_pwrctrl_control(CRYPTO_POWERDOWN) sequence
  required by the CC312 engine.

  Declare power-domains = <&otp_pd> on this node to ensure the OTP rail
  is brought up before CRYPTO is enabled (required by the Apollo5X HAL).
  Children (AES, TRNG, CRC) acquire the domain via pm_device_runtime_get/put.

compatible: "ambiq,crypto-power-domain"

include: power-domain.yaml
```

## dts/bindings/power-domain/ambiq,disp-power-domain.yaml
```yaml
# Copyright (c) 2026 Ambiq Micro Inc.
# SPDX-License-Identifier: Apache-2.0

description: |
  Ambiq DISP power domain.

  Manages am_hal_pwrctrl_periph_enable/disable for the shared DISP rail
  used by MIPI-DSI, MIPI-DBI, JDI display controller, and the SPI
  display controller (spi-dcif).  Multiple display drivers may be compiled
  in simultaneously but only one is active on a board; this domain ensures
  the rail is enabled at boot and disabled on system suspend.

  Consumers declare this domain via:
    power-domains = <&disp_pd>;

compatible: "ambiq,disp-power-domain"

include: power-domain.yaml
```

## dts/bindings/power-domain/ambiq,otp-power-domain.yaml
```yaml
# Copyright (c) 2026 Ambiq Micro Inc.
# SPDX-License-Identifier: Apache-2.0

description: |
  Ambiq OTP (INFOC/EFUSE) power domain. Manages the OTP peripheral
  rail via am_hal_pwrctrl_periph_enable/disable(AM_HAL_PWRCTRL_PERIPH_OTP).

  On Apollo5X SoCs the OTP rail must be active before the CRYPTO (CC312)
  rail can be enabled. Model this by having the CRYPTO power domain node
  declare power-domains = <&otp_pd> so the framework automatically
  enables OTP before CRYPTO and disables it after.

compatible: "ambiq,otp-power-domain"

include: power-domain.yaml
```

## dts/bindings/rtc/ambiq,rtc.yaml
```yaml
# SPDX-License-Identifier: Apache-2.0
# Copyright (c) 2024 Ambiq Micro

description: AMBIQ RTC

compatible: "ambiq,rtc"

include: rtc-device.yaml

properties:
  reg:
    required: true
  clock:
    type: int
    default: 0
    description: |
      Clock to gate the RTC.
      Use the macros not the actual enum value, here is the concordance
      list. (Not implemented in driver currently)
        0    AM_HAL_CLKGEN_CONTROL_RTC_SEL_XTAL
        1    AM_HAL_CLKGEN_CONTROL_RTC_SEL_LFRC
    enum:
      - 0
      - 1
```

## dts/bindings/sdhc/ambiq,ambiq-sdhc.yaml
```yaml
# Copyright 2024, Ambiq Micro Inc.
# SPDX-License-Identifier: Apache-2.0

description: Ambiq SDIO host controller

compatible: "ambiq,sdio"

include: [sdhc.yaml, pinctrl-device.yaml]
```

## dts/bindings/spi/apm,aps6404l.yaml
```yaml
# Copyright (c) 2018, NXP
# SPDX-License-Identifier: Apache-2.0

description: APS6404L FLASH

compatible: "apm,aps6404l"

include: spi-device.yaml
```

## dts/bindings/timer/ambiq,ctimer.yaml
```yaml
# Copyright (c) 2023 Antmicro <www.antmicro.com>
# SPDX-License-Identifier: Apache-2.0

description: Ambiq CTIMER

compatible: "ambiq,ctimer"

include: base.yaml

properties:
  reg:
    required: true

  interrupts:
    required: true

  clk-source:
    type: int
    required: true
    description: |
      clk-source specifies the clock source that used by the system timer.
      For Apollo3:
      0, : TMRPIN : Clock source is TMRPINA
      1, : HFRC_DIV4 : Clock source is the HFRC / 4
      2, : HFRC_DIV16 : Clock source is HFRC / 16   
      3, : HFRC_DIV256 : Clock source is HFRC / 256
      4, : HFRC_DIV1024 : Clock source is HFRC / 1024
      5, : HFRC_DIV4K : Clock source is HFRC / 4096
      6, : XT : Clock source is the XT (uncalibrated)
      7, : XT_DIV2 : Clock source is XT / 2
      8, : XT_DIV16 : Clock source is XT / 16
      9 : XT_DIV128 : Clock source is XT / 128
      10 : LFRC_DIV2 : Clock source is LFRC / 2
      11 : LFRC_DIV32 : Clock source is LFRC / 32
      12 : LFRC_DIV1K : Clock source is LFRC / 1024
      13 : LFRC : Clock source is LFRC
      14 : RTC_100HZ : Clock source is 100 Hz from the current RTC oscillator
      15 : HCLK_DIV4 : Clock source is HCLK / 4 (note: this clock is only available when MCU is in active mode)
      16 : XT_DIV4 : Clock source is XT / 4
      17 : XT_DIV8 : Clock source is XT / 8
      18 : XT_DIV32 : Clock source is XT / 32
      20 : CTMRB0 : Clock source is CTIMERB0 OUT
      21 : CTMRA1 : Clock source is CTIMERA1 OUT
      22 : CTMRB1 : Clock source is CTIMERB1 OUT
      23 : CTMRA2 : Clock source is CTIMERA2 OUT
      24 : CTMRB2 : Clock source is CTIMERB2 OUT
      25 : CTMRB3 : Clock source is CTIMERB3 OUT
      26 : CTMRB4 : Clock source is CTIMERB4 OUT
      27 : CTMRB5 : Clock source is CTIMERB5 OUT
      28 : CTMRB6 : Clock source is CTIMERB6 OUT
      29 : BUCKBLE : Clock source is BLE buck converter TON pulses
      30 : BUCKB : Clock source is Memory buck converter TON pulses
      31 : BUCKA : Clock source is CPU buck converter TON pulses
```

## dts/bindings/timer/ambiq,timer.yaml
```yaml
# Copyright (c) 2023-2024 Analog Devices, Inc.
# SPDX-License-Identifier: Apache-2.0

description: Ambiq TIMER timer

compatible: "ambiq,timer"

include: [base.yaml]

properties:
  reg:
    required: true

  interrupts:
    required: true

  clk-source:
    type: int
    required: true
    description: Counter Clock Source
```

## modules/hal_ambiq/Kconfig
```kconfig
# SPDX-License-Identifier: Apache-2.0
#
# Copyright (c) 2023 Antmicro <www.antmicro.com>

config AMBIQ_HAL
	bool "Ambiq HAL drivers support"
	depends on SOC_SERIES_APOLLO4X || SOC_SERIES_APOLLO5X
	help
	  Use the Ambiq HAL

if AMBIQ_HAL

config AMBIQ_HAL_USE_ITM
	bool
	help
	  Use the ITM HAL from Ambiq

config AMBIQ_HAL_USE_TPIU
	bool
	help
	  Use the TPIU HAL from Ambiq

config AMBIQ_HAL_USE_DCU
	bool
	help
	  Use the DCU HAL from Ambiq

config AMBIQ_HAL_USE_GPIO
	bool
	help
	  Use the GPIO driver from Ambiq HAL

config AMBIQ_HAL_USE_STIMER
	bool
	help
	  Use the STIMER driver from Ambiq HAL

config AMBIQ_HAL_USE_TIMER
	bool
	help
	  Use the TIMER driver from Ambiq HAL

config AMBIQ_HAL_USE_WDT
	bool
	help
	  Use the WDT driver from Ambiq HAL

config AMBIQ_HAL_USE_I2C
	bool
	help
	  Use the I2C driver from Ambiq HAL

config AMBIQ_HAL_USE_SPI
	bool
	help
	  Use the SPI driver from Ambiq HAL

config AMBIQ_HAL_USE_MSPI
	bool
	help
	  Use the MSPI driver from Ambiq HAL

config AMBIQ_HAL_USE_SDIO
	bool
	help
	  Use the SDIO driver from Ambiq HAL

endif # AMBIQ_HAL
```

## samples/am_samples/drivers/custom_drivers/zephyr/ambt53/Kconfig
```kconfig
# Copyright (c) 2019 Nordic Semiconductor
# SPDX-License-Identifier: Apache-2.0

menuconfig AMBT53_XIP_DRIVER
    bool "AMBT53 driver"
    default n
    depends on DT_HAS_CUSTOM_AMBT53_ENABLED
    help
      Enable custom driver for AMBT53

config CUSTOM_AMBT53_INIT_PRIORITY
	int "Init priority"
	default 71
	help
	  Device driver initialization priority.
```

## samples/am_samples/drivers/custom_drivers/zephyr/mspi/Kconfig
```kconfig
# Copyright (c) 2019 Nordic Semiconductor
# SPDX-License-Identifier: Apache-2.0

menuconfig CUSTOM_MSPI_DRIVER
    bool "MSPI driver"
    default n
    depends on DT_HAS_CUSTOM_AMBIQ_QSPI_ENABLED
    select AMBIQ_HAL
    select AMBIQ_HAL_USE_MSPI
    help
      Enable custom mspi driver for AMBT53

config CUSTOM_SPI_INIT_PRIORITY
	int "Init priority"
	default 70
	help
	  Device driver initialization priority.
```

## samples/bluetooth/broadcaster/sample.yaml
```yaml
sample:
  name: broadcaster
tests:
  sample.bluetooth.broadcaster.console:
    harness: console
    harness_config:
      type: one_line
      regex:
        - "Sending advertising data"
    platform_allow:
      - apollo510L_eb
  sample.bluetooth.broadcaster.bluetooth_harness:
    harness: bluetooth
    platform_allow:
      - qemu_cortex_m3
      - qemu_x86
      - nrf51dk/nrf51822
      - nrf52dk/nrf52832
    tags: bluetooth
    integration_platforms:
      - qemu_cortex_m3
```

## samples/bluetooth/direct_adv/sample.yaml
```yaml
sample:
  name: Bluetooth Direct Advertising
tests:
  sample.bluetooth.direct_adv.console:
    harness: console
    harness_config:
      type: one_line
      regex:
        - "Advertising successfully started"
    platform_allow:
      - apollo510L_eb
  sample.bluetooth.direct_adv.bluetooth_harness:
    harness: bluetooth
    platform_allow: qemu_x86
    integration_platforms:
      - qemu_x86
    tags: bluetooth
```
