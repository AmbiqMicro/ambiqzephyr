## samples/bluetooth/eddystone/sample.yaml
```yaml
sample:
  name: Bluetooth Eddystone
tests:
  sample.bluetooth.eddystone.console:
    harness: console
    harness_config:
      type: one_line
      regex:
        - "Configuration mode: waiting connections"
    platform_allow:
      - apollo510L_eb
  sample.bluetooth.eddystone.bluetooth_harness:
    harness: bluetooth
    platform_allow:
      - qemu_cortex_m3
      - qemu_x86
    tags: bluetooth
    integration_platforms:
      - qemu_cortex_m3
```

## samples/bluetooth/ibeacon/sample.yaml
```yaml
sample:
  description: Sample code for Zephyr iBeacon Demo
  name: iBeacon
tests:
  sample.bluetooth.ibeacon.console:
    harness: console
    harness_config:
      type: one_line
      regex:
        - "iBeacon started"
    platform_allow:
      - apollo510L_eb
  sample.bluetooth.ibeacon.bluetooth_harness:
    harness: bluetooth
    platform_allow:
      - bbc_microbit
      - qemu_x86
    tags: bluetooth
    integration_platforms:
      - qemu_x86
```

## samples/drivers/audio/dmic/boards/apollo510_evb.conf
```kconfig
# CONFIG_MAIN_STACK_SIZE=4096
# CONFIG_NO_OPTIMIZATIONS=y
CONFIG_USE_SEGGER_RTT=y
CONFIG_SEGGER_RTT_SECTION_DTCM=y
```

## samples/drivers/i2s/output/boards/apollo510_evb.conf
```kconfig
# Copyright (c) 2025 Ambiq Micro Inc. <www.ambiq.com>
# SPDX-License-Identifier: Apache-2.0

CONFIG_PM_DEVICE_RUNTIME_DISABLE_CONSOLE=n
```

## samples/drivers/mbox_data/sample.yaml
```yaml
sample:
  name: MBOX Data IPC sample
common:
  sysbuild: true
  tags: mbox
tests:
  sample.drivers.mbox_data.real_hw:
    filter: dt_compat_enabled("vnd,mbox-consumer")
    integration_platforms:
      - mimxrt1160_evk/mimxrt1166/cm7
      - lpcxpresso55s69/lpc55s69/cpu0
    platform_exclude:
      - apollo510L_eb
    harness: console
    harness_config:
      type: multi_line
      ordered: false
      regex:
        - "Client received .+ value: 1"
        - "Client send .+ value: 2"
        - "Client received .+ value: 3"
        - "Client send .+ value: 4"
        - "Client received .+ value: 41"
        - "Client send .+ value: 42"
        - "Client received .+ value: 97"
        - "Client send .+ value: 98"
        - "Client received .+ value: 99"
  sample.drivers.mbox_data.ambiq:
    filter: dt_compat_enabled("vnd,mbox-consumer")
    sysbuild: false
    build_only: true
    platform_allow:
      - apollo510L_eb
```
