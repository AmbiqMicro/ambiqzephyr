## soc/ambiq/apollo5x/Kconfig
```kconfig
# SPDX-License-Identifier: Apache-2.0
#
# Copyright (c) 2025 Ambiq Micro Inc.

config SOC_SERIES_APOLLO5X
	select ARM
	select CPU_CORTEX_M55
	select CPU_CORTEX_M_HAS_DWT
	select CPU_CORTEX_M_HAS_VTOR
	select CPU_HAS_ARM_SAU
	select CPU_HAS_ARM_MPU
	select CPU_HAS_FPU
	select ARMV8_M_DSP
	select ARMV8_1_M_MVEI
	select ARMV8_1_M_MVEF
	select ARMV8_1_M_PMU
	select HAS_SWO
	select AMBIQ_HAL
	select HAS_PM
	select PM_STATE_SET_IRQ_UNLOCKED
	select SOC_EARLY_INIT_HOOK
	select REQUIRES_FULL_LIBC
	select CPU_HAS_DCACHE
	select CPU_HAS_ICACHE

config SOC_AMBIQ_HAS_PUF
	bool "Ambiq PUF support"
	default y
	help
	  This option enables the Ambiq PUF support.
	  It is required for the true random number generator.

config SOC_AMBIQ_DCACHE_SIZE
	int
	default 65536 if SOC_APOLLO510
	default 65536 if SOC_APOLLO510B

config SOC_AMBIQ_DMA_BUFF_LOCATION
	hex "Byte offset to SRAM_BASE_ADDRESS"
	default 0x50000
	help
	  This option specifies the cacheable DMA buffers' start address

config SOC_AMBIQ_DMA_BUFF_ALIGNMENT
	int "Byte alignment of the DMA buffer"
	default DCACHE_LINE_SIZE if DCACHE
	default 1
	help
	  This option specifies the DMA buffers' alignment

config SOC_APOLLO510B_EM9305_EXTREF_INIT
	bool "Wake the SiP EM9305 to provide the EXTREF clock"
	depends on SOC_APOLLO510B
	depends on DT_HAS_AMBIQ_BT_HCI_SPI_ENABLED
	depends on !MCUBOOT
	select GPIO
	select SPI
	select AMBIQ_COMPONENT_USE_BT
	select AMBIQ_HAL_USE_TIMER
	help
	  On the Apollo510B the EM9305 Bluetooth controller in the package
	  also supplies the ~12 MHz external reference clock. Wake it over
	  SPI at boot and put it to sleep with the clock request enabled so
	  the clock manager can use EXTREF even when Bluetooth is not built.
	  The controller is found through the ambiq,bt-hci-spi node.

config SOC_APOLLO510B_EM9305_EXTREF_INIT_PRIORITY
	int "EM9305 EXTREF clock init priority"
	default 51
	depends on SOC_APOLLO510B_EM9305_EXTREF_INIT

config ARMV8_1_M_PMU_EVENTCNT
	int
	default 8 if SOC_APOLLO510
	default 8 if SOC_APOLLO510B
```

## soc/ambiq/apollo5x/Kconfig.defconfig.apollo510b
```kconfig
# SPDX-License-Identifier: Apache-2.0
#
# Copyright (c) 2025 Ambiq Micro Inc.

if SOC_APOLLO510B

config NUM_IRQS
	default 134

config SOC_APOLLO510B_EM9305_EXTREF_INIT
	default y if !MCUBOOT

endif # SOC_APOLLO510B
```
