## boards/ambiq/apollo330mP_evb/Kconfig.apollo330mP_evb
```kconfig
# SPDX-License-Identifier: Apache-2.0
#
# Copyright (c) 2026 Ambiq Micro Inc. <www.ambiq.com>

config BOARD_APOLLO330MP_EVB
	select SOC_APOLLO330P
```

## boards/ambiq/apollo330mP_evb/Kconfig.sysbuild
```kconfig
# SPDX-License-Identifier: Apache-2.0
#
# Copyright (c) 2026 Ambiq Micro Inc.

choice BOOTLOADER
	default BOOTLOADER_MCUBOOT
endchoice
```

## boards/ambiq/apollo330mP_evb/board.yml
```yaml
board:
  name: apollo330mP_evb
  full_name: Apollo330mP SOC Evaluation Board
  vendor: ambiq
  socs:
  - name: apollo330P
```

## boards/ambiq/apollo3_evb/Kconfig.apollo3_evb
```kconfig
# SPDX-License-Identifier: Apache-2.0
#
# Copyright (c) 2023 Ambiq Micro Inc. <www.ambiq.com>

config BOARD_APOLLO3_EVB
	select SOC_APOLLO3_BLUE

config PM_DEVICE
	default y if PM

config PM_DEVICE_RUNTIME
	default y if PM_DEVICE

# Need to enlarge the IDLE stack size because the power 
# management operations are executed in the idle task
config IDLE_STACK_SIZE
	default 2048 if PM
```

## boards/ambiq/apollo3p_evb/Kconfig.apollo3p_evb
```kconfig
# SPDX-License-Identifier: Apache-2.0
#
# Copyright (c) 2023 Ambiq Micro Inc. <www.ambiq.com>

config BOARD_APOLLO3P_EVB
	select SOC_APOLLO3P_BLUE

config PM_DEVICE
	default y if PM

config PM_DEVICE_RUNTIME
	default y if PM_DEVICE

# Need to enlarge the IDLE stack size because the power 
# management operations are executed in the idle task.
config IDLE_STACK_SIZE
	default 2048 if PM

config SYS_CLOCK_TICKS_PER_SEC
	default 1024
```

## boards/ambiq/apollo4p_blue_kbr_evb/Kconfig.apollo4p_blue_kbr_evb
```kconfig
# SPDX-License-Identifier: Apache-2.0
#
# Copyright (c) 2025 Ambiq Micro Inc. <www.ambiq.com>

config BOARD_APOLLO4P_BLUE_KBR_EVB
	select SOC_APOLLO4P_BLUE
```

## boards/ambiq/apollo4p_blue_kbr_evb/board.yml
```yaml
board:
  name: apollo4p_blue_kbr_evb
  full_name: Apollo4 Blue Plus KBR EVB
  vendor: ambiq
  socs:
  - name: apollo4p_blue
```

## boards/ambiq/apollo4p_blue_kxr_evb/Kconfig.apollo4p_blue_kxr_evb
```kconfig
# SPDX-License-Identifier: Apache-2.0
#
# Copyright (c) 2023 Ambiq Micro Inc. <www.ambiq.com>

config BOARD_APOLLO4P_BLUE_KXR_EVB
	select SOC_APOLLO4P_BLUE

config SYS_CLOCK_TICKS_PER_SEC
	default 1024
```

## boards/ambiq/apollo4p_evb/Kconfig.apollo4p_evb
```kconfig
# SPDX-License-Identifier: Apache-2.0
#
# Copyright (c) 2023 Antmicro <www.antmicro.com>

config BOARD_APOLLO4P_EVB
	select SOC_APOLLO4P

config SYS_CLOCK_TICKS_PER_SEC
	default 1024
```

## boards/ambiq/apollo510L_eb/Kconfig.defconfig
```kconfig
# SPDX-License-Identifier: Apache-2.0
#
# Copyright (c) 2025 Ambiq Micro Inc.

if BOARD_APOLLO510L_EB

config SYS_CLOCK_HW_CYCLES_PER_SEC
	default 32768 if AMBIQ_STIMER_TIMER
	default 96000000 if CORTEX_M_SYSTICK

config LOG_BACKEND_SWO_FREQ_HZ
	default 1000000
	depends on LOG_BACKEND_SWO

if MSPI

config MSPI_INIT_PRIORITY
	default 40

endif # MSPI

if MEMC

config MEMC_INIT_PRIORITY
	default 50

endif # MEMC

if FLASH

config FLASH_INIT_PRIORITY
	default 50

endif # FLASH

config ROM_START_OFFSET
	default 0x400 if BOOTLOADER_MCUBOOT

if BT

config IPC_SERVICE_BACKEND_RPMSG_SHMEM_RESET
	default y

config IPC_SERVICE_STATIC_VRINGS_MEM_ALIGNMENT
	default 32

config OPENAMP_SLAVE
	default n

config MAIN_STACK_SIZE
	default 2048

# HEAP is definitely necessary for BT HCI IPC.
config HEAP_MEM_POOL_SIZE
	default 2048

config BT_HCI_ACL_FLOW_CONTROL
	default y if BT_CONN

config BT_HCI_VS
	default n

config BT_BUF_ACL_TX_COUNT
	default 8

config BT_BUF_CMD_TX_SIZE
	default 251

config BT_BUF_EVT_RX_SIZE
	default 251

config BT_BUF_ACL_TX_SIZE
	default 251

config BT_BUF_ACL_RX_SIZE
	default 251

config BT_L2CAP_TX_MTU
	default 247

endif # BT

endif # BOARD_APOLLO510L_EB
```

## boards/ambiq/apollo510L_eb/board.yml
```yaml
board:
  name: apollo510L_eb
  full_name: Apollo510 Lite SOC Evaluation Board
  vendor: ambiq
  socs:
  - name: apollo510L
```

## boards/ambiq/apollo510_blue_eb/board.yml
```yaml
board:
  name: apollo510_blue_eb
  full_name: Apollo510 Blue SOC Evaluation Board
  vendor: ambiq
  socs:
  - name: apollo510
```

## boards/ambiq/apollo510_evb/Kconfig.defconfig
```kconfig
# SPDX-License-Identifier: Apache-2.0
#
# Copyright (c) 2025 Ambiq Micro Inc.

if BOARD_APOLLO510_EVB

config SYS_CLOCK_HW_CYCLES_PER_SEC
	default 32768 if AMBIQ_STIMER_TIMER

config LOG_BACKEND_SWO_FREQ_HZ
	default 1000000
	depends on LOG_BACKEND_SWO

endif # BOARD_APOLLO510_EVB

#if BT

config MAIN_STACK_SIZE
  default 2048

config BT_BUF_ACL_TX_COUNT
	default 4

config BT_BUF_CMD_TX_SIZE
	default 255

config BT_BUF_EVT_RX_SIZE
	default 255

config BT_BUF_ACL_TX_SIZE
	default 251

config BT_BUF_ACL_RX_SIZE
	default 251

# L2CAP SDU/PDU TX MTU
# BT_L2CAP_RX_MTU = CONFIG_BT_BUF_ACL_RX_SIZE - BT_L2CAP_HDR_SIZE
config BT_L2CAP_TX_MTU
	default 247

#endif # BT
```

## boards/ambiq/apollo510b_evb/Kconfig
```kconfig
# SPDX-License-Identifier: Apache-2.0
#
# Copyright (c) 2025 Ambiq Micro Inc. <www.ambiq.com>

config BOARD_APOLLO510B_EVB
	select BOARD_EARLY_INIT_HOOK

if BOARD_APOLLO510B_EVB

config BOARD_APOLLO510B_EVB_EM9305_EXTREF_INIT
	bool "Wake SIP EM9305 for EXTREF clock"
	default y
	select GPIO
	select SPI
	select AMBIQ_COMPONENT_USE_BT
	select AMBIQ_HAL_USE_TIMER
	help
	  After POST_KERNEL device init, wake the SIP EM9305 over SPI and enable sleep so
	  CLKMGR can use EXTREF (~12 MHz). Uses ambiq,bt-hci-spi in devicetree;
	  CONFIG_BT is not required. Runs via SYS_INIT at POST_KERNEL.

config EXTREF_INIT_PRIORITY
	int "Apollo510B EXTREF clock init priority"
	default 51
	depends on BOARD_APOLLO510B_EVB_EM9305_EXTREF_INIT

config BOARD_ENABLE_GPU_ASSET_RELOCATION
	bool "Relocate GPU asset from MRAM to PSRAM or SSRAM"
	default y if LVGL
	select BOARD_LATE_INIT_HOOK
	help
	  The Apollo510B GPU has limited access to MRAM. If this option is
	  enabled, large constant assets (like LVGL fonts and images) will
	  be loaded into MRAM but copied to external XIP RAM at BOARD_LATE_INIT_HOOK
	  for direct access by the GPU. This is essential for any LVGL
	  application with large assets on this board.
endif
```

## boards/ambiq/apollo510dL_evb/Kconfig.defconfig
```kconfig
# SPDX-License-Identifier: Apache-2.0
#
# Copyright (c) 2025 Ambiq Micro Inc.

if BOARD_APOLLO510DL_EVB

config SYS_CLOCK_HW_CYCLES_PER_SEC
	default 32768 if AMBIQ_STIMER_TIMER
	default 96000000 if CORTEX_M_SYSTICK

config LOG_BACKEND_SWO_FREQ_HZ
	default 1000000
	depends on LOG_BACKEND_SWO

if MSPI

config MSPI_INIT_PRIORITY
	default 40

endif # MSPI

if MEMC

config MEMC_INIT_PRIORITY
	default 50

endif # MEMC

if FLASH

config FLASH_INIT_PRIORITY
	default 50

endif # FLASH

# NemaGFX places the command-list ring buffer and (by default) the render heap in
# SRAM_NO_CACHE. This board exposes 256 KiB at 0x20200000; the last 12 KiB are
# reserved for IPC at 0x2023d000, so the render heap must stay small enough that
# static allocations do not grow into that window (see apollo510dL_evb.dts).
if AMBIQ_COMPONENT_USE_NEMAGFX

config NEMAGFX_HEAP_SIZE_RENDER
	default 236

endif # AMBIQ_COMPONENT_USE_NEMAGFX

config ROM_START_OFFSET
	default 0x400 if BOOTLOADER_MCUBOOT

if BT

config IPC_SERVICE_BACKEND_RPMSG_SHMEM_RESET
	default y

config IPC_SERVICE_STATIC_VRINGS_MEM_ALIGNMENT
	default 32

config OPENAMP_SLAVE
	default n

config MAIN_STACK_SIZE
	default 2048

# HEAP is definitely necessary for BT HCI IPC.
config HEAP_MEM_POOL_SIZE
	default 2048

config BT_HCI_ACL_FLOW_CONTROL
	default y if BT_CONN

config BT_HCI_VS
	default n

config BT_BUF_ACL_TX_COUNT
	default 8

config BT_BUF_CMD_TX_SIZE
	default 251

config BT_BUF_EVT_RX_SIZE
	default 251

config BT_BUF_ACL_TX_SIZE
	default 251

config BT_BUF_ACL_RX_SIZE
	default 251

config BT_L2CAP_TX_MTU
	default 247

endif # BT

endif # BOARD_APOLLO510DL_EVB
```

## boards/ambiq/apollo510dL_evb/board.yml
```yaml
board:
  name: apollo510dL_evb
  full_name: Apollo510dL SOC Evaluation Board
  vendor: ambiq
  socs:
  - name: apollo510L
```

## boards/arm/apollo4p_stmobo2/Kconfig.board
```kconfig
# SPDX-License-Identifier: Apache-2.0
#
# Copyright (c) 2023 Antmicro <www.antmicro.com>

config BOARD_APOLLO4P_STMOBO2
	bool "Ambiq Apollo4 Plus System Test Motherboard Rev2"
	depends on SOC_APOLLO4P
```

## boards/arm/apollo4p_stmobo2/Kconfig.defconfig
```kconfig
# SPDX-License-Identifier: Apache-2.0
#
# Copyright (c) 2023 Antmicro <www.antmicro.com>

config BOARD
	default "apollo4p_stmobo2"
	depends on BOARD_APOLLO4P_STMOBO2
```

## boards/arm/apollo5_eb/Kconfig.board
```kconfig
# SPDX-License-Identifier: Apache-2.0
#
# Copyright (c) 2024 Ambiq Micro Inc.

config BOARD_APOLLO5_EB
	bool "Ambiq Apollo5 Engineering Board"
	depends on SOC_APOLLO5
```

## boards/arm/apollo5_eb/Kconfig.defconfig
```kconfig
# SPDX-License-Identifier: Apache-2.0
#
# Copyright (c) 2024 Ambiq Micro Inc.

config BOARD
	default "apollo5_eb"
	depends on BOARD_APOLLO5_EB
```

## boards/shields/ambiq_mikrobus_spi/Kconfig.shield
```kconfig
# Copyright (c) 2025, Ambiq Micro Inc. <www.ambiq.com>
# SPDX-License-Identifier: Apache-2.0

config SHIELD_AMBIQ_MIKROBUS_SPI
	def_bool $(shields_list_contains,ambiq_mikrobus_spi)
```

## boards/shields/ap510_disp_rev1/Kconfig.shield
```kconfig
# Copyright (c) 2025 Ambiq Micro Inc.
# SPDX-License-Identifier: Apache-2.0

config SHIELD_AP510_DISP_REV1
	def_bool $(shields_list_contains,ap510_disp_rev1)
```

## boards/shields/ap510_disp_rev1/boards/apollo510_evb.conf
```kconfig
# Copyright (c) 2025 Ambiq Inc.
# SPDX-License-Identifier: Apache-2.0

CONFIG_RM69330=y
CONFIG_COMPILER_SAVE_TEMPS=y
CONFIG_DISPLAY_RM69330_INIT_PRIORITY=87
CONFIG_GPIO=y

CONFIG_UART_CONSOLE=y
CONFIG_SERIAL=y
#CONFIG_LOG=y
#CONFIG_NEMADC_LOG_LEVEL_DBG=y
CONFIG_DISPLAY_LOG_LEVEL_DBG=y
# CONFIG_DISPLAY_LOG_LEVEL_INF=y
# CONFIG_DISPLAY_LOG_LEVEL_WRN=y
CONFIG_MIPI_DSI_LOG_LEVEL_DBG=y
# CONFIG_MIPI_DSI_LOG_LEVEL_INF=y
# CONFIG_MIPI_DSI_LOG_LEVEL_WRN=y

CONFIG_LOG_OUTPUT_FORMAT_LINUX_TIMESTAMP=y
CONFIG_LOG_MODE_IMMEDIATE=y
#CONFIG_LOG_DEFAULT_LEVEL=0
#CONFIG_LOG_BUFFER_SIZE=16384
#CONFIG_LOG_BACKEND_AMBIQ_SWO=y
#CONFIG_LOG_BACKEND_AMBIQ_SWO_FREQ_HZ=1000000
```

## boards/shields/apollo5_eb_display_card/Kconfig.shield
```kconfig
# Copyright (c) 2025 Ambiq Micro Inc.
# SPDX-License-Identifier: Apache-2.0

config SHIELD_APOLLO5_EB_DISPLAY_CARD
	def_bool $(shields_list_contains,apollo5_eb_display_card)

config SHIELD_APOLLO5_EB_DISPLAY_CARD_SPI
	def_bool $(shields_list_contains,apollo5_eb_display_card_spi)
```
