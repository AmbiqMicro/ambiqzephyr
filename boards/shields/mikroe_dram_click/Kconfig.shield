## dts/bindings/display/raydium,rm69330.yaml
```yaml
#
# Copyright 2025, Ambiq Inc.
#
# SPDX-License-Identifier: Apache-2.0
#

description: Raydium RM69330 Panel

compatible: "raydium,rm69330"

include: [mipi-dsi-device.yaml, display-controller.yaml, pinctrl-device.yaml]

properties:
  reg:
    required: true

  reset-gpios:
    type: phandle-array
    description: |
      The RESETn pin is asserted to disable the sensor causing a hard
      reset.  The sensor receives this as an active-low signal.

  enable-gpios:
    type: phandle-array
    description: |
      The ENn pin is asserted to enable the panel.
      The sensor receives this as an active-high signal.

  ifsel1-gpios:
    type: phandle-array
    description: |
      The Interface selection1 pin.
      
  ifsel2-gpios:
    type: phandle-array
    description: |
      The Interface selection1 pin.

  rotation:
    type: int
    default: 0
    enum:
      - 0
      - 90
      - 180
      - 270
    description: |
      Display rotation (CW) in degrees. Defaults to 0, display default.
```

## dts/bindings/display/sharp,ls014b7dd01.yaml
```yaml
# Copyright (c) 2025 Ambiq Micro Inc.
# SPDX-License-Identifier: Apache-2.0

description: Sharp LS014B7DD01 display

compatible: "sharp,ls014b7dd01"

include: ["display-controller.yaml", "pinctrl-device.yaml", "jdi-device.yaml"]
```

## dts/bindings/mipi-dsi/ambiq,mipi-dsi.yaml
```yaml
# Copyright (c) 2025 Ambiq Micro Inc.
# SPDX-License-Identifier: Apache-2.0

description: Ambiq MIPI DSI host

compatible: "ambiq,mipi-dsi"

include: [mipi-dsi-host.yaml, pinctrl-device.yaml]

properties:
  dbi-width:
    type: int
    required: true
    description:
      DBI width to DSI.
      
  data-lanes:
    type: int
    required: true
    description:
      Number of data lanes.

  pix-fmt:
    type: int
    required: true
    description:
      Pixel format. Available formats in dt-bindings/mipi_dsi/mipi_dsi.h.

  disp-te:
    type: boolean
    description:
      Enable or Disable the TE feature.
```

## dts/bindings/mmc/ambiq,ambiq-sdio.yaml
```yaml
description: Ambiq sdmmc disk access

compatible: "ambiq,sdio"

include: [mmc.yaml, pinctrl-device.yaml, reset-device.yaml]

properties:

  bus-width:
    type: int
    default: 4
    description: |
        bus width for SDMMC access
    enum:
      - 1
      - 4
      - 8
```
