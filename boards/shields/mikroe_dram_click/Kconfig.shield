## boards/shields/mikroe_dram_click/Kconfig.shield
```kconfig
# Copyright (c) 2025, Ambiq Micro Inc. <www.ambiq.com>
# SPDX-License-Identifier: Apache-2.0

config SHIELD_MIKROE_DRAM_CLICK
	def_bool $(shields_list_contains,mikroe_dram_click)
```

## drivers/crc/Kconfig
```kconfig
# CRC configuration options

# Copyright (c) 2025, Ambiq
# SPDX-License-Identifier: Apache-2.0

menuconfig CRC
	bool "CRC drivers"
	help
	  Enable CRC (Cyclic Redundancy Check) driver support.

if CRC

# Ensure Ambiq-specific CRC Kconfig is included
source "drivers/crc/Kconfig.ambiq"

config CRC_INIT_PRIORITY
	int "CRC devices init priority"
	default 90
	help
	  CRC devices initialization priority.

module = CRC
module-str = CRC
source "subsys/logging/Kconfig.template.log_config"

endif # CRC
```

## drivers/crc/Kconfig.ambiq
```kconfig
# Ambiq CRC configuration options

# Copyright (c) 2025 Ambiq
# Author: Richard S Wheatley
# SPDX-License-Identifier: Apache-2.0

config CRC_AMBIQ
	bool "Ambiq Apollo4P and Apollo510 CRC support"
	default y
	depends on SOC_SERIES_APOLLO4X || SOC_SERIES_APOLLO5X
	help
	  Enable Ambiq Apollo4P and Apollo510 CRC support.
```

## drivers/display/Kconfig.rm69330
```kconfig
# Copyright (c) 2025 Ambiq Inc.
# SPDX-License-Identifier: Apache-2.0

config RM69330
	bool "RM69330 display driver"
	default y
	select MIPI_DSI
	depends on DT_HAS_RAYDIUM_RM69330_ENABLED
	help
	  Enable driver for RM69330 display driver.
```

## drivers/flash/Kconfig.ambiq
```kconfig
# Copyright (c) 2023 Ambiq Micro Inc.
# SPDX-License-Identifier: Apache-2.0

config FLASH_AMBIQ
	bool "Ambiq flash driver on MRAM"
	default y
	depends on DT_HAS_AMBIQ_FLASH_CONTROLLER_ENABLED
	select AMBIQ_HAL
	select FLASH_HAS_PAGE_LAYOUT
	select FLASH_HAS_DRIVER_ENABLED
	help
	  Enables Ambiq flash driver on MRAM.

if DT_HAS_AMBIQ_MSPI_CONTROLLER_ENABLED

menu "Ambiq MSPI flash driver"

config FLASH_AMBIQ_MSPI_ATXP032
	bool "Ambiq MSPI ATXP032 driver"
	default y
	depends on DT_HAS_AMBIQ_MSPI_ATXP032_ENABLED
	select FLASH_HAS_PAGE_LAYOUT
	select FLASH_HAS_DRIVER_ENABLED
    select GPIO
	select MSPI
	select MSPI_AMBIQ_AP3 if SOC_SERIES_APOLLO3X

config FLASH_AMBIQ_MSPI_NAND
	bool "Ambiq MSPI NAND driver"
	default y
	depends on DT_HAS_AMBIQ_MSPI_NAND_ENABLED
	select FLASH_HAS_PAGE_LAYOUT
	select FLASH_HAS_DRIVER_ENABLED
    select GPIO
	select MSPI
	select MSPI_AMBIQ_AP3 if SOC_SERIES_APOLLO3X

endmenu

endif # HAS_AMBIQ_MSPI
```

## drivers/flash/Kconfig.mspi
```kconfig
# Copyright (c) 2023 Ambiq Micro Inc.
# SPDX-License-Identifier: Apache-2.0

# SPDX-License-Identifier: Apache-2.0

config MSPI_FLASH
	bool "MSPI flash drivers"
	default y
	depends on FLASH
	select FLASH_HAS_DRIVER_ENABLED
	select FLASH_HAS_PAGE_LAYOUT
	select FLASH_JESD216
	select FLASH_HAS_EX_OP
	select MSPI

if MSPI_FLASH

menu "MSPI flash driver"

config FLASH_MSPI_ATXP032
	bool "MSPI ATXP032 driver"
	default y
	depends on DT_HAS_MSPI_ATXP032_ENABLED
	select FLASH_HAS_PAGE_LAYOUT
	select FLASH_HAS_DRIVER_ENABLED
    select GPIO
	select MSPI_AMBIQ_AP3 if SOC_SERIES_APOLLO3X

config FLASH_MSPI_NAND
	bool "MSPI NAND driver"
	default y
	depends on DT_HAS_MSPI_NAND_ENABLED
	select FLASH_HAS_PAGE_LAYOUT
	select FLASH_HAS_DRIVER_ENABLED
    select GPIO
	select MSPI_AMBIQ_AP3 if SOC_SERIES_APOLLO3X

endmenu

endif # MSPI_FLASH
```

## drivers/input/Kconfig.chsc6540
```kconfig
# Copyright (c) 2026 Your Name
# SPDX-License-Identifier: Apache-2.0

config INPUT_CHSC6540
	bool "CHSC6540/6x40 capacitive touch panel driver"
	default y
	depends on DT_HAS_CHIPSEMI_CHSC6540_ENABLED
	select GPIO
	select I2C
	select INPUT_TOUCH
	help
	  Enable driver for Chipsemi CHSC6540/6x40 capacitive touch panel controller.
```

## drivers/jdi/Kconfig.ambiq
```kconfig
# Copyright (c) 2025 Ambiq Micro Inc.
# SPDX-License-Identifier: Apache-2.0

config JDI_AMBIQ
	bool "Ambiq JDI driver"
	default y
	depends on DT_HAS_AMBIQ_JDI_ENABLED
	select GPIO
	select AMBIQ_HAL
	select AMBIQ_COMPONENT_USE_NEMASDK if SOC_SERIES_APOLLO5X
	help
	  Enable Ambiq JDI (Japan Display Interface) driver.
```

## drivers/memc/Kconfig.ambiq
```kconfig
# Copyright 2024 Ambiq Micro Inc.
# SPDX-License-Identifier: Apache-2.0

config MEMC_AMBIQ_MSPI_APS6404L
	bool "Ambiq MSPI AP Memory APS6404L pSRAM driver"
	default y
	depends on DT_HAS_AMBIQ_MSPI_APS6404L_ENABLED
	select MSPI_AMBIQ_AP3
```

## drivers/mipi_dsi/Kconfig.ambiq
```kconfig
# Copyright (c) 2025, Ambiq Micro Inc. <www.ambiq.com>
# SPDX-License-Identifier: Apache-2.0

config MIPI_DSI_AMBIQ
	bool "AMBIQ APOLLO MIPI-DSI Host Controller"
	default y
	depends on DT_HAS_AMBIQ_APOLLO_MIPI_DSI_ENABLED
	select AMBIQ_HAL_USE_DSI
	help
	  AMBIQ APOLLO MIPI DSI controller driver
```

## drivers/misc/ambiq_pwrctrl/Kconfig
```kconfig
# Copyright (c) 2026 Ambiq Micro Inc.
# SPDX-License-Identifier: Apache-2.0

config AMBIQ_PWRCTRL
	bool "Ambiq shared peripheral power-rail refcount helper"
	default y
	depends on SOC_SERIES_APOLLO5X || SOC_SERIES_APOLLO4X
	depends on AMBIQ_HAL
	help
	  Reference-counted wrapper around am_hal_pwrctrl_periph_enable() /
	  _disable(). Drivers that share a power rail (OTP, CRYPTO, DISP)
	  acquire/release through this helper so the rail is only physically
	  toggled on the 0->1 / 1->0 edges. Required for safe concurrent use
	  of crypto + entropy (OTP) and any combination of the display drivers
	  (DSI/MIPI-DBI/JDI/SPI display controller).

if AMBIQ_PWRCTRL

config AMBIQ_PWRCTRL_HAS_OTP
	bool
	default y if SOC_SERIES_APOLLO5X
	help
	  Set on SoCs whose HAL exposes AM_HAL_PWRCTRL_PERIPH_OTP. The OTP
	  rail is only present on Apollo5X (incl. Apollo330P); Apollo4X
	  HAL headers do not define the symbol so OTP support is compiled
	  out and ambiq_pwrctrl_acquire(AMBIQ_PWRCTRL_OTP) returns -ENOTSUP.

module = AMBIQ_PWRCTRL
module-str = ambiq_pwrctrl
source "subsys/logging/Kconfig.template.log_config"

endif # AMBIQ_PWRCTRL
```

## drivers/mspi/Kconfig
```kconfig
# MSPI driver configuration options

# Copyright (c) 2024 Ambiq Micro Inc.
# SPDX-License-Identifier: Apache-2.0

#
# MSPI Drivers
#
menuconfig MSPI
	bool "Multi-bit Serial Peripheral Interface (MSPI) bus drivers"
	help
	  Enable support for the MSPI hardware bus.

if MSPI

config MSPI_ASYNC
	bool "Asynchronous call support"
	select POLL
	help
	  This option enables the asynchronous API calls.

config MSPI_SLAVE
	bool "Slave support [EXPERIMENTAL]"
	select EXPERIMENTAL
	help
	  Enables Driver MSPI slave operations. Slave support depends
	  on the driver and the hardware it runs on.

config MSPI_INIT_PRIORITY
	int "Init priority"
	default 70
	help
	  Device driver initialization priority.

config MSPI_COMPLETION_TIMEOUT_TOLERANCE
	int "Completion timeout tolerance (ms)"
	default 200
	help
	  The tolerance value in ms for the MSPI completion timeout logic.

module = MSPI
module-str = mspi
source "subsys/logging/Kconfig.template.log_config"

source "drivers/mspi/Kconfig.ambiq"

endif # MSPI
```

## drivers/mspi/Kconfig.ambiq
```kconfig
# Ambiq SDK SPI
#
# Copyright (c) 2023 Antmicro <www.antmicro.com>
#
# SPDX-License-Identifier: Apache-2.0
#

config MSPI_AMBIQ_AP3
	bool "Ambiq Apollo3 series MSPI driver"
	default n
	depends on DT_HAS_AMBIQ_MSPI_CONTROLLER_ENABLED
	select AMBIQ_HAL
	select AMBIQ_HAL_USE_MSPI
	help
	  Enable driver for Ambiq MSPI.

DT_CHOSEN_Z_SRAM := zephyr,sram

config MSPI_BUFF_RAM_LOCATION
	hex "byte offset to SRAM_BASE_ADDRESS"
	default 0x50000
	help
	  This option specifies the mspi buffer/heap start address
```

## drivers/power_domain/Kconfig
```kconfig
# Copyright (c) 2022, CSIRO.
# SPDX-License-Identifier: Apache-2.0

menuconfig POWER_DOMAIN
	bool "Power domain drivers"
	help
	  Include drivers for power domains in system config

if POWER_DOMAIN

module = POWER_DOMAIN
module-str = power_domain
source "subsys/logging/Kconfig.template.log_config"

config POWER_DOMAIN_INIT_PRIORITY
	int "Power domain init priority"
	default 75
	help
	  Power domain initialization priority.

config POWER_DOMAIN_GPIO
	bool "GPIO controlled power domain"
	default y
	depends on DT_HAS_POWER_DOMAIN_GPIO_ENABLED
	depends on GPIO
	depends on PM_DEVICE || !PM_DEVICE_POWER_DOMAIN
	depends on TIMEOUT_64BIT
	select DEVICE_DEPS

if POWER_DOMAIN_GPIO

config POWER_DOMAIN_GPIO_INIT_PRIORITY
	int "GPIO power domain init priority"
	default POWER_DOMAIN_INIT_PRIORITY
	help
	  GPIO power domain initialization priority.

endif #POWER_DOMAIN_GPIO_MONITOR

config POWER_DOMAIN_INTEL_ADSP
	bool "Use Intel ADSP power gating mechanisms"
	default y
	depends on DT_HAS_INTEL_ADSP_POWER_DOMAIN_ENABLED
	select DEVICE_DEPS
	help
	  Include Intel ADSP power domain control mechanisms

if POWER_DOMAIN_INTEL_ADSP

config POWER_DOMAIN_INTEL_ADSP_INIT_PRIORITY
	int "Intel ADSP power domain init priority"
	default KERNEL_INIT_PRIORITY_DEFAULT
	help
	  Intel ADSP power domain initialization priority.

endif #POWER_DOMAIN_INTEL_ADSP

config POWER_DOMAIN_GPIO_MONITOR
	bool "GPIO monitor for sensing power on rail"
	default y
	depends on DT_HAS_POWER_DOMAIN_GPIO_MONITOR_ENABLED
	depends on GPIO
	depends on PM_DEVICE
	select DEVICE_DEPS

if POWER_DOMAIN_GPIO_MONITOR

config POWER_DOMAIN_GPIO_MONITOR_INIT_PRIORITY
	int "GPIO monitor power domain init priority"
	default POWER_DOMAIN_INIT_PRIORITY
	help
	  GPIO monitor power domain initialization priority.

endif #POWER_DOMAIN_GPIO_MONITOR

config POWER_DOMAIN_NXP_SCU
	bool "NXP SCU-managed PD driver"
	default y
	depends on DT_HAS_NXP_SCU_PD_ENABLED
	help
	  Enable support for NXPs SCU-managed power domain driver.

if POWER_DOMAIN_NXP_SCU

config POWER_DOMAIN_NXP_SCU_INIT_PRIORITY
	int "NXP SCU-managed PD driver init priority"
	default 10
	help
	  NXP SCU-managed PD driver initialization priority.

endif #POWER_DOMAIN_NXP_SCU

config POWER_DOMAIN_SOC_PM_STATE
	bool "SoC PM state power domain"
	default y
	depends on DT_HAS_POWER_DOMAIN_SOC_STATE_CHANGE_ENABLED
	select DEVICE_DEPS
	help
	  Generic power domain control to turn on/off devices when the
	  PM subsystem transitions in and out of certain power states.

config POWER_DOMAIN_TISCI
	bool "TISCI managed power domain"
	default y
	depends on DT_HAS_TI_SCI_PM_DOMAIN_ENABLED
	help
	  TISCI managed power domain control to turn on/off devices when the
	  PM subsystem transitions in and out of certain power states.

if POWER_DOMAIN_TISCI

config POWER_DOMAIN_TISCI_INIT_PRIORITY
	int "TISCI managed power domain init priority"
	default 10
	help
	  TISCI managed power domain initialization priority.

config SOC_POWER_DOMAIN_INIT
	bool "Power domain initialization"
	default y
	help
	  Power domain initialization for the SoC.

endif #POWER_DOMAIN_TISCI

rsource "Kconfig.nrfs_gdpwr"
rsource "Kconfig.nrfs_swext"
rsource "Kconfig.silabs_siwx91x"

config POWER_DOMAIN_AMBIQ_OTP
	bool "Ambiq OTP power domain"
	default y
	depends on DT_HAS_AMBIQ_OTP_POWER_DOMAIN_ENABLED
	depends on AMBIQ_HAL
	select DEVICE_DEPS
	help
	  Power domain driver for the Ambiq OTP (INFOC/EFUSE) peripheral rail.
	  Enables and disables the OTP rail via am_hal_pwrctrl_periph_enable/
	  disable(AM_HAL_PWRCTRL_PERIPH_OTP). Intended to be the parent domain
	  of the CRYPTO domain so the framework enables OTP automatically
	  before CRYPTO is brought up.

config POWER_DOMAIN_AMBIQ_CRYPTO
	bool "Ambiq CRYPTO power domain"
	default y
	depends on DT_HAS_AMBIQ_CRYPTO_POWER_DOMAIN_ENABLED
	depends on AMBIQ_HAL
	select DEVICE_DEPS
	help
	  Power domain driver for the Ambiq CRYPTO (CC312) peripheral rail.
	  On RESUME enables CRYPTO via am_hal_pwrctrl_periph_enable; on SUSPEND
	  uses the dedicated am_hal_pwrctrl_control(CRYPTO_POWERDOWN) sequence
	  required by the CC312 engine. Children (AES, TRNG, CRC) acquire the
	  domain via pm_device_runtime_get/put.

config POWER_DOMAIN_AMBIQ_DISP
	bool "Ambiq DISP power domain"
	default y
	depends on DT_HAS_AMBIQ_DISP_POWER_DOMAIN_ENABLED
	depends on AMBIQ_HAL
	select DEVICE_DEPS
	help
	  Power domain driver for the Ambiq DISP peripheral rail shared by
	  MIPI-DSI, MIPI-DBI, JDI, and SPI display controller drivers.

endif
```

## drivers/rtc/Kconfig.ambiq
```kconfig
# SPDX-License-Identifier: Apache-2.0
# Copyright (c) 2023 Linumiz
# Author: Sri Surya  <srisurya@linumiz.com>

config RTC_AMBIQ
	bool "AMBIQ RTC driver"
	default y
	depends on DT_HAS_AMBIQ_RTC_ENABLED
	select AMBIQ_HAL
	select AMBIQ_HAL_USE_RTC
	help
	  Enable the AMBIQ RTC driver.

config RTC_ALARM
	default y if RTC_AMBIQ
```

## drivers/sdhc/Kconfig.sdhc_ambiq
```kconfig
 # Copyright (c) 2024 Ambiq Micro Inc.
 # SPDX-License-Identifier: Apache-2.0

config AMBIQ_SDHC
	bool "Ambiq SDHC driver"
	default y
	depends on DT_HAS_AMBIQ_SDIO_ENABLED
	select AMBIQ_HAL
	select AMBIQ_HAL_USE_SDIO
	select PINCTRL
	select SDHC_SUPPORTS_NATIVE_MODE
	help
	  This option enables the SDHC driver for Ambiq Apollo family.

#if AMBIQ_SDHC
config AMBIQ_SDIO_ASYNC
	bool "Ambiq SDIO Async Mode"
	default y
	depends on DT_HAS_AMBIQ_SDIO_ENABLED
	help
	  This option enables Ambiq SDIO Async Mode.
#endif
```

## drivers/spi/Kconfig.ambiq
```kconfig
# Ambiq SDK SPI
#
# Copyright (c) 2023 Antmicro <www.antmicro.com>
# Copyright (c) 2024 Ambiq Micro Inc. <www.ambiq.com>
#
# SPDX-License-Identifier: Apache-2.0
#

config SPI_AMBIQ
	bool "AMBIQ SPI driver"
	default y
	depends on DT_HAS_AMBIQ_SPI_ENABLED
	select AMBIQ_HAL
	select AMBIQ_HAL_USE_SPI
	help
	  Enable driver for Ambiq SPI.

config MSPI_AMBIQ
	bool "AMBIQ MSPI driver"
	default y
	depends on DT_HAS_AMBIQ_MSPI_ENABLED
	select AMBIQ_HAL
	select AMBIQ_HAL_USE_MSPI
	help
	  Enable driver for Ambiq MSPI.

config SPI_AMBIQ_BLEIF
	bool "AMBIQ SPI-BLEIF driver"
	default y
	depends on DT_HAS_AMBIQ_SPI_BLEIF_ENABLED
	select AMBIQ_HAL
	select AMBIQ_HAL_USE_BLEIF
	help
	  Enable driver for Ambiq Apollox Blue SOC (e.g. Apollo3 Blue)
	  which uses internal designed BLEIF module (different from the
	  general IOM module) for SPI transceiver. It is always used for
	  the HCI communication.
```

## drivers/spi/aps6404l/Kconfig
```kconfig
# APS6404L FLASH

# Copyright (c) 2017 IpTronix S.r.l.
# SPDX-License-Identifier: Apache-2.0

menuconfig APS6404L
	bool "APS6404L FLASH"
	default y
	depends on DT_HAS_APM_APS6404L_ENABLED
	help
	  Enable driver for FLASH
```

## drivers/timer/Kconfig.ambiq
```kconfig
# SPDX-License-Identifier: Apache-2.0
#
# Copyright (c) 2023 Antmicro <www.antmicro.com>

config AMBIQ_STIMER_TIMER
	bool "Ambiq STIMER system clock driver"
	default n
	depends on DT_HAS_AMBIQ_STIMER_ENABLED
	select AMBIQ_HAL
	select TICKLESS_CAPABLE
	select AMBIQ_HAL_USE_STIMER
	help
	  Ambiq Apollo stimer driver

config AMBIQ_CTIMER_TIMER
	bool "Ambiq CTIMER system clock driver"
	default y
	depends on DT_HAS_AMBIQ_CTIMER_ENABLED
	select AMBIQ_HAL
	select TICKLESS_CAPABLE
	select AMBIQ_HAL_USE_CTIMER
	help
	  Ambiq Apollo ctimer driver
```

## dts/bindings/bluetooth/ambiq,bt-hci-spi.yaml
```yaml
# Copyright (c) 2023, Ambiq Micro Inc.
# SPDX-License-Identifier: Apache-2.0

description: |
    Bluetooth module that uses Ambiq's Bluetooth Host Controller Interface SPI
    driver (e.g. Apollo4 Blue Plus).

compatible: "ambiq,bt-hci-spi"

include: [spi-device.yaml, bt-hci.yaml]

properties:
  reg:
    type: array
    required: true

  irq-gpios:
    type: phandle-array
    description: |
      This irq gpio is used to indicate there is packet ready to send to host
      from controller.

  reset-gpios:
    type: phandle-array
    description: |
      This reset gpio is used to reset the Bluetooth controller.

  cm-gpios:
    type: phandle-array
    description: |
      This cm gpio is used to control em9305 enter firmware update mode.  


  bt-hci-name:
    default: "ambiq hci"

  bt-hci-bus:
    default: "spi"

  cm-gpios:
    type: phandle-array
    description: GPIO specifier for configure mode pin.
```

## dts/bindings/crypto/ambiq,crypto-aes.yaml
```yaml
# Copyright (c) 2026, Ambiq Micro, Inc.
# SPDX-License-Identifier: Apache-2.0

description: Ambiq Micro Cryptocell312 AES Accelerator

compatible: "ambiq,crypto-aes"

include: base.yaml

properties:
  reg:
    required: true

  interrupts:
    required: true
```
