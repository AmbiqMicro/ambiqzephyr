/*
 * Copyright (c) 2025, Ambiq Micro Inc. <www.ambiq.com>
 *
 * SPDX-License-Identifier: Apache-2.0
 *
 * apollo510dL_evb: i2c0 on IOM0 already defined; add mikrobus_i2c label
 * and enable.
 */

mikrobus_i2c: &i2c0 {
	status = "okay";
};
