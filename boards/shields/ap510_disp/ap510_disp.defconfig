## subsys/bluetooth/services/Kconfig.amota
```kconfig
#
# Copyright (c) 2023 Ambiq Micro Inc.
#
# SPDX-License-Identifier: Apache-2.0

menuconfig BT_AMOTA
	bool "AMOTA service"
	help
	  Enable Ambiq GATT AMOTA BLE service.

if BT_AMOTA

config BT_AMOTA_IDLE_TIMEOUT
	int "OTA idle timeout in seconds"
	default 60
	range 0 600
	help
	  Maximum time without any AMOTA GATT write while a firmware transfer
	  is in progress (AMOTA_STATE_GETTING_FW). On expiry the device notifies
	  the client with AMOTA_STATUS_TIMEOUT and the current flash offset.
	  Set to 0 to disable.

config BT_AMOTA_PARTIAL_PKT_TIMEOUT
	int "Partial packet reassembly timeout in seconds"
	default 10
	range 0 120
	help
	  Maximum time to wait for remaining chunks of a partially received
	  AMOTA packet. On expiry the partial reassembly buffer is discarded
	  and the client is notified so it can retry the packet. Set to 0 to
	  disable (falls back to the idle timeout when that is enabled).

config BT_AMOTA_IDLE_DISCONNECT
	bool "Disconnect BLE link on OTA idle timeout"
	default y
	depends on BT_AMOTA_IDLE_TIMEOUT > 0
	help
	  When the OTA idle timeout fires, disconnect the BLE link after
	  notifying the client. This helps phone apps that do not handle
	  AMOTA_STATUS_TIMEOUT recover by reconnecting.

module = BT_AMOTA
module-str = amota
source "subsys/logging/Kconfig.template.log_config"

endif # BT_AMOTA
```

## tests/benchmarks/cc312/testcase.yaml
```yaml
# Copyright (c) 2026 Ambiq Micro, Inc.
# SPDX-License-Identifier: Apache-2.0

common:
  harness: console
  harness_config:
    type: one_line
    regex:
      - "Done"
  tags:
    - ambiq
    - crypto
    - benchmark
  platform_allow:
    - apollo510_evb
    - apollo510b_evb
    - apollo510dL_evb
    - apollo330mP_evb
  integration_platforms:
    - apollo510_evb
tests:
  benchmark.crypto.cc312.aes:
    extra_args: DTC_OVERLAY_FILE=aes.overlay
    extra_configs:
      - CONFIG_NOCACHE_MEMORY=y
  benchmark.crypto.cc312.sha:
    extra_args: DTC_OVERLAY_FILE=sha.overlay
    extra_configs:
      - CONFIG_NOCACHE_MEMORY=n
  benchmark.crypto.cc312.chacha:
    extra_args: DTC_OVERLAY_FILE=chacha.overlay
    extra_configs:
      - CONFIG_NOCACHE_MEMORY=n
```
