## drivers/adc/Kconfig.ambiq
```kconfig
# SPDX-License-Identifier: Apache-2.0
#
# Copyright (c) 2023 Ambiq Micro Inc. <www.ambiq.com>

config ADC_AMBIQ
	bool "Ambiq Adc Driver"
	default y
	depends on DT_HAS_AMBIQ_ADC_ENABLED
	select AMBIQ_HAL
	select AMBIQ_HAL_USE_ADC
	select AMBIQ_HAL_USE_TIMER if SOC_SERIES_APOLLO3X
	help
	  Enables the Adc driver for Ambiq devices.

if ADC_AMBIQ

config ADC_AMBIQ_HANDLE_CACHE
	bool "Turn on cache handling in adc driver"
	default y
	depends on CACHE_MANAGEMENT && DCACHE
	help
	  Disable this if cache has been handled in upper layers.

config ADC_AMBIQ_DMA
	bool "Ambiq ADC DMA Support."
	default n
	help
	  Enable the ADC DMA mode for ADC instances
	  that enable dma channels in their device tree node.

if ADC_AMBIQ_DMA

config ADC_AMBIQ_DMA_MIN_SAMPLES
	int "Minimum number of samples to use DMA mode"
	default 64
	range 1 65535
	help
	  When DMA mode is enabled in device tree, the driver will only use DMA
	  if the total number of samples (channels × (1 + extra_samplings)) is
	  greater than or equal to this value. Otherwise, interrupt mode will be
	  used. This allows both DMA and interrupt modes to coexist based on
	  the workload size.

config ADC_AMBIQ_STREAM
	bool "Ambiq ADC RTIO streaming support"
	select ADC_STREAM
	select RTIO
	select RTIO_WORKQ
	select RTIO_SYS_MEM_BLOCKS
	help
	  Enable native RTIO submit and streaming support for the Ambiq ADC.

	  Streaming uses the ADC DMA engine together with the internal repeat
	  trigger timer to continuously sample the configured channels into RTIO
	  memory-pool buffers, which are then decoded through the ADC decoder
	  API. One-shot RTIO reads are serviced on the RTIO work queue.

	  This depends on ADC_AMBIQ_DMA. When disabled, RTIO reads still work
	  through the generic work-queue fallback (CONFIG_ADC_DEFAULT_RTIO), but
	  continuous streaming is not available.

endif # ADC_AMBIQ_DMA

endif # ADC_AMBIQ
```

## drivers/crypto/Kconfig.ambiq
```kconfig
# Copyright (c) 2026 Ambiq Micro, Inc.
# SPDX-License-Identifier: Apache-2.0

config CRYPTO_AMBIQ_AES
	bool "Ambiq CryptoCell AES driver"
	default y
	depends on DT_HAS_AMBIQ_CRYPTO_AES_ENABLED
	select AMBIQ_HAL
	select POWER_DOMAIN
	select AMBIQ_CC312_ARBITER
	help
		Enable the Ambiq CryptoCell-312 AES cipher driver.

		Supported cipher modes:
		- ECB
		- CBC
		- CTR
		- OFB
		- CCM
		- GCM
		- XTS

config CRYPTO_AMBIQ_CHACHA
	bool "Ambiq CryptoCell ChaCha20 driver"
	default y
	depends on DT_HAS_AMBIQ_CRYPTO_CHACHA_ENABLED
	select AMBIQ_HAL
	select POWER_DOMAIN
	select AMBIQ_CC312_ARBITER
	help
		Enable the Ambiq CryptoCell-312 ChaCha20 stream cipher driver.

		Supported cipher modes:
		- ChaCha20 (stream cipher, encrypt/decrypt)

config CRYPTO_AMBIQ_SHA
	bool "Ambiq CryptoCell SHA driver"
	default y
	depends on DT_HAS_AMBIQ_CRYPTO_SHA_ENABLED
	select AMBIQ_HAL
	select POWER_DOMAIN
	select AMBIQ_CC312_ARBITER
	help
		Enable the Ambiq CryptoCell-312 SHA hash driver.

		Supported hash algorithms:
		- SHA-1
		- SHA-224
		- SHA-256

if CRYPTO_AMBIQ_SHA

config CRYPTO_AMBIQ_SHA_MAX_SESSION
	int "Maximum number of simultaneous SHA sessions"
	default 2
	range 1 8
	help
		Number of hash sessions that can be open at once. Each session
		holds its own running digest state, so sessions may be
		interleaved; access to the engine itself is serialised.

endif # CRYPTO_AMBIQ_SHA

config CRYPTO_AMBIQ_HMAC
	bool "Ambiq CryptoCell HMAC driver"
	default y
	depends on DT_HAS_AMBIQ_CRYPTO_HMAC_ENABLED
	select AMBIQ_HAL
	select POWER_DOMAIN
	select AMBIQ_CC312_ARBITER
	help
	  Enable the Ambiq CryptoCell-312 HMAC driver (SHA-1/224/256).

if CRYPTO_AMBIQ_HMAC

config CRYPTO_AMBIQ_HMAC_MAX_SESSION
	int "Maximum number of simultaneous HMAC sessions"
	default 2
	range 1 8

endif # CRYPTO_AMBIQ_HMAC

config CRYPTO_AMBIQ_CMAC
	bool "Ambiq CryptoCell AES-CMAC driver"
	default y
	depends on DT_HAS_AMBIQ_CRYPTO_CMAC_ENABLED
	select AMBIQ_HAL
	select POWER_DOMAIN
	select AMBIQ_CC312_ARBITER
	help
	  Enable the Ambiq CryptoCell-312 AES-CMAC driver.

	  Standalone AES-CBC-MAC is not exposed as a separate Zephyr driver;
	  use AES-CMAC or AES-CCM for message authentication on CC312.

if CRYPTO_AMBIQ_CMAC

config CRYPTO_AMBIQ_CMAC_MAX_SESSION
	int "Maximum number of simultaneous AES-CMAC sessions"
	default 2
	range 1 8

endif # CRYPTO_AMBIQ_CMAC

config CRYPTO_AMBIQ_HKDF
	bool "Ambiq CryptoCell HKDF driver"
	default y
	depends on DT_HAS_AMBIQ_CRYPTO_KDF_ENABLED
	select AMBIQ_HAL
	select POWER_DOMAIN
	select AMBIQ_CC312_ARBITER
	help
	  Enable the Ambiq CryptoCell-312 HKDF driver (SHA-1/224/256).

config CRYPTO_AMBIQ_X25519
	bool "Ambiq CryptoCell X25519 driver"
	default n
	depends on DT_HAS_AMBIQ_CRYPTO_X25519_ENABLED
	select AMBIQ_HAL
	select POWER_DOMAIN
	select AMBIQ_CC312_ARBITER
	help
	  Enable the Ambiq CryptoCell-312 X25519 key agreement driver.

config CRYPTO_AMBIQ_POLY1305
	bool "Ambiq CryptoCell Poly1305 driver"
	default n
	depends on DT_HAS_AMBIQ_CRYPTO_POLY1305_ENABLED
	select AMBIQ_HAL
	select POWER_DOMAIN
	select AMBIQ_CC312_ARBITER
	help
	  Enable the Ambiq CryptoCell-312 Poly1305 authenticator driver.

config CRYPTO_AMBIQ_ED25519
	bool "Ambiq CryptoCell Ed25519 driver"
	default n
	depends on DT_HAS_AMBIQ_CRYPTO_ED25519_ENABLED
	select AMBIQ_HAL
	select POWER_DOMAIN
	select AMBIQ_CC312_ARBITER
	help
	  Enable the Ambiq CryptoCell-312 Ed25519 signature driver.

config CRYPTO_AMBIQ_RSA
	bool "Ambiq CryptoCell RSA driver"
	default n
	depends on DT_HAS_AMBIQ_CRYPTO_RSA_ENABLED
	select AMBIQ_HAL
	select POWER_DOMAIN
	select AMBIQ_CC312_ARBITER
	help
	  Enable the Ambiq CryptoCell-312 RSA modular exponentiation driver.

config CRYPTO_AMBIQ_SRP
	bool "Ambiq CryptoCell SRP-6a driver"
	default n
	depends on DT_HAS_AMBIQ_CRYPTO_SRP_ENABLED
	select AMBIQ_HAL
	select POWER_DOMAIN
	select AMBIQ_CC312_ARBITER
	help
	  Enable the Ambiq CryptoCell-312 SRP-6a key agreement helpers.
```

## drivers/gpu/Kconfig
```kconfig
# GPU drivers

# Copyright (c) 2025 Ambiq Micro Inc.
# SPDX-License-Identifier: Apache-2.0

config GPU
	bool "GPU drivers"
	help
	  Enable GPU drivers

source "drivers/gpu/Kconfig.ambiq"
```

## dts/bindings/crypto/ambiq,crypto-chacha.yaml
```yaml
# Copyright (c) 2026, Ambiq Micro, Inc.
# SPDX-License-Identifier: Apache-2.0

description: Ambiq Micro CryptoCell-312 ChaCha20 Stream Cipher Accelerator

compatible: "ambiq,crypto-chacha"

include: base.yaml

properties:
  reg:
    required: true

  interrupts:
    required: true
```

## dts/bindings/crypto/ambiq,crypto-cmac.yaml
```yaml
# Copyright (c) 2026, Ambiq Micro, Inc.
# SPDX-License-Identifier: Apache-2.0

description: Ambiq Micro Cryptocell312 AES-CMAC

compatible: "ambiq,crypto-cmac"

include: base.yaml

properties:
  reg:
    required: true

  interrupts:
    required: true
```

## dts/bindings/crypto/ambiq,crypto-ed25519.yaml
```yaml
# Copyright (c) 2026, Ambiq Micro, Inc.
# SPDX-License-Identifier: Apache-2.0

description: Ambiq Micro Cryptocell312 Ed25519

compatible: "ambiq,crypto-ed25519"

include: base.yaml

properties:
  reg:
    required: true

  interrupts:
    required: true
```

## dts/bindings/crypto/ambiq,crypto-hmac.yaml
```yaml
# Copyright (c) 2026, Ambiq Micro, Inc.
# SPDX-License-Identifier: Apache-2.0

description: Ambiq Micro Cryptocell312 HMAC

compatible: "ambiq,crypto-hmac"

include: base.yaml

properties:
  reg:
    required: true

  interrupts:
    required: true
```

## dts/bindings/crypto/ambiq,crypto-poly1305.yaml
```yaml
# Copyright (c) 2026, Ambiq Micro, Inc.
# SPDX-License-Identifier: Apache-2.0

description: Ambiq Micro Cryptocell312 Poly1305

compatible: "ambiq,crypto-poly1305"

include: base.yaml

properties:
  reg:
    required: true

  interrupts:
    required: true
```

## dts/bindings/crypto/ambiq,crypto-rsa.yaml
```yaml
# Copyright (c) 2026, Ambiq Micro, Inc.
# SPDX-License-Identifier: Apache-2.0

description: Ambiq Micro Cryptocell312 RSA

compatible: "ambiq,crypto-rsa"

include: base.yaml

properties:
  reg:
    required: true

  interrupts:
    required: true
```

## dts/bindings/crypto/ambiq,crypto-sha.yaml
```yaml
# Copyright (c) 2026, Ambiq Micro, Inc.
# SPDX-License-Identifier: Apache-2.0

description: Ambiq Micro CryptoCell-312 SHA Hash Accelerator

compatible: "ambiq,crypto-sha"

include: base.yaml

properties:
  reg:
    required: true

  interrupts:
    required: true
```

## dts/bindings/crypto/ambiq,crypto-srp.yaml
```yaml
# Copyright (c) 2026, Ambiq Micro, Inc.
# SPDX-License-Identifier: Apache-2.0

description: Ambiq Micro Cryptocell312 SRP

compatible: "ambiq,crypto-srp"

include: base.yaml

properties:
  reg:
    required: true

  interrupts:
    required: true
```

## dts/bindings/crypto/ambiq,crypto-x25519.yaml
```yaml
# Copyright (c) 2026, Ambiq Micro, Inc.
# SPDX-License-Identifier: Apache-2.0

description: Ambiq Micro Cryptocell312 X25519

compatible: "ambiq,crypto-x25519"

include: base.yaml

properties:
  reg:
    required: true

  interrupts:
    required: true
```

## samples/boards/ambiq/cc312_root_kdf/Kconfig
```kconfig
# Copyright (c) 2026 Ambiq Micro, Inc.
# SPDX-License-Identifier: Apache-2.0

mainmenu "Ambiq CC312 root-KDF example"

source "Kconfig.zephyr"

choice CC312_ROOT_KDF_EXAMPLE_KEY_SOURCE
	prompt "CMAC-KDF key source"
	default CC312_ROOT_KDF_EXAMPLE_USE_TEST_KEY

config CC312_ROOT_KDF_EXAMPLE_USE_TEST_KEY
	bool "Software test key (USER_KEY)"
	help
	  Run NIST SP 800-108 CMAC-KDF with a fixed AES test key.
	  Works without a programmed HUK/KDR — use this for everyday
	  bring-up on DM boards.

config CC312_ROOT_KDF_EXAMPLE_USE_HUK
	bool "Device root key (RKEK / HUK)"
	help
	  Call am_hal_cc312_root_kdf_cmac() with the hardware root key.
	  Requires HUK/KDR programmed and usable in the current LCS.

endchoice
```

## samples/boards/ambiq/cc312_root_kdf/sample.yaml
```yaml
# Copyright (c) 2026 Ambiq Micro, Inc.
# SPDX-License-Identifier: Apache-2.0

sample:
  name: Ambiq CC312 root-key (HUK) CMAC-KDF
  description: Derive device-bound KEKs from RKEK/HUK with label and context
common:
  tags:
    - ambiq
    - crypto
    - kdf
  platform_allow:
    - apollo510_evb
    - apollo510b_evb
    - apollo510dL_evb
    - apollo330mP_evb
  harness: console
  harness_config:
    type: one_line
    regex:
      - "All driver checks passed"
tests:
  sample.board.ambiq.cc312_root_kdf:
    tags:
      - ambiq
      - crypto
```

## samples/drivers/i2s/output/boards/apollo510b_evb.conf
```kconfig
# Copyright (c) 2026 Ambiq Micro Inc.
# SPDX-License-Identifier: Apache-2.0

CONFIG_PM_DEVICE_RUNTIME_DISABLE_CONSOLE=n
```

## soc/ambiq/apollo5x/Kconfig
```kconfig
# SPDX-License-Identifier: Apache-2.0
#
# Copyright (c) 2025 Ambiq Micro Inc.

config SOC_SERIES_APOLLO5X
	select ARM
	select CPU_CORTEX_M55
	select CPU_CORTEX_M_HAS_DWT
	select CPU_CORTEX_M_HAS_VTOR
	select CPU_HAS_ARM_SAU
	select CPU_HAS_ARM_MPU
	select CPU_HAS_FPU
	select ARMV8_M_DSP
	select ARMV8_1_M_MVEI
	select ARMV8_1_M_MVEF
	select ARMV8_1_M_PMU
	select HAS_SWO
	select AMBIQ_HAL
	select HAS_PM
	select SOC_EARLY_INIT_HOOK
	select REQUIRES_FULL_LIBC
	select SOC_AMBIQ_HAS_PUF
	select SOC_AMBIQ_HAS_CLKMGR
	select MEM_ATTR if CACHE_MANAGEMENT

config SOC_APOLLO510B
	select SOC_AMBIQ_BT_SUPPORTED

config SOC_APOLLO510B_EM9305_EXTREF_INIT
	bool "Wake SIP EM9305 for EXTREF clock"
	depends on SOC_APOLLO510B
	depends on DT_HAS_AMBIQ_BT_HCI_SPI_ENABLED
	depends on !MCUBOOT
	select GPIO
	select SPI
	select AMBIQ_COMPONENT_USE_BT
	select AMBIQ_HAL_USE_TIMER
	help
	  Wake the SIP EM9305 over SPI and enable sleep so CLKMGR can use EXTREF
	  (~12 MHz). Uses ambiq,bt-hci-spi in devicetree; CONFIG_BT is not
	  required.

config SOC_APOLLO510B_EM9305_EXTREF_INIT_PRIORITY
	int "Apollo510B EM9305 EXTREF clock init priority"
	default 51
	depends on SOC_APOLLO510B_EM9305_EXTREF_INIT

config SOC_APOLLO510L
	select SOC_AMBIQ_BT_SUPPORTED
	select SOC_AMBIQ_HAS_CRM
	select SOC_AMBIQ_HAS_RSS

config SOC_APOLLO330P
	select SOC_AMBIQ_BT_SUPPORTED
	select SOC_AMBIQ_HAS_CRM
	select SOC_AMBIQ_HAS_RSS

config SOC_AMBIQ_APOLLO5X_BLE_LP
	bool "Apollo5x BLE low-power early SoC configuration"
	depends on SOC_APOLLO330P || SOC_APOLLO510L || SOC_APOLLO510B
	help
	  Apply a low-power SoC profile during early boot for BLE applications that
	  use tickless idle and system PM. This configures LFRC for RTC, powers down
	  the crystal in deep sleep, clears DBGCTRL, gates unused peripherals, sets
	  DTCM128K with ROM auto and MRAM low-power bits, and disables I/D cache with
	  CPDLP and cache power-down.

	  Apollo330P / Apollo510L (integrated radio):
	  IOSFD0 through NETAOL-1 are gated while NETAOL (RSS) stays powered; 0.75 MiB
	  SSRAM is retained in deep sleep.

	  Apollo510B (SIP EM9305 over SPI):
	  ITCM32K / DTCM128K and NVM0 only; selective peripheral gating keeps IOM6
	  for the HCI SPI link. After bt_enable(), applications may call
	  ambiq_apollo510b_ble_lp_runtime_init() to gate remaining blocks and power
	  down CRYPTO/OTP (do not use DIS_PERIPHS_ALL once the Zephyr SPI driver has
	  initialized IOM6). SSRAM 2 MiB retain is the default; optional DTCM-only
	  mapping is available via SOC_AMBIQ_APOLLO510B_BLE_LP_SRAM_NONE.

	  Intended for BLE samples with PM enabled; disable for throughput-oriented
	  builds.

config SOC_AMBIQ_APOLLO510B_BLE_LP_SRAM_NONE
	bool "Apollo510B BLE LP: DTCM-only RAM (no SSRAM retain)"
	depends on SOC_AMBIQ_APOLLO5X_BLE_LP && SOC_APOLLO510B
	default n
	help
	  Map application RAM to 128 KiB DTCM and power off all SSRAM banks in deep
	  sleep. Requires a devicetree overlay that sets chosen zephyr,sram = &dtcm
	  and a trimmed application configuration (see
	  samples/bluetooth/peripheral_hr/prj_apollo510b_ble_lp.conf).

	  Disabled by default: the Zephyr Bluetooth stack on apollo510b_evb does not
	  boot reliably with DTCM-only RAM without further memory tuning. Enable only
	  after validating the overlay and Kconfig on target hardware.

if SOC_SERIES_APOLLO5X

config SOC_AMBIQ_RSS_MGR
	bool "Radio subsystem manager functions"
	default y
	depends on SOC_AMBIQ_HAS_RSS
	depends on DT_HAS_VND_MBOX_CONSUMER_ENABLED || DT_HAS_AMBIQ_MBOX_IPC_ENABLED || DT_HAS_AMBIQ_USB_ENABLED
	select NET_BUF
	select MBOX
	help
	  This option includes the radio subsystem manager functions for Apollo510L.

config SOC_AMBIQ_DEEPER_SLEEP_RECOVERY
	bool "Recovery window for the deeper sleep state"
	depends on PM && (SOC_APOLLO510L || SOC_APOLLO330P)
	select GPIO
	help
	  Apollo330P and Apollo510L map suspend-to-disk onto the Ambiq deeper
	  sleep state, which retains only NVM. A part that has entered it cannot
	  be halted, so a board that idles early in boot can only be reflashed by
	  racing its first idle, which is unreliable.

	  Sample a recovery pin during initialisation and, while it is asserted
	  through reset, block the state for a fixed window so a debugger can
	  attach and erase.

	  The pin is the pm-recovery alias if the board defines one, otherwise sw0.
	  Either may name any node carrying a gpios property, and the devicetree
	  flags decide whether asserted means low or high, so a board is free to
	  use a jumper or test point rather than a button. A board with neither
	  alias has no trigger and is unaffected.
	  Apollo510 does not offer the state at all.

	  Off by default. Recovering a board is a developer action, so nothing
	  samples a pin at boot unless a build asks for it. Enable it in the
	  configuration of a test or application that can strand a part.

config SOC_AMBIQ_DEEPER_SLEEP_BOOT_WINDOW_MS
	int "Recovery window when the recovery pin is held at boot, in ms"
	depends on SOC_AMBIQ_DEEPER_SLEEP_RECOVERY
	default 10000
	help
	  How long SOC_AMBIQ_DEEPER_SLEEP_RECOVERY blocks suspend-to-disk when it
	  finds the recovery pin asserted at boot. The window has to outlast a
	  debugger connecting and starting an erase.

config ARMV8_1_M_PMU_EVENTCNT
	int
	default 8

endif

config AMBIQ_CC312_ARBITER
	bool
```
