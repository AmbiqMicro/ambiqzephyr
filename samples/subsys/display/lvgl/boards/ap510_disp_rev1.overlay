/*
* Copyright (c) 2025 Ambiq Inc.
*
* SPDX-License-Identifier: Apache-2.0
*/

#include <apollo510/ambiq-apollo510-pinmux.h>
#include <zephyr/dt-bindings/mipi_dsi/mipi_dsi.h>
#include <zephyr/dt-bindings/display/panel.h>

/ {
	chosen {
		zephyr,display = &rm69330;
	};
};

&mipi_dsi {
	pix-fmt = <MIPI_DSI_PIXFMT_RGB565>;
	rm69330: rm69330@0 {
		pixel-format = <PANEL_PIXEL_FORMAT_RGB_565>;
	};
};

