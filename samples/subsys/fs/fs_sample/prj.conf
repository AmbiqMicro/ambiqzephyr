## sample.yaml
```
sample:
  name: Filesystems sample
common:
  tags: filesystem
  modules:
    - fatfs
tests:
  sample.filesystem.fat_fs:
    depends_on: sdhc
    harness: console
    harness_config:
      fixture: fixture_sdhc
  sample.filesystem.fat_fs.overlay:
    platform_allow: nrf52840_blip
  sample.filesystem.fat_fs.adafruit_2_8_tft_touch_v2:
    depends_on:
      - arduino_spi
      - arduino_gpio
      - arduino_i2c
    platform_exclude:
      - stm32f769i_disco
      - pan1781_evb
      - pan1782_evb
      - frdm_k64f
      - mimxrt1010_evk
    extra_args: SHIELD=adafruit_2_8_tft_touch_v2
    tags: shield
    harness: console
    harness_config:
      fixture: fixture_shield_adafruit_2_8_tft_touch_v2
  sample.filesystem.fat_fs.nrf52840dk_nrf52840:
    build_only: true
    platform_allow: nrf52840dk_nrf52840
  sample.filesystem.fat_fs.nrf52840dk_nrf52840.qspi:
    build_only: true
    platform_allow: nrf52840dk_nrf52840
    extra_args:
      - OVERLAY_CONFIG=boards/nrf52840dk_nrf52840_qspi.conf
      - DTC_OVERLAY_FILE=boards/nrf52840dk_nrf52840_qspi.overlay
  sample.filesystem.fat_fs.has_sdmmc_disk:
    build_only: true
    filter: dt_compat_enabled("zephyr,sdmmc-disk")
    integration_platforms:
      - frdm_k64f
  sample.filesystem.ext2:
    simulation_exclude:
      - renode
    extra_args: CONF_FILE="prj_ext.conf"
    platform_allow: hifive_unmatched bl5340_dvk_cpuapp
  sample.filesystem.fat_fs.stm32h747i_disco_m7_sdmmc:
    build_only: true
    platform_allow: stm32h747i_disco_m7
    extra_args:
      - OVERLAY_CONFIG=boards/stm32h747i_disco_m7.conf
  sample.filesystem.fat_fs.apollo5_eb_sdmmc:
    build_only: true
    platform_allow: apollo5_eb
    extra_args:
      - OVERLAY_CONFIG=boards/apollo5_eb.conf
```

## prj.conf
```kconfig
CONFIG_DISK_ACCESS=y
CONFIG_LOG=y
CONFIG_FILE_SYSTEM=y
CONFIG_FAT_FILESYSTEM_ELM=y
CONFIG_PRINTK=y
# CONFIG_MAIN_STACK_SIZE=2048

CONFIG_NO_OPTIMIZATIONS=y
CONFIG_LOG=y
CONFIG_LOG_OUTPUT_FORMAT_LINUX_TIMESTAMP=y
CONFIG_LOG_MODE_IMMEDIATE=y
#CONFIG_LOG_MODE_DEFERRED=y
#CONFIG_LOG_MODE_OVERFLOW=y
CONFIG_LOG_DEFAULT_LEVEL=0

CONFIG_LOG_BACKEND_AMBIQ_SWO=y
CONFIG_LOG_BACKEND_AMBIQ_SWO_FREQ_HZ=1000000
#CONFIG_LOG_PROCESS_THREAD=y

CONFIG_MAIN_STACK_SIZE=4096
```

## boards/apollo4p_evb.conf
```kconfig
CONFIG_DISK_DRIVER_MMC=y
CONFIG_MMC_STACK=y
CONFIG_SDHC=y
CONFIG_MMC_SUBSYS=y

CONFIG_MAIN_STACK_SIZE=8192
CONFIG_IDLE_STACK_SIZE=4096
CONFIG_AMBIQ_SDIO_ASYNC=y
CONFIG_PM=y
CONFIG_PM_DEVICE=y
CONFIG_PM_DEVICE_RUNTIME=y
CONFIG_MMC_CARD_8BIT_WIDTH=y
```

## boards/apollo510dL_evb.conf
```kconfig
# Copyright (c) 2026 Ambiq Micro Inc. <www.ambiq.com>
# SPDX-License-Identifier: Apache-2.0

CONFIG_MMC_STACK=y

CONFIG_MAIN_STACK_SIZE=8192
CONFIG_IDLE_STACK_SIZE=4096
CONFIG_AMBIQ_SDIO_ASYNC=y
```

## boards/apollo5_eb.conf
```kconfig
CONFIG_DISK_DRIVER_SDMMC=y
CONFIG_MMC_STACK=y
CONFIG_SDMMC_STACK=n
CONFIG_SDHC=y
CONFIG_SDMMC_SUBSYS=y
CONFIG_CONSOLE=n
CONFIG_UART_CONSOLE=n
CONFIG_SERIAL=n
CONFIG_UART_INTERRUPT_DRIVEN=n

CONFIG_NO_OPTIMIZATIONS=y
CONFIG_LOG=y
CONFIG_LOG_OUTPUT_FORMAT_LINUX_TIMESTAMP=y
CONFIG_LOG_MODE_IMMEDIATE=y
#CONFIG_LOG_MODE_DEFERRED=y
#CONFIG_LOG_MODE_OVERFLOW=y
CONFIG_LOG_DEFAULT_LEVEL=0

CONFIG_LOG_BACKEND_AMBIQ_SWO=y
CONFIG_LOG_BACKEND_AMBIQ_SWO_FREQ_HZ=1000000
#CONFIG_LOG_PROCESS_THREAD=y

CONFIG_MAIN_STACK_SIZE=20480
```

## src/main.c
```c
/*
 * Copyright (c) 2019 Tavish Naruka <tavishnaruka@gmail.com>
 * Copyright (c) 2023 Nordic Semiconductor ASA
 * Copyright (c) 2023 Antmicro <www.antmicro.com>
 *
 * SPDX-License-Identifier: Apache-2.0
 */

/* Sample which uses the filesystem API and SDHC driver */

#include <zephyr/kernel.h>
#include <zephyr/device.h>
#include <zephyr/storage/disk_access.h>
#include <zephyr/logging/log.h>
#include <zephyr/fs/fs.h>

#if defined(CONFIG_FAT_FILESYSTEM_ELM)

#include <ff.h>

/*
 *  Note the fatfs library is able to mount only strings inside _VOLUME_STRS
 *  in ffconf.h
 */
#define DISK_DRIVE_NAME "SD"
#define DISK_MOUNT_PT "/"DISK_DRIVE_NAME":"

static FATFS fat_fs;
/* mounting info */
static struct fs_mount_t mp = {
	.type = FS_FATFS,
	.fs_data = &fat_fs,
};

#elif defined(CONFIG_FILE_SYSTEM_EXT2)

#include <zephyr/fs/ext2.h>

#define DISK_DRIVE_NAME "SDMMC"
#define DISK_MOUNT_PT "/ext"

static struct fs_mount_t mp = {
	.type = FS_EXT2,
	.flags = FS_MOUNT_FLAG_NO_FORMAT,
	.storage_dev = (void *)DISK_DRIVE_NAME,
	.mnt_point = "/ext",
};

#endif

LOG_MODULE_REGISTER(main, LOG_LEVEL_DBG);

#define MAX_PATH 128
#define SOME_FILE_NAME "some.dat"
#define SOME_DIR_NAME "some"
#define SOME_REQUIRED_LEN MAX(sizeof(SOME_FILE_NAME), sizeof(SOME_DIR_NAME))

static void check_if_rwbuf_match(uint8_t *rdbuf, uint8_t *wrbuf, uint32_t len);
static int file_write_read(void);
static int lsdir(const char *path);
#ifdef CONFIG_FS_SAMPLE_CREATE_SOME_ENTRIES
static bool create_some_entries(const char *base_path)
{
	char path[MAX_PATH];
	struct fs_file_t file;
	int base = strlen(base_path);

	fs_file_t_init(&file);

	if (base >= (sizeof(path) - SOME_REQUIRED_LEN)) {
		LOG_ERR("Not enough concatenation buffer to create file paths");
		return false;
	}

	LOG_INF("Creating some dir entries in %s", base_path);
	strncpy(path, base_path, sizeof(path));

	path[base++] = '/';
	path[base] = 0;
	strcat(&path[base], SOME_FILE_NAME);

	if (fs_open(&file, path, FS_O_CREATE) != 0) {
		LOG_ERR("Failed to create file %s", path);
		return false;
	}
	fs_close(&file);

	path[base] = 0;
	strcat(&path[base], SOME_DIR_NAME);

	if (fs_mkdir(path) != 0) {
		LOG_ERR("Failed to create dir %s", path);
		/* If code gets here, it has at least successes to create the
		 * file so allow function to return true.
		 */
	}
	return true;
}
#endif

static const char *disk_mount_pt = DISK_MOUNT_PT;

int main(void)
{
	LOG_DBG("Ambiq SDIO FatFs Example! %s\n", CONFIG_BOARD);
	/* raw disk i/o */
	do {
		static const char *disk_pdrv = DISK_DRIVE_NAME;
		uint64_t memory_size_mb;
		uint32_t block_count;
		uint32_t block_size;

		if (disk_access_init(disk_pdrv) != 0) {
			LOG_ERR("Storage init ERROR!");
			break;
		}

		if (disk_access_ioctl(disk_pdrv,
				DISK_IOCTL_GET_SECTOR_COUNT, &block_count)) {
			LOG_ERR("Unable to get sector count");
			break;
		}
		LOG_INF("Block count %u", block_count);

		if (disk_access_ioctl(disk_pdrv,
				DISK_IOCTL_GET_SECTOR_SIZE, &block_size)) {
			LOG_ERR("Unable to get sector size");
			break;
		}
		printk("Sector size %u\n", block_size);

		memory_size_mb = (uint64_t)block_count * block_size;
		printk("Memory Size(MB) %u\n", (uint32_t)(memory_size_mb >> 20));
	} while (0);

	mp.mnt_point = disk_mount_pt;

	int res = fs_mount(&mp);

#if defined(CONFIG_FAT_FILESYSTEM_ELM)
	if (res == FR_OK) {
#else
	if (res == 0) {
#endif
		printk("Disk mounted.\n");

		if (file_write_read() != 0)
		{
			printk("File write read test failed.\n");
		}

		if (lsdir(disk_mount_pt) == 0) {
#ifdef CONFIG_FS_SAMPLE_CREATE_SOME_ENTRIES
			if (create_some_entries(disk_mount_pt)) {
				lsdir(disk_mount_pt);
			}
#endif
		}
	} else {
		printk("Error mounting disk.\n");
	}

	fs_unmount(&mp);

	printk(" Ambiq SDIO FatFs Example Complete!\n");

	while (1) {
		k_sleep(K_MSEC(1000));
	}
	return 0;
}

/* List dir entry by path
 *
 * @param path Absolute path to list
 *
 * @return Negative errno code on error, number of listed entries on
 *         success.
 */
static int lsdir(const char *path)
{
	int res;
	struct fs_dir_t dirp;
	static struct fs_dirent entry;
	int count = 0;

	fs_dir_t_init(&dirp);

	/* Verify fs_opendir() */
	res = fs_opendir(&dirp, path);
	if (res) {
		printk("Error opening dir %s [%d]\n", path, res);
		return res;
	}

	printk("\nListing dir %s ...\n", path);
	for (;;) {
		/* Verify fs_readdir() */
		res = fs_readdir(&dirp, &entry);

		/* entry.name[0] == 0 means end-of-dir */
		if (res || entry.name[0] == 0) {
			break;
		}

		if (entry.type == FS_DIR_ENTRY_DIR) {
			printk("[DIR ] %s\n", entry.name);
		} else {
			printk("[FILE] %s (size = %zu)\n",
				entry.name, entry.size);
		}
		count++;
	}

	/* Verify fs_closedir() */
	fs_closedir(&dirp);
	if (res == 0) {
		res = count;
	}

	return res;
}

static int file_write_read(void)
{
	uint8_t read_buf[256]; /* buffer for file read */
	uint8_t write_buf[256] = "This is the content insided the TXT\nApollo5 eMMC File System Example!!!\n"; /* buffer for file write */
	FRESULT res;      /* File function return code */
	struct fs_file_t fp;

	printk("Test File write and read\n");

    res = fs_open(&fp, DISK_MOUNT_PT"/FatFs.TXT", FS_O_CREATE | FS_O_RDWR);
    if ( res == 0 )
    {
        printk("File FatFs.TXT is opened for write\n");
        res = fs_write(&fp, write_buf, sizeof(write_buf));
        if (res != 0 )
        {
            printk("File Write Error!\n");
        }
        else
        {
            res = fs_close(&fp); //close the file to flush data into device
            if ( res == 0 )
            {
                printk("File is closed\n");
            }
            else
            {
                printk("Fail to close file\n");
            }
            res = fs_open(&fp, DISK_MOUNT_PT"/FatFs.TXT", FS_O_READ);
            if ( res == 0 )
            {
                printk("File FatFs.TXT is opened for read\n");
                res = fs_read(&fp, read_buf, sizeof(read_buf));
                if ( res != 0 )
                {
                    printk("File Read Error!\n");
                }
                else
                {
                    res = fs_close(&fp);
                    if ( res != 0 )
                    {
                        printk("Fail to close file\n");
                    }
                    //
                    // Check whether read data match with write data.
                    //
                    check_if_rwbuf_match(read_buf, write_buf, sizeof(write_buf));
                }
            }
            else
            {
                printk("Fail to open file for read\n");
            }
        }
    }

	return res;
}

static void check_if_rwbuf_match(uint8_t *rdbuf, uint8_t *wrbuf, uint32_t len)
{
    int i;
    for ( i = 0; i < len; i++ )
    {
        if (*(wrbuf + i) != *(rdbuf + i) )
        {
            printk("Test Fail: read and write buffer does not match from %d\n", i);
            break;
        }
    }

    if (i == len)
    {
        printk("\nFile read write data matched!\n");
    }
}
```
