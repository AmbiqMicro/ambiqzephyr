## Kconfig
```
# Copyright (c) 2019-2020 Nordic Semiconductor ASA
# SPDX-License-Identifier: Apache-2.0

menu "MSC sample options"

config APP_WIPE_STORAGE
	bool "Option to clear the flash area before mounting"
	help
	  Use this to force an existing file system to be created.

choice
	prompt "Storage and file system type used by the application"
	default APP_MSC_STORAGE_NONE
	help
	  Specify the type of storage and file system.

config APP_MSC_STORAGE_NONE
	bool "Use RAM disk as block device"

config APP_MSC_STORAGE_RAM
	bool "Use RAM disk and FAT file system"
	imply FILE_SYSTEM
	imply FAT_FILESYSTEM_ELM

config APP_MSC_STORAGE_FLASH_FATFS
	bool "Use FLASH disk and FAT file system"
	imply DISK_DRIVER_FLASH
	imply FILE_SYSTEM
	imply FAT_FILESYSTEM_ELM

config APP_MSC_STORAGE_FLASH_LITTLEFS
	bool "Use FLASH disk and LittleFS"
	imply DISK_DRIVER_FLASH
	imply FILE_SYSTEM
	imply FILE_SYSTEM_LITTLEFS

config APP_MSC_STORAGE_SDCARD
	bool "Use SDHC and FAT file system"
	imply DISK_DRIVER_SDMMC
	imply FILE_SYSTEM
	imply FAT_FILESYSTEM_ELM

config APP_MSC_STORAGE_EMMC
	bool "Use eMMC and FAT file system"
	imply DISK_DRIVER_MMC
	imply FILE_SYSTEM
	imply FAT_FILESYSTEM_ELM

endchoice

config MASS_STORAGE_DISK_NAME
	default "NAND" if DISK_DRIVER_FLASH
	default "RAM" if DISK_DRIVER_RAM
	default "SD" if DISK_DRIVER_SDMMC
	default "eMMC" if DISK_DRIVER_MMC

if DISK_DRIVER_FLASH

config FLASH_MAP
	default y

config FLASH_PAGE_LAYOUT
	default y

config FLASH_LOG_LEVEL
	default 3

if NORDIC_QSPI_NOR

config NORDIC_QSPI_NOR_FLASH_LAYOUT_PAGE_SIZE
	default 4096

endif # NORDIC_QSPI_NOR

endif # DISK_DRIVER_FLASH

endmenu

# Source common USB sample options used to initialize new experimental USB
# device stack. The scope of these options is limited to USB samples in project
# tree, you cannot use them in your own application.
source "samples/subsys/usb/common/Kconfig.sample_usbd"

source "Kconfig.zephyr"
```

## sample.yaml
```
sample:
  name: Mass Storage
tests:
  sample.usbd.mass_ram_none:
    min_ram: 128
    depends_on: usbd
    integration_platforms:
      - nrf52840dk/nrf52840
      - nrf54h20dk/nrf54h20/cpuapp
      - frdm_k64f
      - stm32f723e_disco
      - nucleo_f413zh
      - mimxrt685_evk/mimxrt685s/cm33
      - mimxrt1060_evk/mimxrt1062/qspi
      - max32690evkit/max32690/m4
    extra_args:
      - EXTRA_DTC_OVERLAY_FILE="ramdisk.overlay"
    tags:
      - usb
    harness: console
    harness_config:
      type: multi_line
      ordered: true
      regex:
        - "No file system selected"
        - "The device is put in USB mass storage mode"
  sample.usbd.mass_ram_fat:
    min_ram: 128
    depends_on: usbd
    integration_platforms:
      - nrf52840dk/nrf52840
      - nrf54h20dk/nrf54h20/cpuapp
      - frdm_k64f
      - stm32f723e_disco
      - nucleo_f413zh
      - mimxrt685_evk/mimxrt685s/cm33
      - mimxrt1060_evk/mimxrt1062/qspi
    extra_args:
      - EXTRA_DTC_OVERLAY_FILE="ramdisk.overlay"
    extra_configs:
      - CONFIG_APP_MSC_STORAGE_RAM=y
    tags:
      - usb
    harness: console
    harness_config:
      type: multi_line
      ordered: true
      regex:
        - "End of files"
        - "The device is put in USB mass storage mode"
  sample.usbd.mass_flash_fatfs:
    min_ram: 32
    modules:
      - fatfs
    depends_on: usbd
    filter: dt_compat_enabled("nordic,qspi-nor")
    platform_allow:
      - nrf52840dk/nrf52840
      - nrf5340dk/nrf5340/cpuapp
      - adafruit_feather_nrf52840/nrf52840/sense
    integration_platforms:
      - nrf52840dk/nrf52840
    extra_configs:
      - CONFIG_APP_MSC_STORAGE_FLASH_FATFS=y
    tags:
      - usb
    harness: console
    harness_config:
      type: multi_line
      ordered: true
      regex:
        - "End of files"
        - "The device is put in USB mass storage mode"
  sample.usbd.mass_sdhc_fatfs:
    min_ram: 32
    filter: dt_compat_enabled("zephyr,sdmmc-disk")
    modules:
      - fatfs
    depends_on:
      - usbd
      - sdhc
    extra_configs:
      - CONFIG_APP_MSC_STORAGE_SDCARD=y
    tags:
      - usb
    harness: console
    harness_config:
      fixture: fixture_sdcard
      type: multi_line
      ordered: true
      regex:
        - "End of files"
        - "The device is put in USB mass storage mode"
  sample.usbd.mass_flash_littlefs:
    modules:
      - littlefs
    min_ram: 32
    depends_on: usbd
    filter: dt_compat_enabled("nordic,qspi-nor")
    platform_allow:
      - nrf52840dk/nrf52840
      - nrf5340dk/nrf5340/cpuapp
      - adafruit_feather_nrf52840/nrf52840/sense
    integration_platforms:
      - nrf52840dk/nrf52840
    extra_configs:
      - CONFIG_APP_MSC_STORAGE_FLASH_LITTLEFS=y
    tags:
      - usb
    harness: console
    harness_config:
      type: multi_line
      ordered: true
      regex:
        - "End of files"
        - "The device is put in USB mass storage mode"
  sample.usb_device_next.mass_emmc_fatfs:
    min_ram: 32
    filter: dt_compat_enabled("zephyr,mmc-disk")
    platform_allow:
      - apollo4p_evb
      - apollo510_evb
    modules:
      - fatfs
    depends_on:
      - usbd
      - sdhc
    extra_configs:
      - CONFIG_APP_MSC_STORAGE_EMMC=y
    tags:
      - usb
    harness: console
    harness_config:
      fixture: fixture_sdcard
      type: multi_line
      ordered: true
      regex:
        - "End of files"
        - "The device is put in USB mass storage mode."
```

## prj.conf
```kconfig
CONFIG_USB_DEVICE_STACK_NEXT=y
CONFIG_CDC_ACM_SERIAL_INITIALIZE_AT_BOOT=n

CONFIG_STDOUT_CONSOLE=y
CONFIG_SERIAL=y
CONFIG_UART_LINE_CTRL=y
CONFIG_USBD_MSC_CLASS=y
CONFIG_USBD_MSC_LUNS_PER_INSTANCE=3

# Enlarge the UDC request pool so large control transfers (e.g. a Windows
# host's ~4 KB descriptor/MS-OS probe on EP0) can be allocated; the 1024-byte
# default is too small and causes "Failed to allocate net_buf" on ep 0x80.
CONFIG_UDC_BUF_POOL_SIZE=8192

CONFIG_LOG=y
CONFIG_USBD_LOG_LEVEL_WRN=y
CONFIG_UDC_DRIVER_LOG_LEVEL_WRN=y

CONFIG_SAMPLE_USBD_PID=0x0008
CONFIG_SAMPLE_USBD_PRODUCT="USBD MSC sample"
CONFIG_MAIN_STACK_SIZE=2048
```

## boards/apollo510_eb.conf
```kconfig
# Copyright (c) 2025 Ambiq Micro Inc. <www.ambiq.com>
# SPDX-License-Identifier: Apache-2.0
CONFIG_MMC_DDR50=y
CONFIG_MMC_CARD_8BIT_WIDTH=y
CONFIG_APP_MSC_STORAGE_EMMC=y
```

## boards/apollo510b_evb.conf
```kconfig
# Copyright (c) 2025 Ambiq Micro Inc. <www.ambiq.com>
# SPDX-License-Identifier: Apache-2.0
CONFIG_MMC_DDR50=y
CONFIG_MMC_CARD_8BIT_WIDTH=y
CONFIG_APP_MSC_STORAGE_EMMC=y
CONFIG_UDC_BUF_POOL_SIZE=16384
CONFIG_UDC_AMBIQ_DMA1_MODE=y
```

## boards/apollo510dL_evb.conf
```kconfig
# Copyright (c) 2026 Ambiq Micro Inc. <www.ambiq.com>
# SPDX-License-Identifier: Apache-2.0
CONFIG_MMC_DDR50=y
CONFIG_MMC_CARD_8BIT_WIDTH=y
CONFIG_APP_MSC_STORAGE_EMMC=y
```

## boards/apollo330mP_evb.overlay
```dts
/*
 * Copyright (c) 2026, Ambiq Micro Inc. <www.ambiq.com>
 *
 * SPDX-License-Identifier: Apache-2.0
 */

&sdio0 {
	status = "okay";

	mmc {
		status = "okay";
	};
};
```

## boards/apollo510_evb.overlay
```dts
&sdio0 {
	status = "okay";
	mmc {
		status = "okay";
	};
};
```

## boards/apollo510b_evb.overlay
```dts
/*
 * Copyright (c) 2025, Ambiq Micro Inc. <www.ambiq.com>
 *
 * SPDX-License-Identifier: Apache-2.0
 */

&sdio0 {
	status = "okay";

	mmc {
		status = "okay";
	};
};
```

## src/main.c
```c
/*
 * Copyright (c) 2016 Intel Corporation.
 * Copyright (c) 2019-2020 Nordic Semiconductor ASA
 *
 * SPDX-License-Identifier: Apache-2.0
 */

#include <sample_usbd.h>

#include <zephyr/kernel.h>
#include <zephyr/logging/log.h>
#include <zephyr/usb/usb_device.h>
#include <zephyr/usb/usbd.h>
#include <zephyr/usb/class/usbd_msc.h>
#include <zephyr/fs/fs.h>
#include <stdio.h>

LOG_MODULE_REGISTER(main);

#if CONFIG_DISK_DRIVER_FLASH
#include <zephyr/storage/flash_map.h>
#endif

#if CONFIG_FAT_FILESYSTEM_ELM
#include <ff.h>
#endif

#if CONFIG_FILE_SYSTEM_LITTLEFS
#include <zephyr/fs/littlefs.h>
FS_LITTLEFS_DECLARE_DEFAULT_CONFIG(storage);
#endif

#if !defined(CONFIG_DISK_DRIVER_FLASH) && \
	!defined(CONFIG_DISK_DRIVER_RAM) && \
	!defined(CONFIG_DISK_DRIVER_MMC) && \
	!defined(CONFIG_DISK_DRIVER_SDMMC)
#error No supported disk driver enabled
#endif

#define STORAGE_PARTITION		storage_partition
#define STORAGE_PARTITION_ID		FIXED_PARTITION_ID(STORAGE_PARTITION)

static struct fs_mount_t fs_mnt;

#if defined(CONFIG_USB_DEVICE_STACK_NEXT)
static struct usbd_context *sample_usbd;

#if CONFIG_DISK_DRIVER_RAM
USBD_DEFINE_MSC_LUN(ram, "RAM", "Zephyr", "RAMDisk", "0.00");
#endif

#if CONFIG_DISK_DRIVER_FLASH
USBD_DEFINE_MSC_LUN(nand, "NAND", "Zephyr", "FlashDisk", "0.00");
#endif

#if CONFIG_DISK_DRIVER_SDMMC
USBD_DEFINE_MSC_LUN(sd, "SD", "Zephyr", "SD", "0.00");
#endif

#if CONFIG_DISK_DRIVER_MMC
USBD_DEFINE_MSC_LUN(emmc, "eMMC", "Zephyr", "eMMC", "0.00");
#endif

static int enable_usb_device_next(void)
{
	int err;

	sample_usbd = sample_usbd_init_device(NULL);
	if (sample_usbd == NULL) {
		LOG_ERR("Failed to initialize USB device");
		return -ENODEV;
	}

	err = usbd_enable(sample_usbd);
	if (err) {
		LOG_ERR("Failed to enable device support");
		return err;
	}

	LOG_DBG("USB device support enabled");

	return 0;
}
#endif /* defined(CONFIG_USB_DEVICE_STACK_NEXT) */

static int setup_flash(struct fs_mount_t *mnt)
{
	int rc = 0;
#if CONFIG_DISK_DRIVER_FLASH
	unsigned int id;
	const struct flash_area *pfa;

	mnt->storage_dev = (void *)STORAGE_PARTITION_ID;
	id = STORAGE_PARTITION_ID;

	rc = flash_area_open(id, &pfa);
	printk("Area %u at 0x%x on %s for %u bytes\n",
	       id, (unsigned int)pfa->fa_off, pfa->fa_dev->name,
	       (unsigned int)pfa->fa_size);

	if (rc < 0 && IS_ENABLED(CONFIG_APP_WIPE_STORAGE)) {
		printk("Erasing flash area ... ");
		rc = flash_area_flatten(pfa, 0, pfa->fa_size);
		printk("%d\n", rc);
	}

	if (rc < 0) {
		flash_area_close(pfa);
	}
#endif
	return rc;
}

static int mount_app_fs(struct fs_mount_t *mnt)
{
	int rc;

#if CONFIG_FAT_FILESYSTEM_ELM
	static FATFS fat_fs;

	mnt->type = FS_FATFS;
	mnt->fs_data = &fat_fs;
	if (IS_ENABLED(CONFIG_DISK_DRIVER_RAM)) {
		mnt->mnt_point = "/RAM:";
	} else if (IS_ENABLED(CONFIG_DISK_DRIVER_SDMMC)) {
		mnt->mnt_point = "/SD:";
	} else if (IS_ENABLED(CONFIG_DISK_DRIVER_MMC)) {
		mnt->mnt_point = "/SD2:";
	} else {
		mnt->mnt_point = "/NAND:";
	}

#elif CONFIG_FILE_SYSTEM_LITTLEFS
	mnt->type = FS_LITTLEFS;
	mnt->mnt_point = "/lfs";
	mnt->fs_data = &storage;
#endif
	rc = fs_mount(mnt);

	return rc;
}

static void setup_disk(void)
{
	struct fs_mount_t *mp = &fs_mnt;
	struct fs_dir_t dir;
	struct fs_statvfs sbuf;
	int rc;

	fs_dir_t_init(&dir);

	if (IS_ENABLED(CONFIG_DISK_DRIVER_FLASH)) {
		rc = setup_flash(mp);
		if (rc < 0) {
			LOG_ERR("Failed to setup flash area");
			return;
		}
	}

	if (!IS_ENABLED(CONFIG_FILE_SYSTEM_LITTLEFS) &&
	    !IS_ENABLED(CONFIG_FAT_FILESYSTEM_ELM)) {
		LOG_INF("No file system selected");
		return;
	}

	rc = mount_app_fs(mp);
	if (rc < 0) {
		LOG_ERR("Failed to mount filesystem");
		return;
	}

	/* Allow log messages to flush to avoid interleaved output */
	k_sleep(K_MSEC(50));

	printk("Mount %s: %d\n", fs_mnt.mnt_point, rc);

	rc = fs_statvfs(mp->mnt_point, &sbuf);
	if (rc < 0) {
		printk("FAIL: statvfs: %d\n", rc);
		return;
	}

	printk("%s: bsize = %lu ; frsize = %lu ;"
	       " blocks = %lu ; bfree = %lu\n",
	       mp->mnt_point,
	       sbuf.f_bsize, sbuf.f_frsize,
	       sbuf.f_blocks, sbuf.f_bfree);

	rc = fs_opendir(&dir, mp->mnt_point);
	printk("%s opendir: %d\n", mp->mnt_point, rc);

	if (rc < 0) {
		LOG_ERR("Failed to open directory");
	}

	while (rc >= 0) {
		struct fs_dirent ent = { 0 };

		rc = fs_readdir(&dir, &ent);
		if (rc < 0) {
			LOG_ERR("Failed to read directory entries");
			break;
		}
		if (ent.name[0] == 0) {
			printk("End of files\n");
			break;
		}
		printk("  %c %u %s\n",
		       (ent.type == FS_DIR_ENTRY_FILE) ? 'F' : 'D',
		       ent.size,
		       ent.name);
	}

	(void)fs_closedir(&dir);

	return;
}

int main(void)
{
	int ret;

	setup_disk();

#if defined(CONFIG_USB_DEVICE_STACK_NEXT)
	ret = enable_usb_device_next();
#else
	ret = usb_enable(NULL);
#endif
	if (ret != 0) {
		LOG_ERR("Failed to enable USB");
		return 0;
	}

	LOG_INF("The device is put in USB mass storage mode.\n");
	return 0;
}
```
