/*
 * Copyright (c) 2025, Ambiq Micro Inc. <www.ambiq.com>
 *
 * SPDX-License-Identifier: Apache-2.0
 */

&mspi0 {

	/delete-property/ zephyr,pm-device-runtime-auto;

	aps25616ba: aps_z8@0 {
		/delete-property/ zephyr,pm-device-runtime-auto;
	};
};
