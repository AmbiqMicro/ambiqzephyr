## CMakeLists.txt
```
# SPDX-License-Identifier: Apache-2.0

cmake_minimum_required(VERSION 3.20.0)
find_package(Zephyr REQUIRED HINTS $ENV{ZEPHYR_BASE})
project(nemagfx_benchmarks)

target_include_directories(app PRIVATE
  src
  ${ZEPHYR_HAL_AMBIQ_MODULE_DIR}/components/graphics/NemaGFX_SDK/headers/include/tsi/common
)

target_sources(app PRIVATE
  src/main.c
  src/utils.c
  src/nema_utils_port.c
  src/bench_blit.c
  src/bench_draw_line.c
  src/bench_draw_rect.c
  src/bench_draw_string.c
  src/bench_fill_quad.c
  src/bench_fill_rect.c
  src/bench_fill_tri.c
  src/bench_stretch_blit.c
  src/bench_stretch_blit_rotate.c
  src/bench_textured_quad.c
  src/bench_textured_tri.c
  src/DejaVuSerif12pt8b.c
)
```

## sample.yaml
```
sample:
  name: NemaGFX Benchmarks
  description: NemaGFX GPU performance benchmarking suite
tests:
  sample.boards.ambiq.nemagfx_benchmarks:
    tags:
      - display
      - gpu
    platform_allow:
      - apollo510_evb
      - apollo510b_evb
      - apollo510dL_evb
    extra_args: SHIELD=ap510_disp
    filter: dt_chosen_enabled("zephyr,display") and dt_chosen_enabled("ambiq,gpu")
    harness: console
    harness_config:
      fixture: fixture_display
      type: one_line
      regex:
        - "NemaGFX benchmarks complete"
    timeout: 300
```

## prj.conf
```kconfig
CONFIG_FPU=y
CONFIG_MAIN_STACK_SIZE=8192
CONFIG_HEAP_MEM_POOL_SIZE=65536

CONFIG_DISPLAY=y
CONFIG_LOG=y

# Keep GPU/DSI/display blocks awake; LVGL demos use the same setting.
CONFIG_PM_DEVICE_RUNTIME_DEFAULT_ENABLE=n

CONFIG_NEMAGFX_HEAP_SIZE_RENDER=1280
CONFIG_NEMAGFX_HEAP_SIZE_ASSETS=256

# Run one benchmark pass and exit (used by Twister).
CONFIG_TEST=y
```

## boards/apollo510b_evb.conf
```kconfig
# Copyright (c) 2026 Ambiq Micro Inc.
# SPDX-License-Identifier: Apache-2.0

CONFIG_FPU=y
CONFIG_GPIO=y
CONFIG_DCACHE=n
CONFIG_NEMAGFX_RENDER_HEAP_IN_NONCACHE_SRAM=y
CONFIG_NEMAGFX_ASSETS_HEAP_IN_PSRAM=n
```

## boards/apollo510dL_evb.conf
```kconfig
# Copyright (c) 2026 Ambiq Micro Inc.
# SPDX-License-Identifier: Apache-2.0

CONFIG_FPU=y
CONFIG_GPIO=y
CONFIG_DCACHE=n
CONFIG_MEMC=y
CONFIG_MEMC_MSPI_APS_Z8=y
CONFIG_MEMC_MSPI_APS25616BA=y
CONFIG_NEMAGFX_RENDER_HEAP_IN_PSRAM=y
CONFIG_NEMAGFX_HEAP_SIZE_RENDER=2048
CONFIG_NEMAGFX_HEAP_SIZE_ASSETS=512
CONFIG_NEMAGFX_ASSETS_HEAP_IN_PSRAM=y
```

## boards/apollo510b_evb.overlay
```dts
/*
 * Copyright (c) 2026 Ambiq Micro Inc.
 *
 * SPDX-License-Identifier: Apache-2.0
 */

/*
 * Center the 384x384 GPU framebuffer on the 468x468 ap510_disp panel.
 * Offsets are applied in the CO5300 driver via chipone,co5300 x-offset/y-offset
 * (see commit 6ce4ab0b09fc1408a0bf6511579c7a2884e7a724).
 */
&co5300 {
	x-offset = <42>;
	y-offset = <42>;
};
```

## src/main.c
```c
/*
 * Copyright (c) 2026 Ambiq Micro Inc.
 *
 * SPDX-License-Identifier: Apache-2.0
 */

/**
 * @file
 * @brief NemaGFX performance benchmarking suite for Zephyr.
 *
 * Port of the AmbiqSuite nemagfx_benchmarks example. Measures GPU throughput
 * for shape rendering, texture operations, and transformations, reporting
 * results on the console and pushing each result frame to the display.
 */

#include "nemagfx_benchmarks.h"
#include "bench.h"
#include "utils.h"

#include <zephyr/kernel.h>
#include <zephyr/logging/log.h>

LOG_MODULE_REGISTER(nemagfx_benchmarks, LOG_LEVEL_INF);

#ifndef DEFAULT_EXEC_MODE
#define DEFAULT_EXEC_MODE CPU_GPU
#endif

TLS_VAR nema_cmdlist_t *g_psCLCur, g_sCL0, g_sCL1, g_sContextCL;
ExecutionMode_e eExecMode = DEFAULT_EXEC_MODE;

typedef enum {
	GPU_BURST_LENGTH_16 = 4,
	GPU_BURST_LENGTH_32 = 5,
	GPU_BURST_LENGTH_64 = 6,
	GPU_BURST_LENGTH_128 = 7,
} nemagfx_burst_length_t;

static nemagfx_burst_length_t tex_burst_length = GPU_BURST_LENGTH_16;
static nemagfx_burst_length_t fb_burst_length = GPU_BURST_LENGTH_16;

uint32_t nema_burst_reg_value;

static int i32RenderFrame(void)
{
	return 0;
}

void run_bench(int32_t i32TestNo)
{
	int32_t i32Result = 0;

	suite_init();

	switch (i32TestNo) {
	case 1:
		bench_start(i32TestNo);
		i32Result = bench_fill_tri(0);
		bench_stop(i32TestNo, i32Result);
		break;
	case 2:
		bench_start(i32TestNo);
		i32Result = bench_fill_tri(1);
		bench_stop(i32TestNo, i32Result);
		break;
	case 3:
		bench_start(i32TestNo);
		i32Result = bench_fill_rect(0);
		bench_stop(i32TestNo, i32Result);
		break;
	case 4:
		bench_start(i32TestNo);
		i32Result = bench_fill_rect(1);
		bench_stop(i32TestNo, i32Result);
		break;
	case 5:
		bench_start(i32TestNo);
		i32Result = bench_fill_quad(0);
		bench_stop(i32TestNo, i32Result);
		break;
	case 6:
		bench_start(i32TestNo);
		i32Result = bench_fill_quad(1);
		bench_stop(i32TestNo, i32Result);
		break;
	case 7:
		bench_start(i32TestNo);
		i32Result = bench_draw_string(NEMA_BL_SRC);
		bench_stop(i32TestNo, i32Result);
		break;
	case 8:
		bench_start(i32TestNo);
		i32Result = bench_draw_line(0);
		bench_stop(i32TestNo, i32Result);
		break;
	case 9:
		bench_start(i32TestNo);
		i32Result = bench_draw_line(1);
		bench_stop(i32TestNo, i32Result);
		break;
	case 10:
		bench_start(i32TestNo);
		i32Result = bench_draw_rect(0);
		bench_stop(i32TestNo, i32Result);
		break;
	case 11:
		bench_start(i32TestNo);
		i32Result = bench_draw_rect(1);
		bench_stop(i32TestNo, i32Result);
		break;
	case 12:
		bench_start(i32TestNo);
		i32Result = bench_blit(NEMA_BL_SRC, NEMA_ROT_000_CCW);
		bench_stop(i32TestNo, i32Result);
		break;
	case 13:
		bench_start(i32TestNo);
		i32Result = bench_blit(NEMA_BL_SRC | NEMA_BLOP_MODULATE_RGB, NEMA_ROT_000_CCW);
		bench_stop(i32TestNo, i32Result);
		break;
	case 14:
		bench_start(i32TestNo);
		i32Result = bench_blit(NEMA_BL_SIMPLE, NEMA_ROT_000_CCW);
		bench_stop(i32TestNo, i32Result);
		break;
	case 15:
		bench_start(i32TestNo);
		i32Result = bench_blit(NEMA_BL_SIMPLE | NEMA_BLOP_MODULATE_RGB, NEMA_ROT_000_CCW);
		bench_stop(i32TestNo, i32Result);
		break;
	case 16:
		bench_start(i32TestNo);
		i32Result = bench_blit(NEMA_BL_SRC, NEMA_ROT_090_CW);
		bench_stop(i32TestNo, i32Result);
		break;
	case 17:
		bench_start(i32TestNo);
		i32Result = bench_blit(NEMA_BL_SRC, NEMA_ROT_180_CW);
		bench_stop(i32TestNo, i32Result);
		break;
	case 18:
		bench_start(i32TestNo);
		i32Result = bench_blit(NEMA_BL_SRC, NEMA_ROT_270_CW);
		bench_stop(i32TestNo, i32Result);
		break;
	case 19:
		bench_start(i32TestNo);
		i32Result = bench_blit(NEMA_BL_SRC, NEMA_MIR_VERT);
		bench_stop(i32TestNo, i32Result);
		break;
	case 20:
		bench_start(i32TestNo);
		i32Result = bench_blit(NEMA_BL_SRC, NEMA_MIR_HOR);
		bench_stop(i32TestNo, i32Result);
		break;
	case 21:
		bench_start(i32TestNo);
		i32Result = bench_blit(NEMA_BL_SRC | NEMA_BLOP_SRC_CKEY, NEMA_ROT_000_CCW);
		bench_stop(i32TestNo, i32Result);
		break;
	case 22:
		bench_start(i32TestNo);
		i32Result = bench_blit(NEMA_BL_SRC | NEMA_BLOP_DST_CKEY, NEMA_ROT_000_CCW);
		bench_stop(i32TestNo, i32Result);
		break;
	case 23:
		bench_start(i32TestNo);
		i32Result = bench_stretch_blit(NEMA_BL_SRC, 1.5, NEMA_FILTER_PS);
		bench_stop(i32TestNo, i32Result);
		break;
	case 24:
		bench_start(i32TestNo);
		i32Result = bench_stretch_blit(NEMA_BL_SIMPLE, 1.5, NEMA_FILTER_PS);
		bench_stop(i32TestNo, i32Result);
		break;
	case 25:
		bench_start(i32TestNo);
		i32Result = bench_stretch_blit(NEMA_BL_SRC, 1.5, NEMA_FILTER_BL);
		bench_stop(i32TestNo, i32Result);
		break;
	case 26:
		bench_start(i32TestNo);
		i32Result = bench_stretch_blit(NEMA_BL_SIMPLE, 1.5, NEMA_FILTER_BL);
		bench_stop(i32TestNo, i32Result);
		break;
	case 27:
		bench_start(i32TestNo);
		i32Result = bench_stretch_blit_rotate(NEMA_BL_SRC, 0.75, NEMA_FILTER_PS);
		bench_stop(i32TestNo, i32Result);
		break;
	case 28:
		bench_start(i32TestNo);
		i32Result = bench_stretch_blit_rotate(NEMA_BL_SRC, 0.75, NEMA_FILTER_BL);
		bench_stop(i32TestNo, i32Result);
		break;
	case 29:
		bench_start(i32TestNo);
		i32Result = bench_textured_tri(NEMA_BL_SRC, NEMA_FILTER_PS);
		bench_stop(i32TestNo, i32Result);
		break;
	case 30:
		bench_start(i32TestNo);
		i32Result = bench_textured_tri(NEMA_BL_SIMPLE, NEMA_FILTER_PS);
		bench_stop(i32TestNo, i32Result);
		break;
	case 31:
		bench_start(i32TestNo);
		i32Result = bench_textured_tri(NEMA_BL_SRC, NEMA_FILTER_BL);
		bench_stop(i32TestNo, i32Result);
		break;
	case 32:
		bench_start(i32TestNo);
		i32Result = bench_textured_tri(NEMA_BL_SIMPLE, NEMA_FILTER_BL);
		bench_stop(i32TestNo, i32Result);
		break;
	case 33:
		bench_start(i32TestNo);
		i32Result = bench_textured_quad(NEMA_BL_SRC, NEMA_FILTER_PS);
		bench_stop(i32TestNo, i32Result);
		break;
	case 34:
		bench_start(i32TestNo);
		i32Result = bench_textured_quad(NEMA_BL_SIMPLE, NEMA_FILTER_PS);
		bench_stop(i32TestNo, i32Result);
		break;
	case 35:
		bench_start(i32TestNo);
		i32Result = bench_textured_quad(NEMA_BL_SRC, NEMA_FILTER_BL);
		bench_stop(i32TestNo, i32Result);
		break;
	case 36:
		bench_start(i32TestNo);
		i32Result = bench_textured_quad(NEMA_BL_SIMPLE, NEMA_FILTER_BL);
		bench_stop(i32TestNo, i32Result);
		break;
	default:
		return;
	}

	suite_terminate();
}

static void run_benchmark_pass(void)
{
	srand(0xffffff00);

	nema_burst_reg_value = 0x0UL | (fb_burst_length << 4) | (tex_burst_length);
	am_util_stdio_printf("FB burst: %d\n", fb_burst_length);
	am_util_stdio_printf("TEX burst: %d\n", tex_burst_length);
	am_util_stdio_printf("Burst size register value: %08X\n", nema_burst_reg_value);

	for (uint32_t i32Test = 1; i32Test <= TEST_MAX; ++i32Test) {
		run_bench(i32Test);
	}
}

int main(void)
{
	int ret;

	LOG_INF("NemaGFX benchmarks starting");

	ret = nema_init();
	if (ret != 0) {
		LOG_ERR("nema_init failed: %d", ret);
		return ret;
	}

	ret = display_setup();
	if (ret != 0) {
		LOG_ERR("Display setup failed: %d", ret);
		return ret;
	}

	am_util_stdio_printf("\nNemaGFX benchmark suite (FB %dx%d)\n", FB_RESX, FB_RESY);

#if defined(CONFIG_TEST)
	run_benchmark_pass();
	am_util_stdio_printf("NemaGFX benchmarks complete\n");
	return 0;
#else
	while (1) {
		run_benchmark_pass();

		tex_burst_length++;
		if (tex_burst_length > GPU_BURST_LENGTH_128) {
			tex_burst_length = GPU_BURST_LENGTH_16;
			fb_burst_length++;
			if (fb_burst_length > GPU_BURST_LENGTH_128) {
				fb_burst_length = GPU_BURST_LENGTH_16;
			}
		}
	}
#endif
}
```

## src/DejaVuSerif12pt8b.h
```c
/*
 * Copyright (c) 2026 Ambiq Micro Inc.
 *
 * SPDX-License-Identifier: Apache-2.0
 */

#ifndef DEJAVUSERIF12PT8B_H
#define DEJAVUSERIF12PT8B_H

/*    Do this: */
/*        #define NEMA_FONT_IMPLEMENTATION */
/*    before you include this file in *one* C file to create the implementation */
/* */
/*    OR */
/* */
/*    add: */
/*        sDejaVuSerif12pt8b.c */
/*    to your C_SRCS to be compiled */

#include "nema_font.h"

extern nema_font_t g_sDejaVuSerif12pt8b;

#ifdef NEMA_FONT_IMPLEMENTATION
#include "DejaVuSerif12pt8b.c"
#endif /* NEMA_FONT_IMPLEMENTATION */

#endif /* DEJAVUSERIF12PT8B_H */
```

## src/bench.h
```c
/*
 * Copyright (c) 2026 Ambiq Micro Inc.
 *
 * SPDX-License-Identifier: Apache-2.0
 */

#ifndef __BENCH_H__
#define __BENCH_H__

#include "nema_hal.h"
#include "nema_cmdlist.h"
#include "nema_utils.h"
#include "nema_regs.h"

#include "utils.h"
#include <stdlib.h>

#ifndef ITEMS_PER_CL
#define ITEMS_PER_CL 90
#endif

extern ExecutionMode_e eExecMode;
extern TLS_VAR img_obj_t g_sAmbiqLogo;
extern TLS_VAR nema_cmdlist_t *g_psCLCur, g_sCL0, g_sCL1, g_sContextCL;

extern float start_wall, stop_wall;

extern uint32_t nema_burst_reg_value;

static int i32RenderFrame(void);

int bench_fill_tri(int i32Blend);
int bench_fill_rect(int i32Blend);
int bench_fill_quad(int i32Blend);
int bench_draw_string(int blendmode);
int bench_draw_line(int i32Blend);
int bench_draw_rect(int i32Blend);
int bench_blit(int i32BlendMode, int i32Rotation);
int bench_stretch_blit(int i32BlendMode, float scale, int i32NemaTexMode);
int bench_stretch_blit_rotate(int i32BlendMode, float fscale, int i32NemaTexMode);
int bench_textured_tri(int i32BlendMode, int i32NemaTexMode);
int bench_textured_quad(int i32BlendMode, int i32NemaTexMode);

#define PRINTF(...)

#define swap_cmd_lists() \
	(g_psCLCur = (g_psCLCur == &g_sCL0) ? &g_sCL1 : &g_sCL0)

static inline int CL_CHECK_SUBMIT(int i32ItemsPerCL)
{
	int _items_per_cl = i32ItemsPerCL;

	if (_items_per_cl == 0) {
		_items_per_cl = ITEMS_PER_CL;
	}

	int items = 0;
	int i32PixCount = 0;

	start_wall = nema_get_time();
	stop_wall = start_wall;

	nema_cl_bind(g_psCLCur);
	nema_cl_rewind(g_psCLCur);
	nema_cl_branch(&g_sContextCL);

	if (eExecMode != GPU_BOUND) {
		do {
			i32PixCount += i32RenderFrame();

			++items;
			if ((items % _items_per_cl) == 0) {
				if (eExecMode != CPU_BOUND) {
					nema_cl_return();
					nema_cl_submit(g_psCLCur);
				}

				swap_cmd_lists();
				nema_cl_wait(g_psCLCur);

				nema_cl_bind(g_psCLCur);
				nema_cl_rewind(g_psCLCur);
				nema_cl_branch(&g_sContextCL);

				stop_wall = nema_get_time();
				if ((stop_wall - start_wall) > TIMEOUT_S) {
					break;
				}
			}
		} while (1);

		nema_cl_wait(g_psCLCur);
		swap_cmd_lists();
		nema_cl_wait(g_psCLCur);
	} else {
		int i;
		int pix_count_cl = 0;

		for (i = 0; i < _items_per_cl; i++) {
			pix_count_cl += i32RenderFrame();
		}
		while (1) {
			nema_cl_return();
			nema_cl_submit(g_psCLCur);
			nema_cl_wait(g_psCLCur);
			items += _items_per_cl;
			i32PixCount += pix_count_cl;
			stop_wall = nema_get_time();
			if ((stop_wall - start_wall) > TIMEOUT_S) {
				break;
			}
		}
	}

	stop_wall = nema_get_time();

	return i32PixCount;
}

#endif /* __BENCH_H__ */
```

## src/bench_blit.c
```c
/*
 * Copyright (c) 2026 Ambiq Micro Inc.
 * Copyright (c) 2019 Think Silicon S.A.
 *
 * SPDX-License-Identifier: Apache-2.0
 */

#include <nema_core.h>

#include "bench.h"

#define PI 3.14159

static int SZX;
static int SZY;

static int rotation;

static int i32RenderFrame(void)
{
	int x = 0;
	int y = 0;

	if (rotation == NEMA_ROT_090_CCW || rotation == NEMA_ROT_270_CCW ||
	    rotation == NEMA_ROT_090_CW || rotation == NEMA_ROT_270_CW) {
		if (FB_RESX - SZY > 0) {
			x = rand() % (FB_RESX - SZY);
		}
		if (FB_RESY - SZX > 0) {
			y = rand() % (FB_RESY - SZX);
		}
	} else {
		if (FB_RESX - SZX > 0) {
			x = rand() % (FB_RESX - SZX);
		} else {
		}

		if (FB_RESY - SZY > 0) {
			y = rand() % (FB_RESY - SZY);
		}
	}

	if (rotation == 0) {
		nema_blit(x, y);
	} else {
		nema_blit_rotate(x, y, rotation);
	}

	return SZX * SZY;
}

/****************************************************************************** */
/* */
/*! @brief draw numerous company logos with selected blend mode */
/*! */
/*! @param i32BlendMode - blend mode selection. */
/*! @param i32Rotation  - degrees rotation with counter-clockwise or clockwise. */
/*! */
/*! This function could draw numerous logos with selected blend mode. */
/*! */
/*! @return the total count of pixels. */
/* */
/****************************************************************************** */
int bench_blit(int i32BlendMode, int i32Rotation)
{
	SZX = g_sAmbiqLogo.w;
	SZY = g_sAmbiqLogo.h;
	rotation = i32Rotation;

	g_sContextCL = nema_cl_create();
	g_sCL0 = nema_cl_create();
	g_sCL1 = nema_cl_create();
	g_psCLCur = &g_sCL0;

	nema_cl_bind(&g_sContextCL);
	/* */
	/* Set Clipping Rectangle */
	/* */
	nema_set_clip(0, 0, FB_RESX, FB_RESY);
	/* */
	/* Bind Framebuffer */
	/* */
	nema_bind_dst_tex(g_sFB.bo.base_phys, g_sFB.w, g_sFB.h, (nema_tex_format_t)(g_sFB.format),
			  -1);
	nema_bind_src_tex(g_sAmbiqLogo.bo.base_phys, g_sAmbiqLogo.w, g_sAmbiqLogo.h,
			  (nema_tex_format_t)(g_sAmbiqLogo.format), g_sAmbiqLogo.stride,
			  NEMA_FILTER_BL);
	nema_cl_add_cmd(NEMA_BURST_SIZE, nema_burst_reg_value);
	nema_set_const_color(0xff00);
	nema_set_src_color_key(0x404040);
	nema_set_dst_color_key(0x0);
	nema_set_blend_blit(i32BlendMode);

	int i32PixCount = 0;

	i32PixCount += CL_CHECK_SUBMIT(0);

	nema_cl_destroy(&g_sContextCL);
	nema_cl_destroy(&g_sCL0);
	nema_cl_destroy(&g_sCL1);

	return i32PixCount;
}
```

## src/bench_draw_line.c
```c
/*
 * Copyright (c) 2026 Ambiq Micro Inc.
 * Copyright (c) 2019 Think Silicon S.A.
 *
 * SPDX-License-Identifier: Apache-2.0
 */

#include <nema_core.h>

#include "bench.h"

static int g_i32PremultiplyColor;

static int i32RenderFrame(void)
{
	int x0 = rand() % (FB_RESX);
	int x1 = rand() % (FB_RESX);
	uint32_t col = rand();
	int y0 = rand() % (FB_RESY);
	int y1 = rand() % (FB_RESY);

	if (g_i32PremultiplyColor != 0) {
		col = nema_premultiply_rgba(col);
	}

	nema_draw_line(x0, y0, x1, y1, col);

	if (nema_abs(y0 - y1) > nema_abs(x0 - x1)) {
		return nema_abs(y0 - y1);
	} else {
		return nema_abs(x0 - x1);
	}
}

/****************************************************************************** */
/* */
/*! @brief draw lines */
/*! */
/*! @param i32Blend - blend mode selection. */
/*! */
/*! This function could draw numerous lines with selected blend mode. */
/*! */
/*! @return the total count of pixels. */
/* */
/****************************************************************************** */
int bench_draw_line(int i32Blend)
{
	g_sContextCL = nema_cl_create();
	g_sCL0 = nema_cl_create();
	g_sCL1 = nema_cl_create();
	g_psCLCur = &g_sCL0;

	nema_cl_bind(&g_sContextCL);
	/* */
	/* Bind Framebuffer */
	/* */
	nema_bind_dst_tex(g_sFB.bo.base_phys, g_sFB.w, g_sFB.h, (nema_tex_format_t)(g_sFB.format),
			  -1);
	nema_cl_add_cmd(NEMA_BURST_SIZE, nema_burst_reg_value);
	/* */
	/* Set Clipping Rectangle */
	/* */
	nema_set_clip(0, 0, FB_RESX, FB_RESY);
	/* */
	/* Set Blending Mode */
	/* */
	nema_set_blend_fill(i32Blend ? NEMA_BL_SRC_OVER : NEMA_BL_SRC);
	g_i32PremultiplyColor = i32Blend;

	int i32PixCount = 0;

	i32PixCount += CL_CHECK_SUBMIT(0);

	nema_cl_destroy(&g_sContextCL);
	nema_cl_destroy(&g_sCL0);
	nema_cl_destroy(&g_sCL1);

	return i32PixCount;
}
```

## src/bench_draw_rect.c
```c
/*
 * Copyright (c) 2026 Ambiq Micro Inc.
 * Copyright (c) 2019 Think Silicon S.A.
 *
 * SPDX-License-Identifier: Apache-2.0
 */

#include <nema_core.h>

#include "bench.h"

#define min2(a, b) ((a) < (b) ? (a) : (b))

static int g_i32PremultiplyColor;

static int i32RenderFrame(void)
{
	int size = rand() % (min2(FB_RESX, FB_RESY) / 2);

	int x = rand() % (FB_RESX - size);
	uint32_t col = rand();
	int y = rand() % (FB_RESY - size);

	if (g_i32PremultiplyColor != 0) {
		col = nema_premultiply_rgba(col);
	}

	nema_draw_rect(x, y, size, size, col);

	return 4 * size - 4;
}

/****************************************************************************** */
/* */
/*! @brief draw rectangle */
/*! */
/*! @param i32Blend - blend mode selection. */
/*! */
/*! This function could draw numerous lines with selected blend mode. */
/*! */
/*! @return the total count of pixels. */
/* */
/****************************************************************************** */
int bench_draw_rect(int i32Blend)
{
	g_sContextCL = nema_cl_create();
	g_sCL0 = nema_cl_create();
	g_sCL1 = nema_cl_create();
	g_psCLCur = &g_sCL0;

	nema_cl_bind(&g_sContextCL);
	/* */
	/* Bind Framebuffer */
	/* */
	nema_bind_dst_tex(g_sFB.bo.base_phys, g_sFB.w, g_sFB.h, (nema_tex_format_t)(g_sFB.format),
			  -1);
	nema_cl_add_cmd(NEMA_BURST_SIZE, nema_burst_reg_value);
	/* */
	/* Set Clipping Rectangle */
	/* */
	nema_set_clip(0, 0, FB_RESX, FB_RESY);
	/* */
	/* Set Blending Mode */
	/* */
	nema_set_blend_fill(i32Blend ? NEMA_BL_SRC_OVER : NEMA_BL_SRC);
	g_i32PremultiplyColor = i32Blend;

	int i32PixCount = 0;

	i32PixCount += CL_CHECK_SUBMIT(0);

	nema_cl_destroy(&g_sContextCL);
	nema_cl_destroy(&g_sCL0);
	nema_cl_destroy(&g_sCL1);

	return i32PixCount;
}
```

## src/bench_draw_string.c
```c
/*
 * Copyright (c) 2026 Ambiq Micro Inc.
 * Copyright (c) 2019 Think Silicon S.A.
 *
 * SPDX-License-Identifier: Apache-2.0
 */

#include <nema_core.h>
#include <nema_font.h>

#include "DejaVuSerif12pt8b.h"
#include "string.h"
#include "bench.h"

static const char str[] = "Think Silicon\nUltra-low power | vivid graphics";
static int w, h;

static int i32RenderFrame(void)
{
	int x = 0;
	int y = 0;
	uint32_t col = rand();

	if (w < FB_RESX) {
		x = rand() % (FB_RESX - w);
	}

	if (h < FB_RESY) {
		y = rand() % (FB_RESY - h);
	}

	nema_print(str, x, y, w, h, col, NEMA_ALIGNX_CENTER | NEMA_TEXT_WRAP | NEMA_ALIGNY_CENTER);

	return sizeof(str) - 1;
}

/****************************************************************************** */
/* */
/*! @brief draw strings */
/*! */
/*! @param blendmode - blend mode selection. */
/*! */
/*! This function load font to memory SSRAM,draw test string with selected blend */
/*! mode. */
/*! */
/*! @return the total count of pixels. */
/* */
/****************************************************************************** */
int bench_draw_string(int blendmode)
{
	g_sDejaVuSerif12pt8b.bo =
		nema_buffer_create_pool(NEMA_MEM_POOL_ASSETS, g_sDejaVuSerif12pt8b.bitmap_size);
	/*nema_buffer_map(&g_sDejaVuSerif12pt8b.bo); */
	nema_memcpy(g_sDejaVuSerif12pt8b.bo.base_virt, g_sDejaVuSerif12pt8b.bitmap,
		    g_sDejaVuSerif12pt8b.bitmap_size);
	nema_buffer_flush(&g_sDejaVuSerif12pt8b.bo);

	g_sContextCL = nema_cl_create();
	g_sCL0 = nema_cl_create();
	g_sCL1 = nema_cl_create();
	g_psCLCur = &g_sCL0;

	nema_cl_bind(&g_sContextCL);
	/* */
	/* Bind Framebuffer */
	/* */
	nema_bind_dst_tex(g_sFB.bo.base_phys, g_sFB.w, g_sFB.h, (nema_tex_format_t)(g_sFB.format),
			  -1);
	nema_cl_add_cmd(NEMA_BURST_SIZE, nema_burst_reg_value);
	/* */
	/* Set Clipping Rectangle */
	/* */
	nema_set_clip(0, 0, FB_RESX, FB_RESY);
	/* */
	/* Set Blending Mode */
	/* */
	nema_set_blend_blit(blendmode);
	nema_bind_font(&g_sDejaVuSerif12pt8b);
	nema_string_get_bbox(str, &w, &h, FB_RESX, 1);

	int i32PixCount = 0;

	/*nema_bind_font(&g_sDejaVuSerif12pt8b); */
	i32PixCount += CL_CHECK_SUBMIT(ITEMS_PER_CL <= 5 ? 1 : ITEMS_PER_CL / 5);

	nema_cl_destroy(&g_sContextCL);
	nema_cl_destroy(&g_sCL0);
	nema_cl_destroy(&g_sCL1);

	nema_buffer_destroy(&g_sDejaVuSerif12pt8b.bo);

	return i32PixCount;
}
```

## src/bench_fill_quad.c
```c
/*
 * Copyright (c) 2026 Ambiq Micro Inc.
 * Copyright (c) 2019 Think Silicon S.A.
 *
 * SPDX-License-Identifier: Apache-2.0
 */

#include <nema_core.h>

#include "bench.h"

static int g_i32PremultiplyColor;

static int i32RenderFrame(void)
{
	int i32BBoxW = rand() % (FB_RESX - 50) + 50;
	int i32BBoxH = rand() % (FB_RESY - 50) + 50;
	uint32_t ui32Col = rand();
	int i32BBoxX = rand() % (FB_RESX - i32BBoxW);
	int i32BBoxY = rand() % (FB_RESY - i32BBoxH);

	int x0 = (int)(i32BBoxX + (float)(rand() % (100)) / 100.f * i32BBoxW);
	int y0 = i32BBoxY;
	int x1 = i32BBoxX + i32BBoxW;
	int y1 = (int)(i32BBoxY + (float)(rand() % (100)) / 100.f * i32BBoxH);
	int x2 = (int)(i32BBoxX + (float)(rand() % (100)) / 100.f * i32BBoxW);
	int y2 = i32BBoxY + i32BBoxH;
	int x3 = i32BBoxX;
	int y3 = (int)(i32BBoxY + (float)(rand() % (100)) / 100.f * i32BBoxH);

	if (g_i32PremultiplyColor != 0) {
		ui32Col = nema_premultiply_rgba(ui32Col);
	}

	nema_fill_quad(x0, y0, x1, y1, x2, y2, x3, y3, ui32Col);

	int area = (int)(0.5f * nema_abs(x0 * (y1 - y3) + x1 * (y2 - y0) + x2 * (y3 - y1) +
					 x3 * (y0 - y2)));
	return area;
}

/****************************************************************************** */
/* */
/*! @brief fill patterns with quadrilaterals */
/*! */
/*! @param i32Blend - blend mode selection. */
/*! */
/*! This function fill large number of quadrilaterals with blend mode NEMA_BL_SRC_OVER */
/*! or NEMA_BL_SRC */
/*! */
/*! @return the total count of pixels. */
/* */
/****************************************************************************** */
int bench_fill_quad(int i32Blend)
{
	g_sContextCL = nema_cl_create();
	g_sCL0 = nema_cl_create();
	g_sCL1 = nema_cl_create();
	g_psCLCur = &g_sCL0;

	nema_cl_bind(&g_sContextCL);
	/* */
	/* Bind Framebuffer */
	/* */
	nema_bind_dst_tex(g_sFB.bo.base_phys, g_sFB.w, g_sFB.h, (nema_tex_format_t)(g_sFB.format),
			  -1);
	nema_cl_add_cmd(NEMA_BURST_SIZE, nema_burst_reg_value);
	/* */
	/* Set Clipping Rectangle */
	/* */
	nema_set_clip(0, 0, FB_RESX, FB_RESY);
	/* */
	/* Set Blending Mode */
	/* */
	nema_set_blend_fill(i32Blend ? NEMA_BL_SRC_OVER : NEMA_BL_SRC);
	g_i32PremultiplyColor = i32Blend;

	int i32PixCount = 0;

	i32PixCount += CL_CHECK_SUBMIT(0);

	nema_cl_destroy(&g_sContextCL);
	nema_cl_destroy(&g_sCL0);
	nema_cl_destroy(&g_sCL1);

	return i32PixCount;
}
```

## src/bench_fill_rect.c
```c
/*
 * Copyright (c) 2026 Ambiq Micro Inc.
 * Copyright (c) 2019 Think Silicon S.A.
 *
 * SPDX-License-Identifier: Apache-2.0
 */

#include <nema_core.h>

#include "bench.h"

#define min2(a, b) ((a) < (b) ? (a) : (b))

static int g_i32PremultiplyColor;

static int i32RenderFrame(void)
{
	int i32Size = rand() % (min2(FB_RESX, FB_RESY) / 2);

	int x = rand() % (FB_RESX - i32Size);
	uint32_t col = rand();

	if (g_i32PremultiplyColor != 0) {
		col = nema_premultiply_rgba(col);
	}

	int y = rand() % (FB_RESY - i32Size);

	nema_fill_rect(x, y, i32Size, i32Size, col);

	return i32Size * i32Size;
}

/****************************************************************************** */
/* */
/*! @brief fill patterns with rectangles */
/*! */
/*! @param i32Blend - blend mode selection. */
/*! */
/*! This function fill large number of rectangles with blend mode NEMA_BL_SRC_OVER */
/*! or NEMA_BL_SRC */
/*! */
/*! @return the total count of pixels. */
/* */
/****************************************************************************** */
int bench_fill_rect(int i32Blend)
{
	g_sContextCL = nema_cl_create();
	g_sCL0 = nema_cl_create();
	g_sCL1 = nema_cl_create();
	g_psCLCur = &g_sCL0;

	nema_cl_bind(&g_sContextCL);
	/* */
	/* Bind Framebuffer */
	/* */
	nema_bind_dst_tex(g_sFB.bo.base_phys, g_sFB.w, g_sFB.h, (nema_tex_format_t)(g_sFB.format),
			  -1);
	nema_cl_add_cmd(NEMA_BURST_SIZE, nema_burst_reg_value);
	/* */
	/* Set Clipping Rectangle */
	/* */
	nema_set_clip(0, 0, FB_RESX, FB_RESY);
	/* */
	/* Set Blending Mode */
	/* */
	nema_set_blend_fill(i32Blend ? NEMA_BL_SRC_OVER : NEMA_BL_SRC);
	g_i32PremultiplyColor = i32Blend;

	int i32PixCount = 0;

	i32PixCount += CL_CHECK_SUBMIT(0);

	nema_cl_destroy(&g_sContextCL);
	nema_cl_destroy(&g_sCL0);
	nema_cl_destroy(&g_sCL1);

	return i32PixCount;
}
```

## src/bench_fill_tri.c
```c
/*
 * Copyright (c) 2026 Ambiq Micro Inc.
 * Copyright (c) 2019 Think Silicon S.A.
 *
 * SPDX-License-Identifier: Apache-2.0
 */

#include <nema_core.h>

#include "bench.h"

static int g_i32PremultiplyColor;

static int i32RenderFrame(void)
{
	int x0 = rand() % (FB_RESX);
	int y2 = rand() % (FB_RESY);
	int x1 = rand() % (FB_RESX);
	uint32_t ui32Col = rand();
	int y0 = rand() % (FB_RESY);
	int x2 = rand() % (FB_RESX);
	int y1 = rand() % (FB_RESY);

	if (g_i32PremultiplyColor != 0) {
		ui32Col = nema_premultiply_rgba(ui32Col);
	}
	nema_fill_triangle(x0, y0, x1, y1, x2, y2, ui32Col);

	int i32Area = (int)(0.5f * nema_abs(x0 * (y1 - y2) + x1 * (y2 - y0) + x2 * (y0 - y1)));

	return i32Area;
}

/****************************************************************************** */
/* */
/*! @brief fill patterns with triangles */
/*! */
/*! @param i32Blend - blend mode selection. */
/*! */
/*! This function fill large number of triangles with blend mode NEMA_BL_SRC_OVER */
/*! or NEMA_BL_SRC */
/*! */
/*! @return the total count of pixels. */
/* */
/****************************************************************************** */
int bench_fill_tri(int i32Blend)
{
	g_sContextCL = nema_cl_create();
	g_sCL0 = nema_cl_create();
	g_sCL1 = nema_cl_create();
	g_psCLCur = &g_sCL0;

	nema_cl_bind(&g_sContextCL);
	/* */
	/* Bind Framebuffer */
	/* */
	nema_bind_dst_tex(g_sFB.bo.base_phys, g_sFB.w, g_sFB.h, (nema_tex_format_t)(g_sFB.format),
			  -1);
	nema_cl_add_cmd(NEMA_BURST_SIZE, nema_burst_reg_value);
	/* */
	/* Set Clipping Rectangle */
	/* */
	nema_set_clip(0, 0, FB_RESX, FB_RESY);
	/* */
	/* Set Blending Mode */
	/* */
	nema_set_blend_fill(i32Blend ? NEMA_BL_SRC_OVER : NEMA_BL_SRC);
	/*----------------------------------------------------------------------- */
	g_i32PremultiplyColor = i32Blend;

	int i32PixCount = 0;

	i32PixCount += CL_CHECK_SUBMIT(0);

	nema_cl_destroy(&g_sContextCL);
	nema_cl_destroy(&g_sCL0);
	nema_cl_destroy(&g_sCL1);

	return i32PixCount;
}
```

## src/bench_stretch_blit.c
```c
/*
 * Copyright (c) 2026 Ambiq Micro Inc.
 * Copyright (c) 2019 Think Silicon S.A.
 *
 * SPDX-License-Identifier: Apache-2.0
 */

#include <nema_core.h>

#include "bench.h"

#define PI 3.14159

static int SZX;
static int SZY;

static int i32RenderFrame(void)
{
	int x = 0, y = 0;

	if (FB_RESX - SZX > 0) {
		x = rand() % (FB_RESX - SZX);
	}
	if (FB_RESY - SZY > 0) {
		y = rand() % (FB_RESY - SZY);
	}

	nema_blit_rect_fit(x, y, SZX, SZY);

	return SZX * SZY;
}

/****************************************************************************** */
/* */
/*! @brief draw and stretch numerous company logos with selected blend mode */
/*! */
/*! @param i32BlendMode     - blend mode selection. */
/*! @param scale            - target zoom scale. */
/*! @param i32NemaTexMode   - GPU with NEMA_FILTER_PS or NEMA_FILTER_BL. */
/*! */
/*! This function could draw & stretch numerous logos with random positions. */
/*! */
/*! @return the total count of pixels. */
/* */
/****************************************************************************** */
int bench_stretch_blit(int i32BlendMode, float scale, int i32NemaTexMode)
{

	SZX = (int)(g_sAmbiqLogo.w * scale);
	SZY = (int)(g_sAmbiqLogo.h * scale);

	g_sContextCL = nema_cl_create();
	g_sCL0 = nema_cl_create();
	g_sCL1 = nema_cl_create();
	g_psCLCur = &g_sCL0;

	nema_cl_bind(&g_sContextCL);
	/* */
	/* Set Clipping Rectangle */
	/* */
	nema_set_clip(0, 0, FB_RESX, FB_RESY);
	/* */
	/* Bind Framebuffer */
	/* */
	nema_bind_dst_tex(g_sFB.bo.base_phys, g_sFB.w, g_sFB.h, (nema_tex_format_t)(g_sFB.format),
			  -1);
	/* */
	/* Set Blending Mode */
	/* */
	nema_bind_src_tex(g_sAmbiqLogo.bo.base_phys, g_sAmbiqLogo.w, g_sAmbiqLogo.h,
			  (nema_tex_format_t)(g_sAmbiqLogo.format), g_sAmbiqLogo.stride,
			  (nema_tex_mode_t)i32NemaTexMode);
	nema_cl_add_cmd(NEMA_BURST_SIZE, nema_burst_reg_value);
	nema_set_blend_blit(i32BlendMode);

	int i32PixCount = 0;

	i32PixCount += CL_CHECK_SUBMIT(0);

	nema_cl_destroy(&g_sContextCL);
	nema_cl_destroy(&g_sCL0);
	nema_cl_destroy(&g_sCL1);

	return i32PixCount;
}
```
