## CMakeLists.txt
```
# SPDX-License-Identifier: Apache-2.0

cmake_minimum_required(VERSION 3.20.0)

find_package(Zephyr REQUIRED HINTS $ENV{ZEPHYR_BASE})
project(log_backend_swo_example)

target_sources(app PRIVATE src/main.c)
```

## sample.yaml
```
sample:
  description: Log Backend SWO Example
    application
  name: log backend swo example
common:
  tags: introduction
  integration_platforms:
    - native_posix
  harness: console
  harness_config:
    type: one_line
    regex:
      - "(.*) Log Backend SWO Example! (.*)"
tests:
  sample.boards.ambiq.debug.log_backend_swo_example:
    tags: introduction
```

## prj.conf
```kconfig
CONFIG_NO_OPTIMIZATIONS=y

CONFIG_LOG=y
CONFIG_LOG_OUTPUT_FORMAT_LINUX_TIMESTAMP=y
CONFIG_LOG_MODE_IMMEDIATE=y
#CONFIG_LOG_MODE_DEFERRED=y
#CONFIG_LOG_MODE_OVERFLOW=y
CONFIG_LOG_DEFAULT_LEVEL=0

CONFIG_LOG_BACKEND_AMBIQ_SWO=y
CONFIG_LOG_BACKEND_AMBIQ_SWO_FREQ_HZ=1000000
#CONFIG_LOG_PROCESS_THREAD=y

CONFIG_MAIN_STACK_SIZE=4096
```

## boards/apollo4p_evb.conf
```kconfig
CONFIG_CONSOLE=n
CONFIG_UART_CONSOLE=n
CONFIG_SERIAL=n
CONFIG_UART_INTERRUPT_DRIVEN=n
```

## src/main.c
```c
/*
 * Copyright (c) 2023 Ambiq Micro Inc.
 *
 * SPDX-License-Identifier: Apache-2.0
 */

#include <zephyr/kernel.h>
#include <zephyr/logging/log.h>

LOG_MODULE_REGISTER(mainentry, LOG_LEVEL_DBG);

int main(void)
{
    uint32_t i = 0;

    LOG_DBG("Backend_swo_example! %s\n", CONFIG_BOARD);
    while(1)
    {
        k_sleep(K_SECONDS(1));
        LOG_DBG("i: %d\n",i);
        ++i;
    }
	return 0;
}
```
