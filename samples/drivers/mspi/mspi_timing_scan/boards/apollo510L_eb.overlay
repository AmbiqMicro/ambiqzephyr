/*
 * Copyright (c) 2025, Ambiq Micro Inc. <www.ambiq.com>
 *
 * SPDX-License-Identifier: Apache-2.0
 */

/ {
	aliases {
		psram0 = &aps25616n;
	};
};

&mspi0 {
	/delete-property/ zephyr,pm-device-runtime-auto;
	status = "okay";
};

&aps25616n {
	/delete-property/ zephyr,pm-device-runtime-auto;
	status = "okay";
};
