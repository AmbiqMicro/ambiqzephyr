## samples/drivers/mspi/mspi_async/sample.yaml
```yaml
sample:
  name: MSPI Async Sample
tests:
  sample.drivers.mspi.async:
    tags:
      - mspi
    filter: dt_compat_enabled("ambiq,mspi-device")
    platform_exclude: hifive_unmatched
    harness: console
    harness_config:
      type: multi_line
      ordered: true
    depends_on: mspi
```

## samples/shields/mikroe_eeram_33v_click/sample.yaml
```yaml
sample:
  name: EERAM 3.3V Click Sample
tests:
  sample.shields.mikroe_eeram_33v_click:
    tags:
      - drivers
      - eeprom
      - shield
    depends_on:
      - i2c
    filter: dt_alias_exists("eeprom-0")
    harness: console
    harness_config:
      type: one_line
      regex:
        - "EEPROM driver test PASSED"
```

## samples/subsys/crc/sample.yaml
```yaml
sample:
  name: CRC Subsystem
tests:
  samples.subsys.crc:
    depends_on: crc
    tags:
      - subsys
      - crc
    integration_platforms:
      - apollo510_evb
      - apollo510b_evb
    harness: console
    harness_config:
      type: one_line
      regex:
        - "CRC computation completed successfully"
```

## samples/subsys/display/lvgl/boards/ap510_disp_rev1.conf
```kconfig
CONFIG_MAIN_STACK_SIZE=8192

CONFIG_DISPLAY=y
CONFIG_DISPLAY_LOG_LEVEL_ERR=y

CONFIG_LOG=y
CONFIG_SHELL=y

CONFIG_LVGL=y
CONFIG_LV_MEM_CUSTOM=y
CONFIG_LV_USE_LOG=y
CONFIG_LV_USE_LABEL=y
CONFIG_LV_USE_BTN=y
CONFIG_LV_USE_ARC=y
CONFIG_LV_USE_IMG=y
CONFIG_LV_USE_MONKEY=y
CONFIG_LV_FONT_MONTSERRAT_14=y
CONFIG_LV_Z_BITS_PER_PIXEL=16
CONFIG_LV_COLOR_16_SWAP=y
CONFIG_LV_Z_VDB_SIZE=100
#CONFIG_LV_COLOR_DEPTH_32=y
#CONFIG_LV_Z_VDB_ALIGN=2
CONFIG_LV_Z_FULL_REFRESH=y
#CONFIG_LV_Z_DOUBLE_VDB=y
CONFIG_LV_Z_MEM_POOL_SIZE=65536
#CONFIG_LV_Z_SHELL=y

CONFIG_FPU=y
CONFIG_NEMA=y

CONFIG_NO_OPTIMIZATIONS=y
```

## soc/ambiq/Kconfig
```kconfig
# SPDX-License-Identifier: Apache-2.0
#
# Copyright (c) 2023 Antmicro <www.antmicro.com>

if SOC_FAMILY_AMBIQ

config PM_DEVICE_RUNTIME_DISABLE_CONSOLE
	bool "Keep console UART active"
	depends on PM_DEVICE_RUNTIME
	help
	  Leave the zephyr_console UART out of runtime power management.
	  Enable this in samples/tests that log from interrupt context while
	  CONFIG_PM_DEVICE_RUNTIME_DEFAULT_ENABLE is set.

rsource "*/Kconfig"

endif # SOC_FAMILY_AMBIQ
```

## soc/ambiq/apollo3x/Kconfig.defconfig.apollo3_blue
```kconfig
# SPDX-License-Identifier: Apache-2.0
#
# Copyright (c) 2023 Ambiq Micro Inc. <www.ambiq.com>

if SOC_APOLLO3_BLUE

config NUM_IRQS
	default 31

config PM
	default y

endif # SOC_APOLLO3_BLUE
```

## soc/ambiq/apollo4x/Kconfig.defconfig
```kconfig
# SPDX-License-Identifier: Apache-2.0
#
# Copyright (c) 2023 Antmicro <www.antmicro.com>

if SOC_SERIES_APOLLO4X

rsource "Kconfig.defconfig.apollo4*"

config HWINFO_AMBIQ
	default HWINFO

config PM
	default y

config PM_DEVICE
	default y if PM

config PM_DEVICE_RUNTIME
	default y if PM_DEVICE

# Need to enlarge the IDLE stack size because the power
# management operations are executed in the idle task
config IDLE_STACK_SIZE
	default 2048 if PM

endif # SOC_SERIES_APOLLO4X
```

## soc/arm/ambiq/apollo5x/Kconfig.defconfig.apollo5
```kconfig
# SPDX-License-Identifier: Apache-2.0
#
# Copyright (c) 2024 Ambiq Micro Inc.

if SOC_APOLLO5

config NUM_IRQS
    default 134

endif # SOC_APOLLO5
```

## soc/arm/ambiq/apollo5x/Kconfig.defconfig.series
```kconfig
# SPDX-License-Identifier: Apache-2.0
#
# Copyright (c) 2024 Ambiq Micro Inc.

if SOC_SERIES_APOLLO5X

source "soc/arm/ambiq/apollo5x/Kconfig.defconfig.apollo5*"

config SOC_SERIES
    default "apollo5x"

endif # SOC_SERIES_APOLLO5X
```

## soc/arm/ambiq/apollo5x/Kconfig.series
```kconfig
# SPDX-License-Identifier: Apache-2.0
#
# Copyright (c) 2024 Ambiq Micro Inc.

# Ambiq Apollo5 MCU Series

config SOC_SERIES_APOLLO5X
    bool "Apollo5 Series MCU"
    select ARM
    select SOC_FAMILY_AMBIQ
    select HAS_SWO
    select AMBIQ_HAL
    help
      Enable support for Apollo5X MCU series
```

## soc/arm/ambiq/apollo5x/Kconfig.soc
```kconfig
# SPDX-License-Identifier: Apache-2.0
#
# Copyright (c) 2024 Ambiq Micro Inc.

choice
    prompt "Ambiq Apollo5X Selection"
    depends on SOC_SERIES_APOLLO5X

config SOC_APOLLO5
    bool "Apollo5"
    select CPU_CORTEX_M55
    select CPU_CORTEX_M_HAS_DWT
    select CPU_CORTEX_M_HAS_VTOR
    select CPU_HAS_ARM_SAU
    select CPU_HAS_ARM_MPU
    select CPU_HAS_FPU
    select ARMV8_M_DSP
    select ARMV8_1_M_PMU

endchoice

config ARMV8_1_M_PMU_EVENTCNT
    int
    default 8
```

## subsys/logging/backends/Kconfig.ambiq_swo
```kconfig
# Copyright (c) 2021 Nordic Semiconductor ASA
# SPDX-License-Identifier: Apache-2.0

config LOG_BACKEND_AMBIQ_SWO
	bool "Serial Wire Output (SWO) backend"
	depends on HAS_SWO
	select AMBIQ_HAL
	select AMBIQ_HAL_USE_ITM
	select AMBIQ_HAL_USE_TPIU
	select AMBIQ_HAL_USE_DCU
	select PINCTRL
	select LOG_OUTPUT

if LOG_BACKEND_AMBIQ_SWO
config LOG_BACKEND_AMBIQ_SWO_FREQ_HZ
	int "Set SWO output frequency"
	default 1000000
	help
	  Set SWO output frequency. Not all debug probes support high
	  frequency SWO operation. In this case the frequency has to be set
	  manually.

	  SWO value defined by this option will be configured at boot. Most SWO
	  viewer programs will configure SWO frequency when attached to the
	  debug probe. Such configuration will persist only until the device
	  reset. To ensure flawless operation the frequency configured here and
	  by the SWO viewer program has to match.

backend = AMBIQ_SWO
backend-str = ambiq_swo
source "subsys/logging/Kconfig.template.log_format_config"

endif # LOG_BACKEND_AMBIQ_SWO
```

## tests/boot/mcuboot_data_sharing/boards/apollo330mP_evb.conf
```kconfig
# Copyright (c) 2026 Ambiq Micro Inc. <www.ambiq.com>
# SPDX-License-Identifier: Apache-2.0

CONFIG_RETAINED_MEM_ZEPHYR_RAM=y
```

## tests/boot/mcuboot_data_sharing/sysbuild/mcuboot/boards/apollo510_eb.conf
```kconfig
CONFIG_USE_SEGGER_RTT=n
CONFIG_NORDIC_QSPI_NOR=n
CONFIG_BOOT_VALIDATE_SLOT0=n
CONFIG_MCUBOOT_CLEANUP_ARM_CORE=n
CONFIG_BOOT_WATCHDOG_FEED=n

CONFIG_LOG=y
CONFIG_MCUBOOT_LOG_LEVEL_DBG=y
CONFIG_NO_OPTIMIZATIONS=y
CONFIG_MAIN_STACK_SIZE=10240
```

## tests/crypto/mbedtls/boards/apollo510_evb.conf
```kconfig
# Board-specific configuration for apollo510_evb
# Use Ambiq hardware entropy instead of test random generator

# Disable test random generator (software-based)
CONFIG_TEST_RANDOM_GENERATOR=n

# Enable Ambiq PUF TRNG hardware entropy driver
# Note: CSPRNG_ENABLED will be automatically enabled when ENTROPY_HAS_DRIVER is set
CONFIG_ENTROPY_AMBIQ_PUF_TRNG=y

# Ensure mbedtls entropy polling uses Zephyr's entropy API
# (These are typically enabled by default)
CONFIG_MBEDTLS_ENTROPY_C=y
CONFIG_MBEDTLS_ENTROPY_POLL_ZEPHYR=y
```

## tests/drivers/crc/testcase.yaml
```yaml
tests:
  drivers.crc:
    depends_on: crc
    tags:
      - drivers
      - crc
    integration_platforms:
      - apollo510_evb
      - apollo510b_evb
    harness: ztest
```

## tests/drivers/i2s/i2s_api/boards/apollo510_evb.conf
```kconfig
CONFIG_I2S_LOG_LEVEL_OFF=y

CONFIG_I2S_TEST_SEPARATE_DEVICES=n
CONFIG_I2S_TEST_USE_I2S_DIR_BOTH=y
CONFIG_I2S_TEST_ALLOWED_DATA_OFFSET=1
```

## tests/drivers/rtc/rtc_api/boards/apollo4p_evb.conf
```kconfig
# Copyright (c) 2023 Bjarki Arge Andreasen
# SPDX-License-Identifier: Apache-2.0

CONFIG_RTC_ALARM=y
CONFIG_RTC_UPDATE=y
CONFIG_TEST_RTC_ALARM_TIME_MASK=79
CONFIG_NO_OPTIMIZATIONS=y
```

## tests/kernel/context/boards/apollo510dL_evb.conf
```kconfig
# Copyright (c) 2026 Ambiq Micro Inc. <www.ambiq.com>
# SPDX-License-Identifier: Apache-2.0
CONFIG_PM=n
CONFIG_PM_DEVICE=n
```

## tests/kernel/sleep/boards/apollo510_eb.conf
```kconfig
# Copyright (c) 2025 Ambiq Micro Inc. <www.ambiq.com>
# SPDX-License-Identifier: Apache-2.0
CONFIG_SYS_CLOCK_TICKS_PER_SEC=2048
```

## tests/subsys/crc/testcase.yaml
```yaml
tests:
  subsys.crc:
    depends_on: crc
    tags:
      - subsys
      - crc
    integration_platforms:
      - apollo510_evb
      - apollo510b_evb
    harness: ztest
```

## tests/subsys/sd/sdio/testcase.yaml
```yaml
common:
  depends_on: sdhc
  tags: drivers sdhc
tests:
  sd.sdio:
    harness: ztest
    harness_config:
      fixture: fixture_sdhc
    filter: dt_alias_exists("sdhc0")
    tags: sdhc
    min_ram: 32
    integration_platforms:
      - mimxrt1064_evk
  sd.sdio.apollo:
    harness: ztest
    filter: dt_compat_enabled("zephyr,sdmmc-disk")
    tags: sdhc
    min_ram: 32
    integration_platforms:
      - apollo5_eb
```

## tests/subsys/settings/retention/testcase.yaml
```yaml
tests:
  settings.retention:
    platform_allow:
      - nrf52840dk/nrf52840
      - qemu_cortex_m3
      - apollo510_evb
      - apollo510b_evb
      - apollo510L_eb
      - apollo510dL_evb
      - apollo330mP_evb
    min_ram: 8
    tags:
      - settings
      - retention
```
