## CMakeLists.txt
```
# SPDX-License-Identifier: Apache-2.0

cmake_minimum_required(VERSION 3.20.0)

find_package(Zephyr REQUIRED HINTS $ENV{ZEPHYR_BASE})
project(amic)

function(add_prebuilt_library lib_name prebuilt_path)
  add_library(${lib_name} STATIC IMPORTED GLOBAL)
  set_target_properties(${lib_name} PROPERTIES
    IMPORTED_LOCATION ${APPLICATION_SOURCE_DIR}/${prebuilt_path}
  )
  zephyr_link_libraries(${lib_name})
endfunction()

target_sources(app PRIVATE src/main.c)
target_sources(app PRIVATE src/am_vos_thf.c)
target_sources(app PRIVATE src/appAudio.c)

target_include_directories(app PRIVATE lib)

add_prebuilt_library(sensorylib  lib/sensorylib.a)
```

## sample.yaml
```
sample:
  name: AMIC THF sample
tests:
  sample.drivers.audio.dmic:
    tags: amic
    filter: dt_nodelabel_enabled("amic_dev")
    integration_platforms:
      - apollo510_evb
    harness: console
    harness_config:
      type: multi_line
      ordered: true
      regex:
        - "AMIC THF sample"
        - "Exiting"
```

## prj.conf
```kconfig
CONFIG_FPU=y
CONFIG_MAIN_STACK_SIZE=2048

CONFIG_AUDIO=y
CONFIG_AUDIO_AMIC=y

CONFIG_LOG=y
```

## src/main.c
```c
/*
 * Copyright (c) 2025 Ambiq Micro Inc.
 *
 * SPDX-License-Identifier: Apache-2.0
 */

#include <zephyr/kernel.h>
#include <zephyr/audio/amic.h>

#include <zephyr/logging/log.h>

#include "SensoryLib.h"
#include "am_vos_thf.h"

LOG_MODULE_REGISTER(amic_sample);

#define SAMPLE_RATE  16000
#define BYTES_PER_SAMPLE sizeof(int16_t)
/* Milliseconds to wait for a block to be read. */
#define READ_TIMEOUT     1000

/* AUDADC is 1 channel supported only */
#define NUMBER_OF_CHANNELS	1
#define SAMPLE_BIT_WIDTH (16 * NUMBER_OF_CHANNELS)

/* Size of a block for 15 ms of audio data. */
#define BLOCK_SIZE(_sample_rate, _number_of_channels) \
	(BYTES_PER_SAMPLE * (_sample_rate / 200) * 3 * _number_of_channels)

/* Driver will allocate blocks from this slab to receive audio data into them.
 * Application, after getting a given block from the driver and processing its
 * data, needs to free that block.
 */
#define BLOCK_SIZE_BYTES   BLOCK_SIZE(SAMPLE_RATE, NUMBER_OF_CHANNELS)
#define BLOCK_COUNT      4
K_MEM_SLAB_DEFINE_STATIC(mem_slab, BLOCK_SIZE_BYTES, BLOCK_COUNT, 4);

static int do_audadc_transfer(const struct device *amic_dev,
			   struct amic_cfg *cfg,
			   size_t block_count)
{
	int ret;

	LOG_INF("PCM output rate: %u, channels: %u",
		cfg->streams[0].pcm_rate, 1);

	ret = amic_configure(amic_dev, cfg);
	if (ret < 0) {
		LOG_ERR("Failed to configure the driver: %d", ret);
		return ret;
	}

	ret = amic_trigger(amic_dev, AMIC_TRIGGER_START);
	if (ret < 0) {
		LOG_ERR("START trigger failed: %d", ret);
		return ret;
	}

	while (1) {
		void *buffer;
		uint32_t size;
        uint8_t detected_flag = 0;

		ret = amic_read(amic_dev, 0, &buffer, &size, READ_TIMEOUT);
		if (ret < 0) {
			LOG_ERR("Read failed: %d", ret);
			return ret;
		}

        if(detected_flag == 0)
        {
            am_vos_engine_process(buffer, size, &detected_flag);
        }
        else
        {
            detected_flag++;
            if(detected_flag > 100)
            {
                detected_flag = 0;
            }
        }

		k_mem_slab_free(&mem_slab, buffer);
	}

	ret = amic_trigger(amic_dev, AMIC_TRIGGER_STOP);
	if (ret < 0) {
		LOG_ERR("STOP trigger failed: %d", ret);
		return ret;
	}

	return ret;
}

int main(void)
{
	const struct device *const amic_dev = DEVICE_DT_GET(DT_NODELABEL(amic_dev));
	int ret;

	LOG_INF("AMIC THF sample");

	if (!device_is_ready(amic_dev)) {
		LOG_ERR("%s is not ready", amic_dev->name);
		return 0;
	}

	struct pcm_stream_cfg stream = {
		.pcm_width = SAMPLE_BIT_WIDTH,
		.mem_slab  = &mem_slab,
	};
	struct amic_cfg cfg = {
		.streams = &stream,
	};

    am_vos_engine_init();

	cfg.streams[0].pcm_rate = SAMPLE_RATE;
	cfg.streams[0].block_size = BLOCK_SIZE_BYTES;

	ret = do_audadc_transfer(amic_dev, &cfg, 2 * BLOCK_COUNT);
	if (ret < 0) {
		return 0;
	}

	LOG_INF("Exiting");
	return 0;
}
```

## src/am_vos_thf.c
```c
//*****************************************************************************
//
//! @file am_vos_thf.c
//!
//! @brief Sensory THF engine control
//
//*****************************************************************************

//*****************************************************************************
//
// ${copyright}
//
// This is part of revision ${version} of the AmbiqSuite Development Package.
//
//*****************************************************************************

#include <stdio.h>
#include <string.h>
#include <stdbool.h>

#include <zephyr/kernel.h>

#include <zephyr/logging/log.h>

#include "SensoryLib.h"
#include "am_vos_thf.h"

LOG_MODULE_REGISTER(am_vos_thf);

//    #include "thfft_alexa_enus_v3c_dsp_64kb_pc40\thfft_alexa_enus_v3c_dsp_64kb_search_2_pc40.c"
#include "thfft_alexa_enus_v3c_dsp_64kb_search_4_pc40.c"
#include "thfft_alexa_enus_v3c_dsp_64kb_am_pc40.c"

#define CURRENT_SDET            SDET_NONE
#define configUSE_THF_Static_Alloc  1

#define TRIGGER_DELAY 	        240 	        // override trigger grammar delay value to find end of trigger
                                                // with more accuracy

#define COMMAND_DELAY           0   	        // command delay: use grammar value
#define COMMAND_TIMEOUT         3 		// 5 seconds after trigger to say the command

#if configUSE_THF_Logging
#define SENSORY_LOG_ITEMS       200
#endif // configUSE_THF_Logging

#if configUSE_THF_Static_Alloc
    #define THF_STATIC_MEM_SIZE     24 * 1024
#endif // configUSE_THF_Static_Alloc


//***********************************************************************
// Global Sensory Instance
//***********************************************************************
typedef struct _VosThfInfo {
    appStruct_T         sAppStruct;
    uint32_t            ui32DetectCount;

#if AUDIO_BUFFER_LEN > 0
    SAMPLE              pin16AudioBuffer[AUDIO_BUFFER_LEN];
#endif

#if configUSE_THF_Logging
    SENSORY_LOG_OBJ     psSensoryLog[SENSORY_LOG_ITEMS];
#endif // configUSE_THF_Logging

#if configUSE_THF_Static_Alloc
    uint8_t             pui8ThfHeap[THF_STATIC_MEM_SIZE];
#endif // configUSE_THF_Static_Alloc
} VosThfInfo;

VosThfInfo g_sVosThf = {
    .ui32DetectCount = 0,

#if configUSE_THF_Static_Alloc
    .pui8ThfHeap = {0,},
#endif // configUSE_THF_Static_Alloc
};

// configure t2siStruct with recognition parameters
// allocate memory for Sensory Persistent structure
// initialize audio buffer parameters
// initialized LPSD
// initialize recognizer via call to SensoryProcessInit

errors_t SensoryInitialize(void)
{
    unsigned int ww_spp_size = 0; // size of spp
    unsigned int cmd_spp_size = 0;

    errors_t result;

    appStruct_T *ap = &(g_sVosThf.sAppStruct);
    t2siStruct *t = &ap->_t;

    // Set up recognition control parameters in the t2siStruct.
    // NOTE: t->net, gram, maxResults and maxTokens affect the amount of memory needed
    // (which will be calculated by the call to SensoryAlloc).

    // Here we zero out appStruct including embedded t2siStruct.
    // Warning: if you do this after the persistent structure is malloc'd you will
    // overwrite the pointer without freeing the structure.

    memset(ap, 0, sizeof(*ap));

    t->maxResults = MAX_RESULTS;
    t->maxTokens  = MAX_TOKENS;

    t->sdet_type = CURRENT_SDET; // SDET_NONE or SDET_LPSD
    t->knob = T2SI_DEFAULT_KNOB;
    t->paramAOffset = 0;
    t->enableLogging = 0;   // default is enabling logging

#if configUSE_THF_Logging
    if (t->enableLogging)
    {
        SensoryLogInit(ap, g_sVosThf.psSensoryLog, SENSORY_LOG_ITEMS);
        SensoryLog(t, SENSORY_LOG_RESET,0,0);
    }
#endif // configUSE_THF_Logging

#if AUDIO_BUFFER_LEN > 0
    // initialize audio buffer items. Do this before calling SensoryLPSDInit.
    ap->audioBufferLen = AUDIO_BUFFER_LEN;
    // if not using malloc for the audio buffer, just point audioBufferStart to the statically
    // allocated audio buffer.

    ap->audioBufferStart = g_sVosThf.pin16AudioBuffer;
    ap->audioPutIndex = ap->audioGetIndex = ap->lpsdGetIndex = 0;
    ap->audioGetFrameCounter = 0;
    ap->audioFilledCount = 0;

    // Initialize Sound Detector (OK to do this even for SDET_NONE)
    // Do this after setting up the audio buffer items in appStruct.  You will want to
    // call SensoryProcessInit after this, before the next call to SensoryProcessData
//        SensoryLPSDInit(ap);
#endif

    t->delay = TRIGGER_DELAY;
    t->timeout = 0;

    t->net  = (u32)dnn_wakeword_netLabel;
    t->gram = (u32)gs_wakeword_grammarLabel;

    SensoryAlloc (&(g_sVosThf.sAppStruct), &ww_spp_size);               // Note: need to call SensoryAlloc() to set one library internal variable with calculated size whenever different net and gram are used
    LOG_INF("[AM-VoS] THF spp ww_spp_size = %d bytes\n", ww_spp_size);

    // allocate the persistent structure memory
    if(ww_spp_size > THF_STATIC_MEM_SIZE) {
        LOG_INF("[AM-VoS] THF heap memory is not enough!!\n", ww_spp_size);
        return ERR_NOT_OK;
    }
    t->spp = g_sVosThf.pui8ThfHeap;
    
    result = SensoryProcessInit(ap);
    if (result)
    {
        return ERR_NOT_OK;   // error!
    }

    return 0;
}

// free the Sensory persistent structure
errors_t SensoryTerminate()
{
    appStruct_T *ap = &(g_sVosThf.sAppStruct);
    t2siStruct *t = &ap->_t;

#if configUSE_THF_Static_Alloc
    t->spp = NULL;
#else // configUSE_THF_Static_Alloc
    if (t->spp) {
        vPortFree(t->spp);
        t->spp = NULL;
    }
#endif // configUSE_THF_Static_Alloc
    return 0;
}

uint8_t am_vos_engine_init(void)
{
    if(SensoryInitialize())  // load alexa net and grammar as a default
    {
        LOG_INF("Sensory THF init fail!!\n");
        return 1;
    }

    return 0;
}


// A new brick of samples is available to be processed through the recognizer
// This function returns the result from SensoryProcessData().
//extern appStruct_T appStruct; 
static errors_t SensoryProcessBrick(s16 *brick, appStruct_T *ap, bool bFaEnabled)
{
    errors_t result;
    //appStruct_T *ap = &appStruct;
    t2siStruct *t = &ap->_t;

    result = SensoryProcessData(brick, ap);

    // optionally print a warning message if the recognizer ran out of token memory.
    // if this happens you need to increase the MAX_TOKENS parameter in SensoryLib.h.
    if (t->outOfMemory) {
        //am_util_stdio_printf("Error: Out of Token Memory\n");
        t->outOfMemory = 0;
    }

    if (result == ERR_OK) {
        if (t->wordID && ((!t->nnpqScore && !t->nnpqThreshold && !t->nnpqPass) || ((t->nnpqScore>0) && t->nnpqPass)))	{ // non-nnpq mode or nnpq mode passing score check
            //am_util_stdio_printf("Recognition***** wordID = %d, score = %d\n", t->wordID, t->finalScore);
            //if (t->svScore >= 0) am_util_stdio_printf("SV score = %ld\n", t->svScore);
            //if (t->nnpqPass) am_util_stdio_printf("NNPQ score= %d, NNPQ threshold= %d, NNPQ check pass= %d\n", t->nnpqScore, t->nnpqThreshold, t->nnpqPass);

            // optional: find end-point index in audio buffer where recognition was decided (epIndex)
            // and also the number of samples in the audio buffer after that point (tailCount)
            // which should correspond to the latency between the end of the trigger phrase and the recognition
            // decision.
#if configUSE_THF_Logging
            if (t->enableLogging) SensoryPrintLog(ap);
#endif
            //result = ERR_OK;
        }
        else {
            if(bFaEnabled)
            {
                result = ERR_RECOG_FAIL;
                //am_util_stdio_printf("Not recognized\n");
            }
        }
    
        SensoryProcessRestart(ap);  // restart recognizer
    }
    else if (result != ERR_NOT_FINISHED) {
        //am_util_stdio_printf("SensoryProcessData error 0x%lx, wordID= %d\n", result, t->wordID);
        SensoryProcessInit(ap);  // reset recognizer
    }
    return result;
}

void am_vos_engine_process(int16_t *frame, int16_t i16InputLength, uint8_t *pui8KwdDetectedFlag)
{
    errors_t result = ERR_NOT_FINISHED;
    appStruct_T *ap = &(g_sVosThf.sAppStruct);

    t2siStruct *t = &ap->_t;
    unsigned int size;

    result = SensoryProcessBrick(frame, ap, false);
    if(result == ERR_OK)
    {
        *pui8KwdDetectedFlag = 1;

        LOG_INF("\n[AM-VoS] Keyword Detected! [%d] [%d]", t->wordID, ++g_sVosThf.ui32DetectCount);
    }
}
```

## src/appAudio.c
```c
/*
 * File      : appAudio.c
 * Purpose   : App level audio buffering routines
 * Project   : T2SI "time slice" architecture 
 * Compiler  : PC/embedded platforms
 *
 * Copyright (C) 1995-2022 Sensory Inc., All Rights Reserved                             
 *
 * ******* SENSORY CONFIDENTIAL *************
 *
 *****************************************************************************
*/

#include <stdio.h>
#include <stdlib.h>
#include <string.h>

#include "SensoryLib.h"


BOOL AppAudioFrameReady(appStruct_T *ap)
{
    AUDIOINDEX scnt = ap->audioPutIndex - ap->audioGetIndex;
    if (scnt < 0) scnt += ap->audioBufferLen;
    return scnt >= FRAME_LEN ? 1 : 0;
}

AUDIOINDEX AppAudioNumUnprocessedSamples(appStruct_T *ap)
{
    AUDIOINDEX scnt = ap->audioPutIndex - ap->audioGetIndex;
    if (scnt < 0) scnt += ap->audioBufferLen;
    return scnt;
}

BOOL AppAudioLPSDDecreasePowerMode(void)
{
	//Not running recognizer. Can lower clock frequency.
	return 0;
}

BOOL AppAudioLPSDIncreasePowerMode(void)
{
	//Will start to run recognizer. Need to increase clock frequency.
	return 0;
	//0=will not skip any processing
	//1=will skip extra processing for this frame (need an extra frame to start frontend processing)
}

// NB: this code currently assumes the audio buffer is an integral multiple of FRAME_LEN.
// If audioBufferLen is zero,  then audioBufferStart will point to the start of the brick.

BOOL AppAudioGetFrame(appStruct_T *ap, s16 startOffset, s16 count, SAMPLE *dst)
{
    if (count) {
        AUDIOINDEX scnt; //, gindex;
        
        scnt = ap->audioPutIndex - ap->audioGetIndex;
        if (scnt < 0) scnt += ap->audioBufferLen;

        if (scnt < FRAME_LEN)  
            return 0;  

        memcpy(dst, ap->audioBufferStart+ap->audioGetIndex+startOffset, count*sizeof(s16));

	}

    ap->audioGetIndex += FRAME_LEN;
    if (ap->audioGetIndex >= ap->audioBufferLen)
        ap->audioGetIndex = 0;

    ap->audioGetFrameCounter++;  
    return 1;
}

// Convert input audio of type BRICK_SAMPLE to brickSize x samples of type SAMPLE (s16).

// Appropriate activity at this point may include:
// DC block, scaling or agc, resizing to s16 from s24 or larger, downsampling to 16KHz etc.

// NB: this code currently assumes that the audio buffer is an integral multiple of brickSize samples.

void AppAudioStoreBrick(appStruct_T *ap, BRICK_SAMPLE *brick, s16 brickSize) 
{
#ifdef USE_SENSORY_DCBLOCK
    if (ap->audioBufferLen == 0) {
        SensoryDcBlock(ap, (SAMPLE *)brick, (SAMPLE *)brick, brickSize);
        ap->audioBufferStart = brick;
        ap->audioGetIndex = 0;
        ap->audioPutIndex = ap->audioFilledCount = brickSize;
        return;
    }

    SensoryDcBlock(ap, (SAMPLE *)brick, ap->audioBufferStart+ap->audioPutIndex, brickSize);
#else
    if (ap->audioBufferLen == 0) {
        ap->audioBufferStart = brick;
        ap->audioGetIndex = 0;
        ap->audioPutIndex = ap->audioFilledCount = brickSize;
        return;
    }
    else
		memcpy(ap->audioBufferStart+ap->audioPutIndex, brick, brickSize*sizeof(s16));
#endif
    ap->audioPutIndex += brickSize;
    if (ap->audioPutIndex >= ap->audioBufferLen)  
        ap->audioPutIndex = 0; 

    ap->audioFilledCount += brickSize;
    if (ap->audioFilledCount > ap->audioBufferLen)
        ap->audioFilledCount = ap->audioBufferLen;
}

// Sensory logging feature
#if configUSE_THF_Logging
/******************************************************************************
* Function Name : SensoryLogInit
* Parameters    : 
* log:			: Pass the logging buffer of data type of SENSORY_LOG_OBJ 
* n				: Size of the logging buffer
* Comment       : Called once to initialize logging variables
******************************************************************************/
void SensoryLogInit(appStruct_T *app, SENSORY_LOG_OBJ *log, int n)
{
    t2siStruct *t = &app->_t;
    t->sensoryLogIndex = 0;
    t->sensoryNumLogItems = n;
    t->sensoryLogStart = log;
    t->sensoryLogFull = 0;
}

/******************************************************************************
* Function Name : SensoryLog
* Parameters    : 
* event:		: Underlying logging event.
* a, b			: Underlying logging event's two arguments
* Comment       : Save the underlying logging function calls into the logging buffer
******************************************************************************/
void SensoryLog(t2siStruct *t, int event, int a, int b)
{
    if (!t->sensoryLogStart) return;

    if (t->sensoryLogIndex < t->sensoryNumLogItems) 
    {
        int sensoryLogIndex = t->sensoryLogIndex;
        SENSORY_LOG_OBJ *sensoryLogStart = t->sensoryLogStart;
        
        sensoryLogStart[sensoryLogIndex].event = event;
        sensoryLogStart[sensoryLogIndex].frameCount = 0; //sensoryFrameCounter;
        sensoryLogStart[sensoryLogIndex].a = a;
        sensoryLogStart[sensoryLogIndex].b = b;
        t->sensoryLogIndex++;
    }
    if (t->sensoryLogIndex >= t->sensoryNumLogItems) 
        t->sensoryLogFull = 1;
    
}

#define NO_LOGGING_PRINT
#ifdef NO_LOGGING_PRINT
void SensoryPrintLog(appStruct_T *app){};
#else
void SensoryPrintLog(appStruct_T *app)
{
    t2siStruct *t = &app->_t;
    int sensoryLogIndex = t->sensoryLogIndex;
    int i;
    SENSORY_LOG_OBJ *sensoryLogStart = t->sensoryLogStart;
    
    AM_VOS_LOG_INFO("\nSensory Log\n");
    if (t->sensoryLogFull) AM_VOS_LOG_INFO("**full**\n");
    for (i=0; i < sensoryLogIndex; i++) {
        //printf("frame %6d %3d 0x%06x 0x%06x ", 
        AM_VOS_LOG_INFO("%6d %3d %6d %6d ",
                sensoryLogStart[i].frameCount, \
                sensoryLogStart[i].event,\
                sensoryLogStart[i].a, sensoryLogStart[i].b);

        switch (sensoryLogStart[i].event) {
        case SENSORY_LOG_RESET:  AM_VOS_LOG_INFO("RESET"); break;
        case SENSORY_LOG_INIT: AM_VOS_LOG_INFO("INIT result = %d", sensoryLogStart[i].a); break;
        case SENSORY_LOG_AUDIO_OVERFLOW: AM_VOS_LOG_INFO("AUDIO OVERFLOW"); break;
        case SENSORY_LOG_OUT_OF_MEMORY: AM_VOS_LOG_INFO("OUT OF MEMORY"); break;
        case SENSORY_LOG_LPSD_ABOVE_T:  AM_VOS_LOG_INFO("LPSD +++ getting data from frame %d",
												sensoryLogStart[i].frameCount - sensoryLogStart[i].a);
			break;
        case SENSORY_LOG_LPSD_BELOW_T:  AM_VOS_LOG_INFO("LPSD --- getting data from frame %d",
												sensoryLogStart[i].frameCount - sensoryLogStart[i].a);
			break;
        case SENSORY_LOG_WS_PASS: AM_VOS_LOG_INFO("  WS pass word %d score %d", sensoryLogStart[i].a, sensoryLogStart[i].b); 
			break;
        case SENSORY_LOG_DPP: AM_VOS_LOG_INFO("  DPP dur score = %d adjusted score = %d", sensoryLogStart[i].a, sensoryLogStart[i].b); 
			break;
        case SENSORY_LOG_EPQ: AM_VOS_LOG_INFO("  EPQ %s minSNR = %d ", sensoryLogStart[i].a ? "PASS" : "FAIL", sensoryLogStart[i].b); 
			break;
        case SENSORY_LOG_RECOG: AM_VOS_LOG_INFO("*** RECOG word %d  Samsung word %d", sensoryLogStart[i].a, sensoryLogStart[i].b); 
			break;
        case SENSORY_LOG_SCORES: AM_VOS_LOG_INFO("    SCORES finalScore %d  svScore %d", sensoryLogStart[i].a, sensoryLogStart[i].b); 
            break;
		}

        AM_VOS_LOG_INFO("\n");
    }
}
#endif //NO_LOGGING_PRINT
#endif
```

## src/thfft_alexa_enus_v3c_dsp_64kb_search_4_pc40.h
```c
/* Speech Recognition HMM Grammar Vocabulary Description file */
/* Copyright (C) 2003-2016 Sensory, Inc. All Rights Reserved. */
/* Generated on Wed Dec 12 22:28:23 2018
 */
/********* Sensory Confidential **********/

extern u32 gs_grammarLabel;
#ifndef NETLABEL
#define NETLABEL
extern u32 nn_netLabel;
#endif
#define G_grammarLabel_SILENCE                   (0)
#define G_grammarLabel_alexa                     (1)
#define G_grammarLabel_nota                      (2)
```
