## CMakeLists.txt
```
# SPDX-License-Identifier: Apache-2.0

cmake_minimum_required(VERSION 3.20.0)

find_package(Zephyr REQUIRED HINTS $ENV{ZEPHYR_BASE})
project(dmic)

function(add_prebuilt_library lib_name prebuilt_path)
  add_library(${lib_name} STATIC IMPORTED GLOBAL)
  set_target_properties(${lib_name} PROPERTIES
    IMPORTED_LOCATION ${APPLICATION_SOURCE_DIR}/${prebuilt_path}
  )
  zephyr_link_libraries(${lib_name})
endfunction()

target_sources(app PRIVATE src/main.c)
target_sources(app PRIVATE src/am_vos_thf.c)
target_sources(app PRIVATE src/appAudio.c)

target_include_directories(app PRIVATE lib)

add_prebuilt_library(sensorylib  lib/sensorylib.a)
```

## prj.conf
```kconfig
CONFIG_FPU=y
CONFIG_MAIN_STACK_SIZE=2048

CONFIG_AUDIO=y
CONFIG_AUDIO_DMIC=y

CONFIG_LOG=y
```

## src/main.c
```c
/*
 * Copyright (c) 2021 Nordic Semiconductor ASA
 *
 * SPDX-License-Identifier: Apache-2.0
 */

#include <zephyr/kernel.h>
#include <zephyr/audio/dmic.h>

#include <zephyr/logging/log.h>

#include "SensoryLib.h"
#include "am_vos_thf.h"

LOG_MODULE_REGISTER(dmic_sample);

#define MAX_SAMPLE_RATE  16000
#define SAMPLE_BIT_WIDTH 16
#define BYTES_PER_SAMPLE sizeof(int16_t)
/* Milliseconds to wait for a block to be read. */
#define READ_TIMEOUT     1000

/* Size of a block for 15 ms of audio data. */
#define BLOCK_SIZE(_sample_rate, _number_of_channels) \
	(BYTES_PER_SAMPLE * (_sample_rate / 200) * 3 * _number_of_channels)

/* Driver will allocate blocks from this slab to receive audio data into them.
 * Application, after getting a given block from the driver and processing its
 * data, needs to free that block.
 */
#define MAX_BLOCK_SIZE   BLOCK_SIZE(MAX_SAMPLE_RATE, 2)
#define BLOCK_COUNT      4
K_MEM_SLAB_DEFINE_STATIC(mem_slab, MAX_BLOCK_SIZE, BLOCK_COUNT, 4);

static int do_pdm_transfer(const struct device *dmic_dev,
			   struct dmic_cfg *cfg,
			   size_t block_count)
{
	int ret;

    LOG_INF("PCM output rate: %u, channels: %u",
		cfg->streams[0].pcm_rate, cfg->channel.req_num_chan);

	ret = dmic_configure(dmic_dev, cfg);
	if (ret < 0) {
		LOG_ERR("Failed to configure the driver: %d", ret);
		return ret;
	}

	ret = dmic_trigger(dmic_dev, DMIC_TRIGGER_START);
	if (ret < 0) {
		LOG_ERR("START trigger failed: %d", ret);
		return ret;
	}

//	for (int i = 0; i < block_count; ++i) {
	while (1) {
		void *buffer;
		uint32_t size;
        uint8_t detected_flag = 0;

        ret = dmic_read(dmic_dev, 0, &buffer, &size, READ_TIMEOUT);
        // if (ret < 0) {
		// 	LOG_ERR("%d - read failed: %d", i, ret);
		// 	return ret;
		// }

#if 1
        if(detected_flag == 0)
        {
            am_vos_engine_process(buffer, size, &detected_flag);
        }
        else
        {
            detected_flag++;
            if(detected_flag > 100)
            {
                detected_flag = 0;
            }
        }
#endif

		k_mem_slab_free(&mem_slab, buffer);
//        k_sleep(K_MSEC(3));
	}

	ret = dmic_trigger(dmic_dev, DMIC_TRIGGER_STOP);
	if (ret < 0) {
		LOG_ERR("STOP trigger failed: %d", ret);
		return ret;
	}

	return ret;
}

int main(void)
{
	const struct device *const dmic_dev = DEVICE_DT_GET(DT_NODELABEL(dmic_dev));
	int ret;

	LOG_INF("DMIC sample");

	if (!device_is_ready(dmic_dev)) {
		LOG_ERR("%s is not ready", dmic_dev->name);
		return 0;
	}

	struct pcm_stream_cfg stream = {
		.pcm_width = SAMPLE_BIT_WIDTH,
		.mem_slab  = &mem_slab,
	};
	struct dmic_cfg cfg = {
		.io = {
			/* These fields can be used to limit the PDM clock
			 * configurations that the driver is allowed to use
			 * to those supported by the microphone.
			 */
			.min_pdm_clk_freq = 1000000,
			.max_pdm_clk_freq = 3500000,
			.min_pdm_clk_dc   = 40,
			.max_pdm_clk_dc   = 60,
		},
		.streams = &stream,
		.channel = {
			.req_num_streams = 1,
		},
	};

    am_vos_engine_init();

	cfg.channel.req_num_chan = 1;
	cfg.channel.req_chan_map_lo =
		dmic_build_channel_map(0, 0, PDM_CHAN_LEFT);
	cfg.streams[0].pcm_rate = MAX_SAMPLE_RATE;
	cfg.streams[0].block_size =
		BLOCK_SIZE(cfg.streams[0].pcm_rate, cfg.channel.req_num_chan);

	ret = do_pdm_transfer(dmic_dev, &cfg, 2 * BLOCK_COUNT);
	if (ret < 0) {
		return 0;
	}

	cfg.channel.req_num_chan = 2;
	cfg.channel.req_chan_map_lo =
		dmic_build_channel_map(0, 0, PDM_CHAN_LEFT) |
		dmic_build_channel_map(1, 0, PDM_CHAN_RIGHT);
	cfg.streams[0].pcm_rate = MAX_SAMPLE_RATE;
	cfg.streams[0].block_size =
		BLOCK_SIZE(cfg.streams[0].pcm_rate, cfg.channel.req_num_chan);

	ret = do_pdm_transfer(dmic_dev, &cfg, 2 * BLOCK_COUNT);
	if (ret < 0) {
		return 0;
	}

	LOG_INF("Exiting");
	return 0;
}
```

## src/am_vos_thf.c
```c
//*****************************************************************************
//
//! @file am_vos_thf.c
//!
//! @brief Sensory THF engine control
//
//*****************************************************************************

//*****************************************************************************
//
// ${copyright}
//
// This is part of revision ${version} of the AmbiqSuite Development Package.
//
//*****************************************************************************

#include <stdio.h>
#include <string.h>
#include <stdbool.h>

#include <zephyr/kernel.h>

#include <zephyr/logging/log.h>

#include "SensoryLib.h"
#include "am_vos_thf.h"

LOG_MODULE_REGISTER(am_vos_thf);

//    #include "thfft_alexa_enus_v3c_dsp_64kb_pc40\thfft_alexa_enus_v3c_dsp_64kb_search_2_pc40.c"
#include "thfft_alexa_enus_v3c_dsp_64kb_search_4_pc40.c"
#include "thfft_alexa_enus_v3c_dsp_64kb_am_pc40.c"

#define CURRENT_SDET            SDET_NONE
#define configUSE_THF_Static_Alloc  1

#define TRIGGER_DELAY 	        240 	        // override trigger grammar delay value to find end of trigger
                                                // with more accuracy

#define COMMAND_DELAY           0   	        // command delay: use grammar value
#define COMMAND_TIMEOUT         3 		// 5 seconds after trigger to say the command

#if configUSE_THF_Logging
#define SENSORY_LOG_ITEMS       200
#endif // configUSE_THF_Logging

#if configUSE_THF_Static_Alloc
    #define THF_STATIC_MEM_SIZE     24 * 1024
#endif // configUSE_THF_Static_Alloc


//***********************************************************************
// Global Sensory Instance
//***********************************************************************
typedef struct _VosThfInfo {
    appStruct_T         sAppStruct;
    uint32_t            ui32DetectCount;

#if AUDIO_BUFFER_LEN > 0
    SAMPLE              pin16AudioBuffer[AUDIO_BUFFER_LEN];
#endif

#if configUSE_THF_Logging
    SENSORY_LOG_OBJ     psSensoryLog[SENSORY_LOG_ITEMS];
#endif // configUSE_THF_Logging

#if configUSE_THF_Static_Alloc
    uint8_t             pui8ThfHeap[THF_STATIC_MEM_SIZE];
#endif // configUSE_THF_Static_Alloc
} VosThfInfo;

VosThfInfo g_sVosThf = {
    .ui32DetectCount = 0,

#if configUSE_THF_Static_Alloc
    .pui8ThfHeap = {0,},
#endif // configUSE_THF_Static_Alloc
};

// configure t2siStruct with recognition parameters
// allocate memory for Sensory Persistent structure
// initialize audio buffer parameters
// initialized LPSD
// initialize recognizer via call to SensoryProcessInit

errors_t SensoryInitialize(void)
{
    unsigned int ww_spp_size = 0; // size of spp

    errors_t result;

    appStruct_T *ap = &(g_sVosThf.sAppStruct);
    t2siStruct *t = &ap->_t;

    // Set up recognition control parameters in the t2siStruct.
    // NOTE: t->net, gram, maxResults and maxTokens affect the amount of memory needed
    // (which will be calculated by the call to SensoryAlloc).

    // Here we zero out appStruct including embedded t2siStruct.
    // Warning: if you do this after the persistent structure is malloc'd you will
    // overwrite the pointer without freeing the structure.

    memset(ap, 0, sizeof(*ap));

    t->maxResults = MAX_RESULTS;
    t->maxTokens  = MAX_TOKENS;

    t->sdet_type = CURRENT_SDET; // SDET_NONE or SDET_LPSD
    t->knob = T2SI_DEFAULT_KNOB;
    t->paramAOffset = 0;
    t->enableLogging = 0;   // default is enabling logging

#if configUSE_THF_Logging
    if (t->enableLogging)
    {
        SensoryLogInit(ap, g_sVosThf.psSensoryLog, SENSORY_LOG_ITEMS);
        SensoryLog(t, SENSORY_LOG_RESET,0,0);
    }
#endif // configUSE_THF_Logging

#if AUDIO_BUFFER_LEN > 0
    // initialize audio buffer items. Do this before calling SensoryLPSDInit.
    ap->audioBufferLen = AUDIO_BUFFER_LEN;
    // if not using malloc for the audio buffer, just point audioBufferStart to the statically
    // allocated audio buffer.

    ap->audioBufferStart = g_sVosThf.pin16AudioBuffer;
    ap->audioPutIndex = ap->audioGetIndex = ap->lpsdGetIndex = 0;
    ap->audioGetFrameCounter = 0;
    ap->audioFilledCount = 0;

    // Initialize Sound Detector (OK to do this even for SDET_NONE)
    // Do this after setting up the audio buffer items in appStruct.  You will want to
    // call SensoryProcessInit after this, before the next call to SensoryProcessData
//        SensoryLPSDInit(ap);
#endif

    t->delay = TRIGGER_DELAY;
    t->timeout = 0;

    t->net  = (u32)dnn_wakeword_netLabel;
    t->gram = (u32)gs_wakeword_grammarLabel;

    SensoryAlloc (&(g_sVosThf.sAppStruct), &ww_spp_size);               // Note: need to call SensoryAlloc() to set one library internal variable with calculated size whenever different net and gram are used
    LOG_INF("[AM-VoS] THF spp ww_spp_size = %d bytes\n", ww_spp_size);

    // allocate the persistent structure memory
    if(ww_spp_size > THF_STATIC_MEM_SIZE) {
        LOG_INF("[AM-VoS] THF heap memory is not enough!! %d\n", ww_spp_size);
        return ERR_NOT_OK;
    }
    t->spp = g_sVosThf.pui8ThfHeap;
    
    result = SensoryProcessInit(ap);
    if (result)
    {
        return ERR_NOT_OK;   // error!
    }

    return 0;
}

// free the Sensory persistent structure
errors_t SensoryTerminate()
{
    appStruct_T *ap = &(g_sVosThf.sAppStruct);
    t2siStruct *t = &ap->_t;

#if configUSE_THF_Static_Alloc
    t->spp = NULL;
#else // configUSE_THF_Static_Alloc
    if (t->spp) {
        vPortFree(t->spp);
        t->spp = NULL;
    }
#endif // configUSE_THF_Static_Alloc
    return 0;
}

uint8_t am_vos_engine_init(void)
{
    if(SensoryInitialize())  // load alexa net and grammar as a default
    {
        LOG_INF("Sensory THF init fail!!\n");
        return 1;
    }

    return 0;
}


// A new brick of samples is available to be processed through the recognizer
// This function returns the result from SensoryProcessData().
//extern appStruct_T appStruct; 
static errors_t SensoryProcessBrick(s16 *brick, appStruct_T *ap, bool bFaEnabled)
{
    errors_t result;
    //appStruct_T *ap = &appStruct;
    t2siStruct *t = &ap->_t;

    result = SensoryProcessData(brick, ap);

    // optionally print a warning message if the recognizer ran out of token memory.
    // if this happens you need to increase the MAX_TOKENS parameter in SensoryLib.h.
    if (t->outOfMemory) {
        //am_util_stdio_printf("Error: Out of Token Memory\n");
        t->outOfMemory = 0;
    }

    if (result == ERR_OK) {
        if (t->wordID && ((!t->nnpqScore && !t->nnpqThreshold && !t->nnpqPass) || ((t->nnpqScore>0) && t->nnpqPass)))	{ // non-nnpq mode or nnpq mode passing score check
            //am_util_stdio_printf("Recognition***** wordID = %d, score = %d\n", t->wordID, t->finalScore);
            //if (t->svScore >= 0) am_util_stdio_printf("SV score = %ld\n", t->svScore);
            //if (t->nnpqPass) am_util_stdio_printf("NNPQ score= %d, NNPQ threshold= %d, NNPQ check pass= %d\n", t->nnpqScore, t->nnpqThreshold, t->nnpqPass);

            // optional: find end-point index in audio buffer where recognition was decided (epIndex)
            // and also the number of samples in the audio buffer after that point (tailCount)
            // which should correspond to the latency between the end of the trigger phrase and the recognition
            // decision.
#if configUSE_THF_Logging
            if (t->enableLogging) SensoryPrintLog(ap);
#endif
            //result = ERR_OK;
        }
        else {
            if(bFaEnabled)
            {
                result = ERR_RECOG_FAIL;
                //am_util_stdio_printf("Not recognized\n");
            }
        }
    
        SensoryProcessRestart(ap);  // restart recognizer
    }
    else if (result != ERR_NOT_FINISHED) {
        //am_util_stdio_printf("SensoryProcessData error 0x%lx, wordID= %d\n", result, t->wordID);
        SensoryProcessInit(ap);  // reset recognizer
    }
    return result;
}

void am_vos_engine_process(int16_t *frame, int16_t i16InputLength, uint8_t *pui8KwdDetectedFlag)
{
    errors_t result = ERR_NOT_FINISHED;
    appStruct_T *ap = &(g_sVosThf.sAppStruct);

    t2siStruct *t = &ap->_t;

    result = SensoryProcessBrick(frame, ap, false);
    if(result == ERR_OK)
    {
        *pui8KwdDetectedFlag = 1;

        LOG_INF("\n[AM-VoS] Keyword Detected! [%d] [%d]", t->wordID, ++g_sVosThf.ui32DetectCount);
    }
}
```

## src/thfft_alexa_enus_v3c_dsp_64kb_search_4_pc40.c
```c
/* Speech Recognition HMM Grammar file V40 for pc40 platform */
/* Copyright (C) 2003-2016 Sensory, Inc. All Rights Reserved. */
/* Generated on Wed Dec 12 22:28:22 2018
 */
/********* Sensory Confidential **********/

#include "sensorytypes.h"

//#ifndef __gs_t
//typedef const u16  __gs_t;
//#endif

__gs_t gs_wakeword_grammarLabel[] = {

   40,	 // 0x0028
  217,	 // 0x00d9
   33,	 // 0x0021
    0,	 // 0x0000
    1,	 // 0x0001
   34,	 // 0x0022
   32,	 // 0x0020
    0,	 // 0x0000
   32,	 // 0x0020
  178,	 // 0x00b2
  177,	 // 0x00b1
 1000,	 // 0x03e8
    0,	 // 0x0000
   27,	 // 0x001b
  200,	 // 0x00c8
 1000,	 // 0x03e8
   30,	 // 0x001e
    4,	 // 0x0004
   56,	 // 0x0038
    6,	 // 0x0006
    5,	 // 0x0005
    2,	 // 0x0002
   33,	 // 0x0021
   33,	 // 0x0021
    5,	 // 0x0005
    2,	 // 0x0002
    0,	 // 0x0000
    3,	 // 0x0003
    3,	 // 0x0003
    0,	 // 0x0000
    0,	 // 0x0000
    0,	 // 0x0000
    0,	 // 0x0000
    0,	 // 0x0000
    0,	 // 0x0000
28771,	 // 0x7063
  102,	 // 0x0066
  110,	 // 0x006e
  222,	 // 0x00de
  234,	 // 0x00ea
  244,	 // 0x00f4
  248,	 // 0x00f8
  314,	 // 0x013a
  380,	 // 0x017c
  400,	 // 0x0190
    0,	 // 0x0000
  416,	 // 0x01a0
  422,	 // 0x01a6
  426,	 // 0x01aa
    0,	 // 0x0000
  558,	 // 0x022e
 1020,	 // 0x03fc
 1020,	 // 0x03fc
 1020,	 // 0x03fc
 1020,	 // 0x03fc
    4,	 // 0x0004
32770,	 // 0x8002
    5,	 // 0x0005
32771,	 // 0x8003
    2,	 // 0x0002
32768,	 // 0x8000
    3,	 // 0x0003
32769,	 // 0x8001
    8,	 // 0x0008
32775,	 // 0x8007
    5,	 // 0x0005
32772,	 // 0x8004
   10,	 // 0x000a
32777,	 // 0x8009
    7,	 // 0x0007
32774,	 // 0x8006
   13,	 // 0x000d
32779,	 // 0x800b
   14,	 // 0x000e
32780,	 // 0x800c
   11,	 // 0x000b
32777,	 // 0x8009
   12,	 // 0x000c
32778,	 // 0x800a
   17,	 // 0x0011
32784,	 // 0x8010
   14,	 // 0x000e
32781,	 // 0x800d
   16,	 // 0x0010
32783,	 // 0x800f
   20,	 // 0x0014
32787,	 // 0x8013
   23,	 // 0x0017
   22,	 // 0x0016
32789,	 // 0x8015
   19,	 // 0x0013
32786,	 // 0x8012
   28,	 // 0x001c
32792,	 // 0x8018
   27,	 // 0x001b
32793,	 // 0x8019
   29,	 // 0x001d
32794,	 // 0x801a
   25,	 // 0x0019
32790,	 // 0x8016
   24,	 // 0x0018
32789,	 // 0x8015
   26,	 // 0x001a
32791,	 // 0x8017
   32,	 // 0x0020
32799,	 // 0x801f
   29,	 // 0x001d
   28,	 // 0x001c
32795,	 // 0x801b
   31,	 // 0x001f
32798,	 // 0x801e
   97,	 // 0x0061
  108,	 // 0x006c
  101,	 // 0x0065
  120,	 // 0x0078
   97,	 // 0x0061
    0,	 // 0x0000
   32,	 // 0x0020
   29,	 // 0x001d
   28,	 // 0x001c
   27,	 // 0x001b
65535,	 // 0xffff
    0,	 // 0x0000
    0,	 // 0x0000
14080,	 // 0x3700
14080,	 // 0x3700
14080,	 // 0x3700
14080,	 // 0x3700
14080,	 // 0x3700
14080,	 // 0x3700
14080,	 // 0x3700
14080,	 // 0x3700
14080,	 // 0x3700
14080,	 // 0x3700
14080,	 // 0x3700
14080,	 // 0x3700
14080,	 // 0x3700
14080,	 // 0x3700
14080,	 // 0x3700
14080,	 // 0x3700
14080,	 // 0x3700
14080,	 // 0x3700
14080,	 // 0x3700
14080,	 // 0x3700
14080,	 // 0x3700
14080,	 // 0x3700
14080,	 // 0x3700
14080,	 // 0x3700
14080,	 // 0x3700
14080,	 // 0x3700
14080,	 // 0x3700
14080,	 // 0x3700
14080,	 // 0x3700
14080,	 // 0x3700
14080,	 // 0x3700
14080,	 // 0x3700
14080,	 // 0x3700
 1545,	 // 0x0609
 1793,	 // 0x0701
 1230,	 // 0x04ce
 1586,	 // 0x0632
 1440,	 // 0x05a0
 1586,	 // 0x0632
 1407,	 // 0x057f
 1513,	 // 0x05e9
 1491,	 // 0x05d3
 1479,	 // 0x05c7
 1560,	 // 0x0618
 1557,	 // 0x0615
 1621,	 // 0x0655
 1576,	 // 0x0628
 1603,	 // 0x0643
 1608,	 // 0x0648
 1577,	 // 0x0629
 1658,	 // 0x067a
 1778,	 // 0x06f2
 1773,	 // 0x06ed
 1701,	 // 0x06a5
 1970,	 // 0x07b2
 1529,	 // 0x05f9
 1296,	 // 0x0510
 1790,	 // 0x06fe
 1313,	 // 0x0521
 1271,	 // 0x04f7
 1219,	 // 0x04c3
 1718,	 // 0x06b6
 1210,	 // 0x04ba
 1379,	 // 0x0563
 1248,	 // 0x04e0
 1176,	 // 0x0498
    1,	 // 0x0001
    2,	 // 0x0002
    1,	 // 0x0001
    5,	 // 0x0005
    1,	 // 0x0001
    7,	 // 0x0007
    1,	 // 0x0001
    3,	 // 0x0003
    1,	 // 0x0001
    4,	 // 0x0004
  110,	 // 0x006e
    1,	 // 0x0001
    2,	 // 0x0002
    1,	 // 0x0001
  110,	 // 0x006e
    1,	 // 0x0001
    5,	 // 0x0005
    1,	 // 0x0001
    1,	 // 0x0001
    0,	 // 0x0000
65535,	 // 0xffff
 2395,	 // 0x095b
 2395,	 // 0x095b
   34,	 // 0x0022
   81,	 // 0x0051
   32,	 // 0x0020
  230,	 // 0x00e6
    0,	 // 0x0000
    0,	 // 0x0000
    0,	 // 0x0000
    0,	 // 0x0000
    0,	 // 0x0000
    0,	 // 0x0000
    0,	 // 0x0000
    0,	 // 0x0000
   50,	 // 0x0032
  307,	 // 0x0133
    0,	 // 0x0000
    0,	 // 0x0000
    0,	 // 0x0000
    0,	 // 0x0000
   34,	 // 0x0022
  150,	 // 0x0096
   36,	 // 0x0024
  118,	 // 0x0076
    0,	 // 0x0000
    0,	 // 0x0000
    0,	 // 0x0000
    0,	 // 0x0000
    0,	 // 0x0000
    0,	 // 0x0000
    0,	 // 0x0000
    0,	 // 0x0000
   32,	 // 0x0020
  110,	 // 0x006e
    0,	 // 0x0000
    0,	 // 0x0000
    0,	 // 0x0000
    0,	 // 0x0000
   35,	 // 0x0023
  167,	 // 0x00a7
    0,	 // 0x0000
    0,	 // 0x0000
    0,	 // 0x0000
    0,	 // 0x0000
   32,	 // 0x0020
  230,	 // 0x00e6
   32,	 // 0x0020
   96,	 // 0x0060
   34,	 // 0x0022
   81,	 // 0x0051
    0,	 // 0x0000
    0,	 // 0x0000
    0,	 // 0x0000
    0,	 // 0x0000
    0,	 // 0x0000
    0,	 // 0x0000
    0,	 // 0x0000
    0,	 // 0x0000
    0,	 // 0x0000
    0,	 // 0x0000
    0,	 // 0x0000
    0,	 // 0x0000
   35,	 // 0x0023
   91,	 // 0x005b
    0,	 // 0x0000
    0,	 // 0x0000
    0,	 // 0x0000
    0,	 // 0x0000
   25,	 // 0x0019
    0,	 // 0x0000
    2,	 // 0x0002
32768,	 // 0x8000
65535,	 // 0xffff
   25,	 // 0x0019
    1,	 // 0x0001
   12,	 // 0x000c
32770,	 // 0x8002
65535,	 // 0xffff
    0,	 // 0x0000
    0,	 // 0x0000
    1,	 // 0x0001
    4,	 // 0x0004
    0,	 // 0x0000
    0,	 // 0x0000
    1,	 // 0x0001
   11,	 // 0x000b
    5,	 // 0x0005
    1,	 // 0x0001
    0,	 // 0x0000
    0,	 // 0x0000
    0,	 // 0x0000
    6,	 // 0x0006
32772,	 // 0x8004
    0,	 // 0x0000
    1,	 // 0x0001
   10,	 // 0x000a
    6,	 // 0x0006
32774,	 // 0x8006
   16,	 // 0x0010
    2,	 // 0x0002
   27,	 // 0x001b
32776,	 // 0x8008
32778,	 // 0x800a
    0,	 // 0x0000
    2,	 // 0x0002
   26,	 // 0x001a
    8,	 // 0x0008
    6,	 // 0x0006
    0,	 // 0x0000
    2,	 // 0x0002
   25,	 // 0x0019
32780,	 // 0x800c
32782,	 // 0x800e
   16,	 // 0x0010
    3,	 // 0x0003
   18,	 // 0x0012
32784,	 // 0x8010
    8,	 // 0x0008
   16,	 // 0x0010
    3,	 // 0x0003
   21,	 // 0x0015
32786,	 // 0x8012
    8,	 // 0x0008
    0,	 // 0x0000
    3,	 // 0x0003
   17,	 // 0x0011
   13,	 // 0x000d
    9,	 // 0x0009
    0,	 // 0x0000
    3,	 // 0x0003
   20,	 // 0x0014
   14,	 // 0x000e
   10,	 // 0x000a
    0,	 // 0x0000
    3,	 // 0x0003
   16,	 // 0x0010
   15,	 // 0x000f
32788,	 // 0x8014
    0,	 // 0x0000
    3,	 // 0x0003
   19,	 // 0x0013
   15,	 // 0x000f
32790,	 // 0x8016
   16,	 // 0x0010
    0,	 // 0x0000
   15,	 // 0x000f
32792,	 // 0x8018
32794,	 // 0x801a
    0,	 // 0x0000
    0,	 // 0x0000
   14,	 // 0x000e
   17,	 // 0x0011
   15,	 // 0x000f
    0,	 // 0x0000
    0,	 // 0x0000
   13,	 // 0x000d
   18,	 // 0x0012
32796,	 // 0x801c
   16,	 // 0x0010
    4,	 // 0x0004
   24,	 // 0x0018
32798,	 // 0x801e
   17,	 // 0x0011
    0,	 // 0x0000
    4,	 // 0x0004
   23,	 // 0x0017
   20,	 // 0x0014
   18,	 // 0x0012
    0,	 // 0x0000
    4,	 // 0x0004
   22,	 // 0x0016
32800,	 // 0x8020
32803,	 // 0x8023
   16,	 // 0x0010
    1,	 // 0x0001
   28,	 // 0x001c
32805,	 // 0x8025
   20,	 // 0x0014
   16,	 // 0x0010
    0,	 // 0x0000
    9,	 // 0x0009
32807,	 // 0x8027
   20,	 // 0x0014
   16,	 // 0x0010
    0,	 // 0x0000
   29,	 // 0x001d
32809,	 // 0x8029
   20,	 // 0x0014
    0,	 // 0x0000
    1,	 // 0x0001
   30,	 // 0x001e
   28,	 // 0x001c
   21,	 // 0x0015
    0,	 // 0x0000
    0,	 // 0x0000
    8,	 // 0x0008
   27,	 // 0x001b
   22,	 // 0x0016
    0,	 // 0x0000
    0,	 // 0x0000
   31,	 // 0x001f
   29,	 // 0x001d
   23,	 // 0x0017
    0,	 // 0x0000
    0,	 // 0x0000
    7,	 // 0x0007
   30,	 // 0x001e
32811,	 // 0x802b
    0,	 // 0x0000
    1,	 // 0x0001
   32,	 // 0x0020
   30,	 // 0x001e
32813,	 // 0x802d
    0,	 // 0x0000
    0,	 // 0x0000
   33,	 // 0x0021
   30,	 // 0x001e
32815,	 // 0x802f
   16,	 // 0x0010
    0,	 // 0x0000
    6,	 // 0x0006
32817,	 // 0x8031
32819,	 // 0x8033
    0,	 // 0x0000
    0,	 // 0x0000
    5,	 // 0x0005
   32,	 // 0x0020
   30,	 // 0x001e
    0,	 // 0x0000
    0,	 // 0x0000
    4,	 // 0x0004
65535,	 // 0xffff
32822,	 // 0x8036
};
```
