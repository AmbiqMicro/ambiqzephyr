## sample.yaml
```
sample:
  name: AMIC sample
tests:
  sample.drivers.audio.amic:
    tags: dmic
    filter: dt_nodelabel_enabled("amic_dev")
    integration_platforms:
      - apollo510
    harness: console
    harness_config:
      type: multi_line
      ordered: true
      regex:
        - "AMIC sample"
        - "Exiting"
```

## prj.conf
```kconfig
CONFIG_AUDIO=y
CONFIG_AUDIO_AMIC=y

CONFIG_LOG=y
CONFIG_MAIN_STACK_SIZE=4096
```

## boards/apollo510_evb.overlay
```dts
amic_dev: &audadc0 {
    audadc-buffer-location = "SRAM_NO_CACHE";
    audadc-buffer-size = <1280>;
	status = "okay";
};
```

## src/main.c
```c
/*
 * Copyright (c) 2025 Ambiq Micro Inc.
 *
 * SPDX-License-Identifier: Apache-2.0
 */

#include <zephyr/kernel.h>
#include <zephyr/audio/amic.h>

#include <zephyr/logging/log.h>
LOG_MODULE_REGISTER(amic_sample);

#define SAMPLE_RATE  16000
#define BYTES_PER_SAMPLE sizeof(int16_t)
/* Milliseconds to wait for a block to be read. */
#define READ_TIMEOUT     1000

/* AUDADC is 1 channel supported only */
#define NUMBER_OF_CHANNELS	1
#define SAMPLE_BIT_WIDTH (16 * NUMBER_OF_CHANNELS)

/* Size of a block for 100 ms of audio data. */
#define BLOCK_SIZE(_sample_rate, _number_of_channels) \
	(BYTES_PER_SAMPLE * (_sample_rate / 10) * _number_of_channels)

/* Driver will allocate blocks from this slab to receive audio data into them.
 * Application, after getting a given block from the driver and processing its
 * data, needs to free that block.
 */
#define BLOCK_SIZE_BYTES   BLOCK_SIZE(SAMPLE_RATE, NUMBER_OF_CHANNELS)
#define BLOCK_COUNT      4
K_MEM_SLAB_DEFINE_STATIC(mem_slab, BLOCK_SIZE_BYTES, BLOCK_COUNT, 4);

static int do_audadc_transfer(const struct device *amic_dev,
			   struct amic_cfg *cfg,
			   size_t block_count)
{
	int ret;

	LOG_INF("PCM output rate: %u, channels: %u",
		cfg->streams[0].pcm_rate, 1);

	ret = amic_configure(amic_dev, cfg);
	if (ret < 0) {
		LOG_ERR("Failed to configure the driver: %d", ret);
		return ret;
	}

	ret = amic_trigger(amic_dev, AMIC_TRIGGER_START);
	if (ret < 0) {
		LOG_ERR("START trigger failed: %d", ret);
		return ret;
	}

	for (int i = 0; i < block_count; ++i) {
		void *buffer;
		uint32_t size;

		ret = amic_read(amic_dev, 0, &buffer, &size, READ_TIMEOUT);
		if (ret < 0) {
			LOG_ERR("%d - read failed: %d", i, ret);
			return ret;
		}

		LOG_INF("%d - got buffer %p of %u bytes", i, buffer, size);

		k_mem_slab_free(&mem_slab, buffer);
	}

	ret = amic_trigger(amic_dev, AMIC_TRIGGER_STOP);
	if (ret < 0) {
		LOG_ERR("STOP trigger failed: %d", ret);
		return ret;
	}

	return ret;
}

int main(void)
{
	const struct device *const amic_dev = DEVICE_DT_GET(DT_NODELABEL(amic_dev));
	int ret;

	LOG_INF("AMIC sample");

	if (!device_is_ready(amic_dev)) {
		LOG_ERR("%s is not ready", amic_dev->name);
		return 0;
	}

	struct pcm_stream_cfg stream = {
		.pcm_width = SAMPLE_BIT_WIDTH,
		.mem_slab  = &mem_slab,
	};
	struct amic_cfg cfg = {
		.streams = &stream,
    };

	cfg.streams[0].pcm_rate = SAMPLE_RATE;
	cfg.streams[0].block_size = BLOCK_SIZE_BYTES;

	ret = do_audadc_transfer(amic_dev, &cfg, 2 * BLOCK_COUNT);
	if (ret < 0) {
		return 0;
	}

	LOG_INF("Exiting");
	return 0;
}
```
